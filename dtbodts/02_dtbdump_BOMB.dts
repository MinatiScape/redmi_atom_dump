/dts-v1/;

/ {
	compatible = "mediatek,MT6873";
	model = "BOMB";

	__fixups__ {
		accdet = "/fragment@15:target:0";
		auxadc = "/fragment@37:target:0\0/fragment@38/__overlay__:io-channels:0";
		bat_gm30 = "/fragment@79:target:0";
		camera_af_hw_node = "/fragment@11:target:0";
		charger = "/fragment@65:target:0";
		chosen = "/fragment@1:target:0";
		consys = "/fragment@26:target:0";
		cp_qc30 = "/fragment@70:target:0";
		dispsys_config = "/fragment@13:target:0";
		dsi0 = "/fragment@14:target:0";
		dsi_te = "/fragment@53:target:0";
		fan53870_l1 = "/fragment@33/__overlay__:cam0_vcamd-supply:0";
		fan53870_l2 = "/fragment@33/__overlay__:cam1_vcamd-supply:0";
		fan53870_l3 = "/fragment@33/__overlay__:cam0_vcama-supply:0";
		fan53870_l4 = "/fragment@33/__overlay__:cam2_vcama-supply:0\0/fragment@33/__overlay__:cam4_vcama-supply:0";
		fan53870_l5 = "/fragment@33/__overlay__:cam1_vcama-supply:0\0/fragment@33/__overlay__:cam3_vcama-supply:0";
		fan53870_l6 = "/fragment@11/__overlay__:vcamois-supply:0";
		fan53870_l7 = "/fragment@11/__overlay__:vcamaf-supply:0";
		goodix_fp = "/fragment@19:target:0";
		gpio = "/fragment@51:target:0";
		gpio_usage_mapping = "/fragment@50:target:0";
		i2c0 = "/fragment@4:target:0\0/fragment@6:target:0\0/fragment@40:target:0";
		i2c1 = "/fragment@41:target:0";
		i2c2 = "/fragment@34:target:0\0/fragment@42:target:0";
		i2c3 = "/fragment@27:target:0\0/fragment@43:target:0";
		i2c4 = "/fragment@35:target:0\0/fragment@44:target:0";
		i2c5 = "/fragment@45:target:0";
		i2c6 = "/fragment@9:target:0\0/fragment@30:target:0\0/fragment@46:target:0";
		i2c7 = "/fragment@47:target:0";
		i2c8 = "/fragment@36:target:0\0/fragment@48:target:0";
		i2c9 = "/fragment@49:target:0\0/fragment@69:target:0";
		irtx_pwm = "/fragment@16:target:0";
		kd_camera_hw1 = "/fragment@33:target:0\0/fragment@61:target:0";
		keypad = "/fragment@63:target:0";
		lk_charger = "/fragment@64:target:0";
		maxim_ds28e16 = "/fragment@74:target:0";
		md1_sim1_hot_plug_eint = "/fragment@58:target:0";
		md_auxadc = "/fragment@38:target:0";
		mrdump_ext_rst = "/fragment@52:target:0";
		mt6360_pmic = "/fragment@22:target:0";
		mt6360_pmu = "/fragment@21:target:0\0/fragment@66:target:0";
		mt6360_typec = "/fragment@23:target:0";
		mt_pmic_vcamio_ldo_reg = "/fragment@31:target:0\0/fragment@33/__overlay__:cam0_vcamio-supply:0\0/fragment@33/__overlay__:cam1_vcamio-supply:0\0/fragment@33/__overlay__:cam2_vcamio-supply:0\0/fragment@33/__overlay__:cam3_vcamio-supply:0\0/fragment@33/__overlay__:cam4_vcamio-supply:0\0/fragment@59:target:0\0/fragment@61/__overlay__:vcamaf-supply:0\0/fragment@61/__overlay__:vcamaf_sub-supply:0";
		mt_pmic_vfp_ldo_reg = "/fragment@18/__overlay__/fingerprint@0:vfp-supply:0";
		mt_pmic_vtp_ldo_reg = "/fragment@3/__overlay__/gt9896s@0:vtouch-supply:0\0/fragment@4/__overlay__/gt9886@5d:vtouch-supply:0\0/fragment@6/__overlay__/focaltech@38:avdd-supply:0\0/fragment@60:target:0\0/fragment@62/__overlay__:vtouch-supply:0";
		mtkfb = "/fragment@12:target:0";
		odm = "/fragment@2:target:0\0/fragment@67:target:0";
		onewire_gpio = "/fragment@73:target:0";
		pd_adapter = "/fragment@76:target:0";
		pio = "/fragment@3/__overlay__/gt9896s@0:goodix,reset-gpio:0\0/fragment@3/__overlay__/gt9896s@0:goodix,irq-gpio:0\0/fragment@4/__overlay__/gt9886@5d:interrupt-parent:0\0/fragment@4/__overlay__/gt9886@5d:goodix,reset-gpio:0\0/fragment@4/__overlay__/gt9886@5d:goodix,irq-gpio:0\0/fragment@5:target:0\0/fragment@6/__overlay__/focaltech@38:interrupt-parent:0\0/fragment@6/__overlay__/focaltech@38:focaltech,reset-gpio:0\0/fragment@6/__overlay__/focaltech@38:focaltech,irq-gpio:0\0/fragment@7:target:0\0/fragment@8:target:0\0/fragment@9/__overlay__/aw8624_haptic@5a:reset-gpio:0\0/fragment@9/__overlay__/aw8624_haptic@5a:irq-gpio:0\0/fragment@10:target:0\0/fragment@14/__overlay__/panel@0:pm-enable-gpios:0\0/fragment@14/__overlay__/panel@0:reset-gpios:0\0/fragment@17:target:0\0/fragment@19/__overlay__:interrupt-parent:0\0/fragment@20:target:0\0/fragment@21/__overlay__:mt6360,intr_gpio:0\0/fragment@23/__overlay__:mt6360pd,intr_gpio:0\0/fragment@23/__overlay__:mt6360pd,pcb_gpio:0\0/fragment@24:target:0\0/fragment@25:target:0\0/fragment@27/__overlay__/nxp@28:qcom,nq-irq:0\0/fragment@27/__overlay__/nxp@28:interrupt-parent:0\0/fragment@27/__overlay__/nxp@28:qcom,nq-ven:0\0/fragment@27/__overlay__/nxp@28:qcom,nq-firm:0\0/fragment@27/__overlay__/nxp@28:qcom,nq-clkreq:0\0/fragment@28:target:0\0/fragment@30/__overlay__/cs35l41@40:reset-gpio:0\0/fragment@30/__overlay__/cs35l41@40:interrupt-parent:0\0/fragment@30/__overlay__/cs35l41@40:irq-gpio:0\0/fragment@32:target:0\0/fragment@50/__overlay__:GPIO_SIM1_HOT_PLUG:0\0/fragment@50/__overlay__:GPIO_SIM2_SCLK:0\0/fragment@50/__overlay__:GPIO_SIM2_SRST:0\0/fragment@50/__overlay__:GPIO_SIM2_SIO:0\0/fragment@50/__overlay__:GPIO_SIM1_SIO:0\0/fragment@50/__overlay__:GPIO_SIM1_SRST:0\0/fragment@50/__overlay__:GPIO_SIM1_SCLK:0\0/fragment@50/__overlay__:GPIO_FDD_BAND_SUPPORT_DETECT_1ST_PIN:0\0/fragment@50/__overlay__:GPIO_FDD_BAND_SUPPORT_DETECT_2ND_PIN:0\0/fragment@50/__overlay__:GPIO_FDD_BAND_SUPPORT_DETECT_3RD_PIN:0\0/fragment@50/__overlay__:GPIO_FDD_BAND_SUPPORT_DETECT_4TH_PIN:0\0/fragment@52/__overlay__:interrupt-parent:0\0/fragment@52/__overlay__:deb-gpios:0\0/fragment@53/__overlay__:interrupt-parent:0\0/fragment@54/__overlay__:interrupt-parent:0\0/fragment@55/__overlay__:interrupt-parent:0\0/fragment@56/__overlay__:interrupt-parent:0\0/fragment@57/__overlay__:interrupt-parent:0\0/fragment@67/__overlay__/simtray:status-gpio:0\0/fragment@68:target:0\0/fragment@69/__overlay__/bq2597x-standalone@66:interrupt-parent:0\0/fragment@69/__overlay__/xmusb350-charger@35:interrupt-parent:0\0/fragment@69/__overlay__/xmusb350-charger@35:xm,xmusb350_rst_gpio:0\0/fragment@69/__overlay__/xmusb350-charger@35:xm,xmusb350_sda_gpio:0\0/fragment@69/__overlay__/xmusb350-charger@35:xm,xmusb350_scl_gpio:0\0/fragment@69/__overlay__/xmusb350-charger@35:mi,connect_therm:0\0/fragment@72:target:0\0/fragment@73/__overlay__:xiaomi,ow_gpio:0";
		pmic_clock_buffer_ctrl = "/fragment@39:target:0";
		reserved_memory = "/fragment@0:target:0";
		smart_pa = "/fragment@57:target:0";
		spi1 = "/fragment@18:target:0";
		spi5 = "/fragment@29:target:0";
		spi7 = "/fragment@3:target:0";
		subpmic_pmu_eint = "/fragment@55:target:0";
		tcpc_pd = "/fragment@56:target:0";
		thermal_message = "/fragment@77:target:0";
		touch = "/fragment@54:target:0\0/fragment@62:target:0";
		usb0phy = "/fragment@78:target:0";
		usbpd_pm = "/fragment@71:target:0";
		xiaomi_touch = "/fragment@75:target:0";
	};

	__local_fixups__ {

		fragment@12 {

			__overlay__ {
				pinctrl-0 = <0x00>;
				pinctrl-1 = <0x00>;
				pinctrl-2 = <0x00>;
			};
		};

		fragment@13 {

			__overlay__ {
				pinctrl-0 = <0x00>;
				pinctrl-1 = <0x00>;
				pinctrl-2 = <0x00>;
			};
		};

		fragment@14 {

			__overlay__ {

				panel@0 {

					port {

						endpoint {
							remote-endpoint = <0x00>;
						};
					};
				};

				ports {

					port {

						endpoint {
							remote-endpoint = <0x00>;
						};
					};
				};
			};
		};

		fragment@16 {

			__overlay__ {
				pinctrl-0 = <0x00>;
				pinctrl-1 = <0x00>;
			};
		};

		fragment@19 {

			__overlay__ {
				pinctrl-0 = <0x00>;
				pinctrl-1 = <0x00>;
				pinctrl-2 = <0x00>;
				pinctrl-3 = <0x00>;
			};
		};

		fragment@2 {

			__overlay__ {

				usb_c_pinctrl {
					pinctrl-0 = <0x00>;
					pinctrl-1 = <0x00>;
					pinctrl-10 = <0x00>;
					pinctrl-11 = <0x00>;
					pinctrl-12 = <0x00>;
					pinctrl-2 = <0x00>;
					pinctrl-3 = <0x00>;
					pinctrl-4 = <0x00>;
					pinctrl-5 = <0x00>;
					pinctrl-6 = <0x00>;
					pinctrl-7 = <0x00>;
					pinctrl-8 = <0x00>;
					pinctrl-9 = <0x00>;
				};
			};
		};

		fragment@26 {

			__overlay__ {
				pinctrl-0 = <0x00>;
				pinctrl-1 = <0x00>;
				pinctrl-2 = <0x00>;
				pinctrl-3 = <0x00>;
			};
		};

		fragment@27 {

			__overlay__ {

				nxp@28 {
					pinctrl-0 = <0x00>;
					pinctrl-1 = <0x00 0x04 0x08 0x0c>;
					pinctrl-2 = <0x00 0x04 0x08 0x0c>;
				};
			};
		};

		fragment@3 {

			__overlay__ {
				pinctrl-0 = <0x00>;
				pinctrl-1 = <0x00>;
				pinctrl-2 = <0x00>;
				pinctrl-3 = <0x00>;
				pinctrl-4 = <0x00>;
				pinctrl-5 = <0x00>;
			};
		};

		fragment@33 {

			__overlay__ {
				pinctrl-0 = <0x00>;
				pinctrl-1 = <0x00>;
				pinctrl-10 = <0x00>;
				pinctrl-11 = <0x00>;
				pinctrl-12 = <0x00>;
				pinctrl-13 = <0x00>;
				pinctrl-14 = <0x00>;
				pinctrl-15 = <0x00>;
				pinctrl-16 = <0x00>;
				pinctrl-17 = <0x00>;
				pinctrl-18 = <0x00>;
				pinctrl-19 = <0x00>;
				pinctrl-2 = <0x00>;
				pinctrl-20 = <0x00>;
				pinctrl-21 = <0x00>;
				pinctrl-22 = <0x00>;
				pinctrl-23 = <0x00>;
				pinctrl-24 = <0x00>;
				pinctrl-25 = <0x00>;
				pinctrl-26 = <0x00>;
				pinctrl-27 = <0x00>;
				pinctrl-28 = <0x00>;
				pinctrl-29 = <0x00>;
				pinctrl-3 = <0x00>;
				pinctrl-30 = <0x00>;
				pinctrl-31 = <0x00>;
				pinctrl-32 = <0x00>;
				pinctrl-33 = <0x00>;
				pinctrl-34 = <0x00>;
				pinctrl-35 = <0x00>;
				pinctrl-36 = <0x00>;
				pinctrl-37 = <0x00>;
				pinctrl-38 = <0x00>;
				pinctrl-39 = <0x00>;
				pinctrl-4 = <0x00>;
				pinctrl-40 = <0x00>;
				pinctrl-41 = <0x00>;
				pinctrl-42 = <0x00>;
				pinctrl-43 = <0x00>;
				pinctrl-44 = <0x00>;
				pinctrl-45 = <0x00>;
				pinctrl-46 = <0x00>;
				pinctrl-47 = <0x00>;
				pinctrl-48 = <0x00>;
				pinctrl-49 = <0x00>;
				pinctrl-5 = <0x00>;
				pinctrl-50 = <0x00>;
				pinctrl-51 = <0x00>;
				pinctrl-52 = <0x00>;
				pinctrl-53 = <0x00>;
				pinctrl-54 = <0x00>;
				pinctrl-55 = <0x00>;
				pinctrl-56 = <0x00>;
				pinctrl-57 = <0x00>;
				pinctrl-58 = <0x00>;
				pinctrl-59 = <0x00>;
				pinctrl-6 = <0x00>;
				pinctrl-60 = <0x00>;
				pinctrl-61 = <0x00>;
				pinctrl-62 = <0x00>;
				pinctrl-63 = <0x00>;
				pinctrl-64 = <0x00>;
				pinctrl-65 = <0x00>;
				pinctrl-66 = <0x00>;
				pinctrl-67 = <0x00>;
				pinctrl-7 = <0x00>;
				pinctrl-8 = <0x00>;
				pinctrl-9 = <0x00>;
			};
		};

		fragment@4 {

			__overlay__ {
				pinctrl-0 = <0x00>;
				pinctrl-1 = <0x00>;
				pinctrl-2 = <0x00>;
				pinctrl-3 = <0x00>;
				pinctrl-4 = <0x00>;
				pinctrl-5 = <0x00>;
			};
		};

		fragment@6 {

			__overlay__ {

				focaltech@38 {
					pinctrl-0 = <0x00 0x04>;
					pinctrl-1 = <0x00 0x04>;
				};
			};
		};

		fragment@69 {

			__overlay__ {

				bq2597x-standalone@66 {
					pinctrl-0 = <0x00 0x04>;
				};

				xmusb350-charger@35 {
					pinctrl-0 = <0x00 0x04 0x08>;
					pinctrl-1 = <0x00 0x04 0x08>;
				};
			};
		};

		fragment@73 {

			__overlay__ {
				pinctrl-0 = <0x00>;
				pinctrl-1 = <0x00>;
			};
		};

		fragment@9 {

			__overlay__ {

				aw8624_haptic@5a {
					pinctrl-0 = <0x00>;
					pinctrl-1 = <0x00>;
					pinctrl-2 = <0x00>;
				};
			};
		};
	};

	__symbols__ {
		aw8624_haptic_mtk = "/fragment@46/__overlay__/aw8624_haptic@5a";
		aw8624_interrupt = "/fragment@8/__overlay__/aw8624_interrupt_active";
		aw8624_reset_high = "/fragment@8/__overlay__/aw8624_reset_reset";
		aw8624_reset_low = "/fragment@8/__overlay__/aw8624_reset_active";
		bq2597x_int_default = "/fragment@68/__overlay__/bq2597x_int_default";
		bq2597x_int_suspend = "/fragment@68/__overlay__/bq2597x_int_suspend";
		camera_main_af_mtk = "/fragment@42/__overlay__/camera_main_af@18";
		camera_main_mtk = "/fragment@42/__overlay__/camera_main@5a";
		camera_main_three_mtk = "/fragment@44/__overlay__/camera_main_three@5a";
		camera_main_two_af_mtk = "/fragment@48/__overlay__/camera_main_two_af@1e";
		camera_main_two_mtk = "/fragment@48/__overlay__/camera_main_two@40";
		camera_pins_cam0_mclk_2ma = "/fragment@32/__overlay__/camera_pins_cam0_mclk_2ma";
		camera_pins_cam0_mclk_4ma = "/fragment@32/__overlay__/camera_pins_cam0_mclk_4ma";
		camera_pins_cam0_mclk_6ma = "/fragment@32/__overlay__/camera_pins_cam0_mclk_6ma";
		camera_pins_cam0_mclk_8ma = "/fragment@32/__overlay__/camera_pins_cam0_mclk_8ma";
		camera_pins_cam0_mclk_off = "/fragment@32/__overlay__/camera_pins_cam0_mclk_off";
		camera_pins_cam0_pnd_0 = "/fragment@32/__overlay__/cam0@2";
		camera_pins_cam0_pnd_1 = "/fragment@32/__overlay__/cam0@3";
		camera_pins_cam0_rst_0 = "/fragment@32/__overlay__/cam0@0";
		camera_pins_cam0_rst_1 = "/fragment@32/__overlay__/cam0@1";
		camera_pins_cam0_vcama_0 = "/fragment@32/__overlay__/cam0@vcam2";
		camera_pins_cam0_vcama_1 = "/fragment@32/__overlay__/cam0@vcam3";
		camera_pins_cam0_vcamd_0 = "/fragment@32/__overlay__/cam0@vcam0";
		camera_pins_cam0_vcamd_1 = "/fragment@32/__overlay__/cam0@vcam1";
		camera_pins_cam1_mclk_2ma = "/fragment@32/__overlay__/camera_pins_cam1_mclk_2ma";
		camera_pins_cam1_mclk_4ma = "/fragment@32/__overlay__/camera_pins_cam1_mclk_4ma";
		camera_pins_cam1_mclk_6ma = "/fragment@32/__overlay__/camera_pins_cam1_mclk_6ma";
		camera_pins_cam1_mclk_8ma = "/fragment@32/__overlay__/camera_pins_cam1_mclk_8ma";
		camera_pins_cam1_mclk_off = "/fragment@32/__overlay__/camera_pins_cam1_mclk_off";
		camera_pins_cam1_pnd_0 = "/fragment@32/__overlay__/cam1@2";
		camera_pins_cam1_pnd_1 = "/fragment@32/__overlay__/cam1@3";
		camera_pins_cam1_rst_0 = "/fragment@32/__overlay__/cam1@0";
		camera_pins_cam1_rst_1 = "/fragment@32/__overlay__/cam1@1";
		camera_pins_cam1_vcama_0 = "/fragment@32/__overlay__/cam1@vcam2";
		camera_pins_cam1_vcama_1 = "/fragment@32/__overlay__/cam1@vcam3";
		camera_pins_cam1_vcamd_0 = "/fragment@32/__overlay__/cam1@vcam0";
		camera_pins_cam1_vcamd_1 = "/fragment@32/__overlay__/cam1@vcam1";
		camera_pins_cam2_mclk_2ma = "/fragment@32/__overlay__/camera_pins_cam2_mclk_2ma";
		camera_pins_cam2_mclk_4ma = "/fragment@32/__overlay__/camera_pins_cam2_mclk_4ma";
		camera_pins_cam2_mclk_6ma = "/fragment@32/__overlay__/camera_pins_cam2_mclk_6ma";
		camera_pins_cam2_mclk_8ma = "/fragment@32/__overlay__/camera_pins_cam2_mclk_8ma";
		camera_pins_cam2_mclk_off = "/fragment@32/__overlay__/camera_pins_cam2_mclk_off";
		camera_pins_cam2_pnd_0 = "/fragment@32/__overlay__/cam2@2";
		camera_pins_cam2_pnd_1 = "/fragment@32/__overlay__/cam2@3";
		camera_pins_cam2_rst_0 = "/fragment@32/__overlay__/cam2@0";
		camera_pins_cam2_rst_1 = "/fragment@32/__overlay__/cam2@1";
		camera_pins_cam2_vcama_0 = "/fragment@32/__overlay__/cam2@vcam2";
		camera_pins_cam2_vcama_1 = "/fragment@32/__overlay__/cam2@vcam3";
		camera_pins_cam2_vcamd_0 = "/fragment@32/__overlay__/cam2@vcam0";
		camera_pins_cam2_vcamd_1 = "/fragment@32/__overlay__/cam2@vcam1";
		camera_pins_cam3_mclk_2ma = "/fragment@32/__overlay__/camera_pins_cam3_mclk_2ma";
		camera_pins_cam3_mclk_4ma = "/fragment@32/__overlay__/camera_pins_cam3_mclk_4ma";
		camera_pins_cam3_mclk_6ma = "/fragment@32/__overlay__/camera_pins_cam3_mclk_6ma";
		camera_pins_cam3_mclk_8ma = "/fragment@32/__overlay__/camera_pins_cam3_mclk_8ma";
		camera_pins_cam3_mclk_off = "/fragment@32/__overlay__/camera_pins_cam3_mclk_off";
		camera_pins_cam3_pnd_0 = "/fragment@32/__overlay__/cam3@2";
		camera_pins_cam3_pnd_1 = "/fragment@32/__overlay__/cam3@3";
		camera_pins_cam3_rst_0 = "/fragment@32/__overlay__/cam3@0";
		camera_pins_cam3_rst_1 = "/fragment@32/__overlay__/cam3@1";
		camera_pins_cam3_vcama_0 = "/fragment@32/__overlay__/cam3@vcam2";
		camera_pins_cam3_vcama_1 = "/fragment@32/__overlay__/cam3@vcam3";
		camera_pins_cam3_vcamd_0 = "/fragment@32/__overlay__/cam3@vcam0";
		camera_pins_cam3_vcamd_1 = "/fragment@32/__overlay__/cam3@vcam1";
		camera_pins_cam4_mclk_2ma = "/fragment@32/__overlay__/camera_pins_cam4_mclk_2ma";
		camera_pins_cam4_mclk_4ma = "/fragment@32/__overlay__/camera_pins_cam4_mclk_4ma";
		camera_pins_cam4_mclk_6ma = "/fragment@32/__overlay__/camera_pins_cam4_mclk_6ma";
		camera_pins_cam4_mclk_8ma = "/fragment@32/__overlay__/camera_pins_cam4_mclk_8ma";
		camera_pins_cam4_mclk_off = "/fragment@32/__overlay__/camera_pins_cam4_mclk_off";
		camera_pins_cam4_pnd_0 = "/fragment@32/__overlay__/cam4@2";
		camera_pins_cam4_pnd_1 = "/fragment@32/__overlay__/cam4@3";
		camera_pins_cam4_rst_0 = "/fragment@32/__overlay__/cam4@0";
		camera_pins_cam4_rst_1 = "/fragment@32/__overlay__/cam4@1";
		camera_pins_cam4_vcama_0 = "/fragment@32/__overlay__/cam4@vcam2";
		camera_pins_cam4_vcama_1 = "/fragment@32/__overlay__/cam4@vcam3";
		camera_pins_cam4_vcamd_0 = "/fragment@32/__overlay__/cam4@vcam0";
		camera_pins_cam4_vcamd_1 = "/fragment@32/__overlay__/cam4@vcam1";
		camera_pins_cam_mipi_switch_sel_0 = "/fragment@32/__overlay__/mipi_sel@0";
		camera_pins_cam_mipi_switch_sel_1 = "/fragment@32/__overlay__/mipi_sel@1";
		camera_pins_default = "/fragment@32/__overlay__/camdefault";
		camera_sub_mtk = "/fragment@44/__overlay__/camera_sub@20";
		camera_sub_two_af_mtk = "/fragment@48/__overlay__/camera_sub_two_af@18";
		camera_sub_two_mtk = "/fragment@48/__overlay__/camera_sub_two@6e";
		consys_pins_default = "/fragment@25/__overlay__/consys_default";
		cs35l41 = "/fragment@30/__overlay__/cs35l41@40";
		ctp_gt9896s_int_active = "/fragment@5/__overlay__/int1_active";
		ctp_gt9896s_int_suspend = "/fragment@5/__overlay__/int1_suspend";
		ctp_gt9896s_pins_default = "/fragment@5/__overlay__/pins_default";
		ctp_gt9896s_reset_active = "/fragment@5/__overlay__/reset1_active";
		ctp_gt9896s_reset_suspend = "/fragment@5/__overlay__/reset1_suspend";
		ctp_gt9896s_spi_mode = "/fragment@5/__overlay__/spimode_default";
		ctp_pins_default = "/fragment@5/__overlay__/eintdefault";
		ctp_ts_i2c_mode = "/fragment@5/__overlay__/i2cmode_default";
		ctp_ts_int_active = "/fragment@5/__overlay__/int_active";
		ctp_ts_int_suspend = "/fragment@5/__overlay__/int_suspend";
		ctp_ts_reset_active = "/fragment@5/__overlay__/reset_active";
		ctp_ts_reset_suspend = "/fragment@5/__overlay__/reset_suspend";
		dsi_out = "/fragment@14/__overlay__/ports/port/endpoint";
		fingerprint_default = "/fragment@20/__overlay__/state_default";
		fingerprint_eint_init = "/fragment@20/__overlay__/state_eint_init";
		fingerprint_reset_high = "/fragment@20/__overlay__/state_reset_high";
		fingerprint_reset_low = "/fragment@20/__overlay__/state_reset_low";
		gpio_redriver_c1_high = "/fragment@24/__overlay__/c1_high";
		gpio_redriver_c1_hiz = "/fragment@24/__overlay__/c1_highz";
		gpio_redriver_c1_init = "/fragment@24/__overlay__/c1_init";
		gpio_redriver_c1_low = "/fragment@24/__overlay__/c1_low";
		gpio_redriver_c2_high = "/fragment@24/__overlay__/c2_high";
		gpio_redriver_c2_hiz = "/fragment@24/__overlay__/c2_highz";
		gpio_redriver_c2_init = "/fragment@24/__overlay__/c2_init";
		gpio_redriver_c2_low = "/fragment@24/__overlay__/c2_low";
		gpio_u3_switch_disable = "/fragment@24/__overlay__/u3_sw_dis";
		gpio_u3_switch_enable = "/fragment@24/__overlay__/u3_sw_en";
		gpio_u3_switch_sel1 = "/fragment@24/__overlay__/u3_sw_sel1";
		gpio_u3_switch_sel2 = "/fragment@24/__overlay__/u3_sw_sel2";
		gpslna_pins_init = "/fragment@25/__overlay__/gpslna@0";
		gpslna_pins_oh = "/fragment@25/__overlay__/gpslna@1";
		gpslna_pins_ol = "/fragment@25/__overlay__/gpslna@2";
		i2c_lcd_bias_mtk = "/fragment@46/__overlay__/i2c_lcd_bias@3e";
		irtx_gpio_led_default = "/fragment@17/__overlay__/irtx_gpio_led_def@gpio135";
		irtx_gpio_led_set = "/fragment@17/__overlay__/irtx_gpio_led_set@gpio135";
		led0 = "/fragment@2/__overlay__/led@0";
		led1 = "/fragment@2/__overlay__/led@1";
		led2 = "/fragment@2/__overlay__/led@2";
		led3 = "/fragment@2/__overlay__/led@3";
		led4 = "/fragment@2/__overlay__/led@4";
		led5 = "/fragment@2/__overlay__/led@5";
		led6 = "/fragment@2/__overlay__/led@6";
		mtk_camera_eeprom0 = "/fragment@34/__overlay__/camera_eeprom0@50";
		mtk_camera_eeprom1 = "/fragment@35/__overlay__/camera_eeprom1@51";
		mtk_camera_eeprom2 = "/fragment@36/__overlay__/camera_eeprom2@52";
		mtk_camera_eeprom3 = "/fragment@36/__overlay__/camera_eeprom3@53";
		mtk_camera_eeprom4 = "/fragment@35/__overlay__/camera_eeprom4@54";
		mtkfb_pins_lcm_dsi_te = "/fragment@10/__overlay__/lcm_dsi_te";
		mtkfb_pins_lcm_rst_out0_gpio = "/fragment@10/__overlay__/lcm_rst_out0_gpio";
		mtkfb_pins_lcm_rst_out1_gpio = "/fragment@10/__overlay__/lcm_rst_out1_gpio";
		nfc_clk_req_active = "/fragment@28/__overlay__/nfc_clk_req_active";
		nfc_clk_req_suspend = "/fragment@28/__overlay__/nfc_clk_req_suspend";
		nfc_default = "/fragment@28/__overlay__/nfc_default";
		nfc_enable_active = "/fragment@28/__overlay__/nfc_enable_active";
		nfc_enable_suspend = "/fragment@28/__overlay__/nfc_enable_suspend";
		nfc_firmwaredownload_active = "/fragment@28/__overlay__/nfc_firmwaredownload_active";
		nfc_firmwaredownload_suspend = "/fragment@28/__overlay__/nfc_firmwaredownload_suspend";
		nfc_int_active = "/fragment@28/__overlay__/nfc_int_active";
		nfc_int_suspend = "/fragment@28/__overlay__/nfc_int_suspend";
		nfc_mtk = "/fragment@43/__overlay__/nfc@08";
		onewire_gpio_active = "/fragment@72/__overlay__/onewire_gpio_active@gpio28";
		onewire_gpio_sleep = "/fragment@72/__overlay__/onewire_gpio_sleep@gpio28";
		panel_in = "/fragment@14/__overlay__/panel@0/port/endpoint";
		speaker_amp_mtk = "/fragment@46/__overlay__/speaker_amp@40";
		subpmic_ldo_mtk = "/fragment@45/__overlay__/subpmic_ldo@64";
		subpmic_mtk = "/fragment@45/__overlay__/subpmic@34";
		subpmic_pmic_mtk = "/fragment@45/__overlay__/subpmic_pmic@1a";
		tp_int_active = "/fragment@7/__overlay__/tp_int_active";
		tp_int_suspend = "/fragment@7/__overlay__/tp_int_suspend";
		tp_reset_active = "/fragment@7/__overlay__/tp_reset_active";
		tp_reset_suspend = "/fragment@7/__overlay__/tp_reset_suspend";
		usb_c_pinctrl = "/fragment@2/__overlay__/usb_c_pinctrl";
		usb_default = "/fragment@24/__overlay__/usb_default";
		usb_type_c_mtk = "/fragment@45/__overlay__/usb_type_c@4e";
		vibrator0 = "/fragment@2/__overlay__/vibrator@0";
		xmusb350_int_isp = "/fragment@68/__overlay__/xmusb350_int_isp";
		xmusb350_int_normal = "/fragment@68/__overlay__/xmusb350_int_normal";
		xmusb350_rst_isp = "/fragment@68/__overlay__/xmusb350_rst_isp";
		xmusb350_rst_normal = "/fragment@68/__overlay__/xmusb350_rst_normal";
		xmusb350_scl_isp = "/fragment@68/__overlay__/xmusb350_scl_isp";
		xmusb350_scl_normal = "/fragment@68/__overlay__/xmusb350_scl_normal";
		xmusb350_sda_isp = "/fragment@68/__overlay__/xmusb350_sda_isp";
		xmusb350_sda_normal = "/fragment@68/__overlay__/xmusb350_sda_normal";
	};

	fragment@0 {
		target = <0xffffffff>;

		__overlay__ {
		};
	};

	fragment@1 {
		target = <0xffffffff>;

		__overlay__ {
			atag,videolfb-fb_base_h = <0x00>;
			atag,videolfb-fb_base_l = "~`P";
			atag,videolfb-fps = <0x1770>;
			atag,videolfb-islcm_inited = <0x00>;
			atag,videolfb-islcmfound = <0x01>;
			atag,videolfb-lcmname = "nt35595_fhd_dsi_cmd_truly_nt50358_drv";
			atag,videolfb-vramSize = <0x1be0000>;
		};
	};

	fragment@10 {
		target = <0xffffffff>;

		__overlay__ {

			lcm_dsi_te {
				phandle = <0x23>;

				pins_cmd_dat {
					pinmux = <0x2901>;
				};
			};

			lcm_rst_out0_gpio {
				phandle = <0x22>;

				pins_cmd_dat {
					output-low;
					pinmux = <0x2a00>;
					slew-rate = <0x01>;
				};
			};

			lcm_rst_out1_gpio {
				phandle = <0x21>;

				pins_cmd_dat {
					output-high;
					pinmux = <0x2a00>;
					slew-rate = <0x01>;
				};
			};
		};
	};

	fragment@11 {
		target = <0xffffffff>;

		__overlay__ {
			status = "okay";
			vcamaf-supply = <0xffffffff>;
			vcamois-supply = <0xffffffff>;
		};
	};

	fragment@12 {
		target = <0xffffffff>;

		__overlay__ {
			pinctrl-0 = <0x21>;
			pinctrl-1 = <0x22>;
			pinctrl-2 = <0x23>;
			pinctrl-names = "lcm_rst_out1_gpio\0lcm_rst_out0_gpio\0mode_te_te";
			status = "okay";
		};
	};

	fragment@13 {
		target = <0xffffffff>;

		__overlay__ {
			pinctrl-0 = <0x21>;
			pinctrl-1 = <0x22>;
			pinctrl-2 = <0x23>;
			pinctrl-names = "lcm_rst_out1_gpio\0lcm_rst_out0_gpio\0mode_te_te";
			status = "okay";
		};
	};

	fragment@14 {
		target = <0xffffffff>;

		__overlay__ {
			#address-cells = <0x01>;
			#size-cells = <0x00>;
			status = "okay";

			panel@0 {
				compatible = "s6e8fc01,lcm";
				pinctrl-names = "default";
				pm-enable-gpios = <0xffffffff 0x1d 0x00>;
				reg = <0x00>;
				reset-gpios = <0xffffffff 0x2a 0x00>;

				port {

					endpoint {
						phandle = <0x25>;
						remote-endpoint = <0x24>;
					};
				};
			};

			ports {

				port {

					endpoint {
						phandle = <0x24>;
						remote-endpoint = <0x25>;
					};
				};
			};
		};
	};

	fragment@15 {
		target = <0xffffffff>;

		__overlay__ {
			accdet-mic-mode = <0x02>;
			accdet-mic-vol = <0x08>;
			accdet-plugout-debounce = <0x01>;
			eint_use_ext_res = <0x04>;
			headset-four-key-threshold = <0x00 0x3a 0x79 0xc0 0x190>;
			headset-mode-setting = <0x500 0x500 0x01 0x1f0 0x800 0x1200 0x20 0x44 0x04 0x01 0x05 0x03 0x03 0x07 0x0e>;
			headset-three-key-threshold = <0x00 0x50 0xdc 0x190>;
			headset-three-key-threshold-CDD = <0x00 0x79 0xc0 0x258>;
			status = "okay";
		};
	};

	fragment@16 {
		target = <0xffffffff>;

		__overlay__ {
			pinctrl-0 = <0x26>;
			pinctrl-1 = <0x27>;
			pinctrl-names = "irtx_gpio_led_default\0irtx_gpio_led_set";
			pwm_ch = <0x00>;
			status = "okay";
		};
	};

	fragment@17 {
		target = <0xffffffff>;

		__overlay__ {

			irtx_gpio_led_def@gpio135 {
				phandle = <0x26>;

				pins_cmd_dat {
					bias-disable;
					input-schmitt-enable = <0x00>;
					output-low;
					pinmux = <0x8700>;
					slew-rate = <0x01>;
				};
			};

			irtx_gpio_led_set@gpio135 {
				phandle = <0x27>;

				pins_cmd_dat {
					output-high;
					pinmux = <0x8701>;
					slew-rate = <0x01>;
				};
			};
		};
	};

	fragment@18 {
		target = <0xffffffff>;

		__overlay__ {
			#address-cells = <0x01>;
			#size-cells = <0x00>;

			fingerprint@0 {
				compatible = "goodix,goodix-fp";
				netlink-event = <0x1e>;
				power-type = <0x01>;
				reg = <0x00>;
				spi-max-frequency = <0x7a1200>;
				status = "okay";
				vfp-supply = <0xffffffff>;
			};
		};
	};

	fragment@19 {
		target = <0xffffffff>;

		__overlay__ {
			interrupt-parent = <0xffffffff>;
			interrupts = <0x0f 0x01 0x0f 0x00>;
			pinctrl-0 = <0x28>;
			pinctrl-1 = <0x29>;
			pinctrl-2 = <0x2a>;
			pinctrl-3 = <0x2b>;
			pinctrl-names = "default\0reset_high\0reset_low\0eint_init";
			status = "okay";
		};
	};

	fragment@2 {
		target = <0xffffffff>;

		__overlay__ {

			led@0 {
				compatible = "mediatek,red";
				data = <0x01>;
				led_mode = <0x00>;
				phandle = <0x87>;
				pwm_config = <0x00 0x00 0x00 0x00 0x00>;
			};

			led@1 {
				compatible = "mediatek,green";
				data = <0x01>;
				led_mode = <0x00>;
				phandle = <0x88>;
				pwm_config = <0x00 0x00 0x00 0x00 0x00>;
			};

			led@2 {
				compatible = "mediatek,blue";
				data = <0x01>;
				led_mode = <0x00>;
				phandle = <0x89>;
				pwm_config = <0x00 0x00 0x00 0x00 0x00>;
			};

			led@3 {
				compatible = "mediatek,jogball-backlight";
				data = <0x01>;
				led_mode = <0x00>;
				phandle = <0x8a>;
				pwm_config = <0x00 0x00 0x00 0x00 0x00>;
			};

			led@4 {
				compatible = "mediatek,keyboard-backlight";
				data = <0x01>;
				led_mode = <0x00>;
				phandle = <0x8b>;
				pwm_config = <0x00 0x00 0x00 0x00 0x00>;
			};

			led@5 {
				compatible = "mediatek,button-backlight";
				data = <0x01>;
				led_mode = <0x00>;
				phandle = <0x8c>;
				pwm_config = <0x00 0x00 0x00 0x00 0x00>;
			};

			led@6 {
				compatible = "mediatek,lcd-backlight";
				data = <0x01>;
				led_mode = <0x04>;
				phandle = <0x8d>;
				pwm_config = <0x00 0x01 0x00 0x00 0x00>;
			};

			usb_c_pinctrl {
				compatible = "mediatek,usb_c_pinctrl";
				phandle = <0x8f>;
				pinctrl-0 = <0x01>;
				pinctrl-1 = <0x02>;
				pinctrl-10 = <0x0b>;
				pinctrl-11 = <0x0c>;
				pinctrl-12 = <0x0d>;
				pinctrl-2 = <0x03>;
				pinctrl-3 = <0x04>;
				pinctrl-4 = <0x05>;
				pinctrl-5 = <0x06>;
				pinctrl-6 = <0x07>;
				pinctrl-7 = <0x08>;
				pinctrl-8 = <0x09>;
				pinctrl-9 = <0x0a>;
				pinctrl-names = "usb_default\0redrv_c1_init\0redrv_c1_low\0redrv_c1_hiz\0redrv_c1_high\0redrv_c2_init\0redrv_c2_low\0redrv_c2_hiz\0redrv_c2_high\0switch_sel1\0switch_sel2\0switch_enable\0switch_disable";
				status = "okay";

				usb_switch-data {
					c1_pin_num = <0x71>;
					c1_pin_val = <0x02>;
					c2_pin_num = <0x70>;
					c2_pin_val = <0x01>;
					en_pin_num = <0x00>;
					en_pin_val = <0x00>;
					sel_pin_num = <0x6f>;
					sel_pin_val = <0x01>;
				};
			};

			vibrator@0 {
				compatible = "mediatek,vibrator";
				phandle = <0x8e>;
				vib_limit = <0x09>;
				vib_timer = <0x19>;
				vib_vol = <0x09>;
			};
		};
	};

	fragment@20 {
		target = <0xffffffff>;

		__overlay__ {

			state_default {
				phandle = <0x28>;
			};

			state_eint_init {
				phandle = <0x2b>;

				pins_cmd_dat {
					bias-pull-up = <0x66>;
					input-schmitt-enable;
					pinmux = <0xf00>;
					slew-rate = <0x00>;
				};
			};

			state_reset_high {
				phandle = <0x29>;

				pins_cmd_dat {
					output-high;
					pinmux = <0xe00>;
					slew-rate = <0x01>;
				};
			};

			state_reset_low {
				phandle = <0x2a>;

				pins_cmd_dat {
					output-low;
					pinmux = <0xe00>;
					slew-rate = <0x01>;
				};
			};
		};
	};

	fragment@21 {
		target = <0xffffffff>;

		__overlay__ {
			mt6360,intr_gpio = <0xffffffff 0x18 0x00>;
			mt6360,intr_gpio_num = <0x18>;
		};
	};

	fragment@22 {
		target = <0xffffffff>;

		__overlay__ {
			pwr_off_seq = <0x6000204>;
		};
	};

	fragment@23 {
		target = <0xffffffff>;

		__overlay__ {
			mt6360pd,intr_gpio = <0xffffffff 0x19 0x00>;
			mt6360pd,intr_gpio_num = <0x19>;
			mt6360pd,pcb_gpio = <0xffffffff 0x13 0x00>;
			mt6360pd,pcb_gpio_num = <0x13>;
		};
	};

	fragment@24 {
		target = <0xffffffff>;

		__overlay__ {

			c1_high {
				phandle = <0x05>;

				pins_cmd_dat {
					output-high;
					pinmux = <0x7100>;
					slew-rate = <0x01>;
				};
			};

			c1_highz {
				phandle = <0x04>;

				pins_cmd_dat {
					bias-disable;
					pinmux = <0x7100>;
					slew-rate = <0x00>;
				};
			};

			c1_init {
				phandle = <0x02>;

				pins_cmd_dat {
					output-low;
					pinmux = <0x7100>;
					slew-rate = <0x01>;
				};
			};

			c1_low {
				phandle = <0x03>;

				pins_cmd_dat {
					output-low;
					pinmux = <0x7100>;
					slew-rate = <0x01>;
				};
			};

			c2_high {
				phandle = <0x09>;

				pins_cmd_dat {
					output-high;
					pinmux = <0x7000>;
					slew-rate = <0x01>;
				};
			};

			c2_highz {
				phandle = <0x08>;

				pins_cmd_dat {
					bias-disable;
					pinmux = <0x7000>;
					slew-rate = <0x00>;
				};
			};

			c2_init {
				phandle = <0x06>;

				pins_cmd_dat {
					output-low;
					pinmux = <0x7000>;
					slew-rate = <0x01>;
				};
			};

			c2_low {
				phandle = <0x07>;

				pins_cmd_dat {
					output-low;
					pinmux = <0x7000>;
					slew-rate = <0x01>;
				};
			};

			u3_sw_dis {
				phandle = <0x0d>;
			};

			u3_sw_en {
				phandle = <0x0c>;
			};

			u3_sw_sel1 {
				phandle = <0x0a>;

				pins_cmd_dat {
					output-low;
					pinmux = <0x6f00>;
					slew-rate = <0x01>;
				};
			};

			u3_sw_sel2 {
				phandle = <0x0b>;

				pins_cmd_dat {
					output-high;
					pinmux = <0x6f00>;
					slew-rate = <0x01>;
				};
			};

			usb_default {
				phandle = <0x01>;
			};
		};
	};

	fragment@25 {
		target = <0xffffffff>;

		__overlay__ {

			consys_default {
				phandle = <0x2c>;
			};

			gpslna@0 {
				phandle = <0x2d>;

				pins_cmd_dat {
					output-low;
					pinmux = <0xa200>;
				};
			};

			gpslna@1 {
				phandle = <0x2e>;

				pins_cmd_dat {
					pinmux = <0xa202>;
				};
			};

			gpslna@2 {
				phandle = <0x2f>;

				pins_cmd_dat {
					output-low;
					pinmux = <0xa200>;
				};
			};
		};
	};

	fragment@26 {
		target = <0xffffffff>;

		__overlay__ {
			pinctrl-0 = <0x2c>;
			pinctrl-1 = <0x2d>;
			pinctrl-2 = <0x2e>;
			pinctrl-3 = <0x2f>;
			pinctrl-names = "default\0gps_lna_state_init\0gps_lna_state_oh\0gps_lna_state_ol";
			status = "okay";
		};
	};

	fragment@27 {
		target = <0xffffffff>;

		__overlay__ {
			status = "okay";

			nxp@28 {
				compatible = "qcom,nq-nci";
				interrupt-names = "nfc_irq";
				interrupt-parent = <0xffffffff>;
				interrupts = <0x0b 0x04 0x0b 0x00>;
				pinctrl-0 = <0x30>;
				pinctrl-1 = <0x31 0x32 0x33 0x34>;
				pinctrl-2 = <0x35 0x36 0x37 0x38>;
				pinctrl-names = "default\0nfc_active\0nfc_suspend";
				qcom,nq-clkreq = <0xffffffff 0x12 0x00>;
				qcom,nq-firm = <0xffffffff 0x11 0x00>;
				qcom,nq-irq = <0xffffffff 0x0b 0x00>;
				qcom,nq-ven = <0xffffffff 0x0a 0x00>;
				reg = <0x28>;
			};
		};
	};

	fragment@28 {
		target = <0xffffffff>;

		__overlay__ {

			nfc_clk_req_active {
				phandle = <0x33>;

				pins_cmd_dat {
					bias-pull-up;
					drive-strength = <0x02>;
					input-enable;
					pinmux = <0x1201>;
					slew-rate = <0x00>;
				};
			};

			nfc_clk_req_suspend {
				phandle = <0x37>;

				pins_cmd_dat {
					bias-pull-down;
					drive-strength = <0x02>;
					input-enable;
					pinmux = <0x1201>;
					slew-rate = <0x00>;
				};
			};

			nfc_default {
				phandle = <0x30>;
			};

			nfc_enable_active {
				phandle = <0x32>;

				pins_cmd_dat {
					bias-pull-up = <0x67>;
					drive-strength = <0x02>;
					output-high;
					pinmux = <0xa00>;
					slew-rate = <0x01>;
				};
			};

			nfc_enable_suspend {
				phandle = <0x36>;

				pins_cmd_dat {
					bias-disable;
					drive-strength = <0x02>;
					pinmux = <0xa00>;
					slew-rate = <0x01>;
				};
			};

			nfc_firmwaredownload_active {
				phandle = <0x34>;

				pins_cmd_dat {
					bias-pull-up;
					drive-strength = <0x02>;
					pinmux = <0x1100>;
					slew-rate = <0x01>;
				};
			};

			nfc_firmwaredownload_suspend {
				phandle = <0x38>;

				pins_cmd_dat {
					bias-disable;
					drive-strength = <0x02>;
					pinmux = <0x1100>;
					slew-rate = <0x01>;
				};
			};

			nfc_int_active {
				phandle = <0x31>;

				pins_cmd_dat {
					bias-pull-up;
					drive-strength = <0x02>;
					pinmux = <0xb00>;
					slew-rate = <0x00>;
				};
			};

			nfc_int_suspend {
				phandle = <0x35>;

				pins_cmd_dat {
					bias-pull-up;
					drive-strength = <0x02>;
					pinmux = <0xb00>;
					slew-rate = <0x00>;
				};
			};
		};
	};

	fragment@29 {
		target = <0xffffffff>;

		__overlay__ {
			#address-cells = <0x01>;
			#size-cells = <0x00>;

			p61@31 {
				compatible = "nxp,p61";
				reg = <0x00>;
				spi-max-frequency = <0x7a1200>;
				status = "okay";
			};
		};
	};

	fragment@3 {
		target = <0xffffffff>;

		__overlay__ {
			#address-cells = <0x01>;
			#size-cells = <0x00>;
			pinctrl-0 = <0x0e>;
			pinctrl-1 = <0x0f>;
			pinctrl-2 = <0x10>;
			pinctrl-3 = <0x11>;
			pinctrl-4 = <0x12>;
			pinctrl-5 = <0x13>;
			pinctrl-names = "default\0gt9896s_int_active\0gt9896s_reset_active\0gt9896s_int_suspend\0gt9896s_reset_suspend\0gt9896s_spi_mode";
			status = "okay";

			gt9896s@0 {
				compatible = "goodix,gt9896s";
				goodix,avdd-name = "vtouch";
				goodix,config-version = "6873v01";
				goodix,firmware-version = "6873v00";
				goodix,input-max-x = <0x438>;
				goodix,input-max-y = <0x8e8>;
				goodix,irq-flags = <0x02>;
				goodix,irq-gpio = <0xffffffff 0x15 0x00>;
				goodix,panel-key-map = <0x9e 0xac 0xd9>;
				goodix,panel-max-id = <0x0a>;
				goodix,panel-max-p = <0x100>;
				goodix,panel-max-w = <0x100>;
				goodix,panel-max-x = <0x438>;
				goodix,panel-max-y = <0x8e8>;
				goodix,pen-enable;
				goodix,power-off-delay-us = <0x1388>;
				goodix,power-on-delay-us = <0x2710>;
				goodix,reset-gpio = <0xffffffff 0x14 0x00>;
				reg = <0x00>;
				spi-max-frequency = <0xf4240>;
				tpd-filter-custom-prameters = <0x00 0x00 0x00 0x00 0x00 0x00 0x00 0x00 0x00 0x00 0x00 0x00>;
				tpd-filter-custom-speed = <0x00 0x00 0x00>;
				tpd-filter-enable = <0x00>;
				tpd-filter-pixel-density = <0xa1>;
				vtouch-supply = <0xffffffff>;
			};
		};
	};

	fragment@30 {
		target = <0xffffffff>;

		__overlay__ {
			status = "okay";

			cs35l41@40 {
				cirrus,boost-cap-microfarad = <0x0f>;
				cirrus,boost-ind-nanohenry = <0x3e8>;
				cirrus,boost-peak-milliamp = <0x1194>;
				compatible = "cirrus,cs35l41";
				interrupt-parent = <0xffffffff>;
				interrupts = <0x1f 0x08 0x1f 0x00>;
				irq-gpio = <0xffffffff 0x1f 0x00>;
				phandle = <0x90>;
				reg = <0x40>;
				reset-gpio = <0xffffffff 0x1e 0x00>;

				cirrus,gpio-config2 {
					cirrus,gpio-output-enable;
					cirrus,gpio-src-select = <0x04>;
				};
			};
		};
	};

	fragment@31 {
		target = <0xffffffff>;

		__overlay__ {
			regulator-default-on = <0x01>;
			status = "okay";
		};
	};

	fragment@32 {
		target = <0xffffffff>;

		__overlay__ {

			cam0@0 {
				phandle = <0x3a>;

				pins_cmd_dat {
					output-low;
					pinmux = <0x8f00>;
					slew-rate = <0x01>;
				};
			};

			cam0@1 {
				phandle = <0x3b>;

				pins_cmd_dat {
					output-high;
					pinmux = <0x8f00>;
					slew-rate = <0x01>;
				};
			};

			cam0@2 {
				phandle = <0x3c>;

				pins_cmd_dat {
					output-low;
					pinmux = <0xa500>;
					slew-rate = <0x01>;
				};
			};

			cam0@3 {
				phandle = <0x3d>;

				pins_cmd_dat {
					output-high;
					pinmux = <0xa500>;
					slew-rate = <0x01>;
				};
			};

			cam0@vcam0 {
				phandle = <0x4e>;

				pins_cmd_dat {
					output-low;
					pinmux = <0x8a00>;
					slew-rate = <0x01>;
				};
			};

			cam0@vcam1 {
				phandle = <0x4f>;

				pins_cmd_dat {
					output-high;
					pinmux = <0x8a00>;
					slew-rate = <0x01>;
				};
			};

			cam0@vcam2 {
				phandle = <0x50>;

				pins_cmd_dat {
					output-low;
					pinmux = <0x8a00>;
					slew-rate = <0x01>;
				};
			};

			cam0@vcam3 {
				phandle = <0x51>;

				pins_cmd_dat {
					output-high;
					pinmux = <0x8a00>;
					slew-rate = <0x01>;
				};
			};

			cam1@0 {
				phandle = <0x3e>;

				pins_cmd_dat {
					output-low;
					pinmux = <0x9000>;
					slew-rate = <0x01>;
				};
			};

			cam1@1 {
				phandle = <0x3f>;

				pins_cmd_dat {
					output-high;
					pinmux = <0x9000>;
					slew-rate = <0x01>;
				};
			};

			cam1@2 {
				phandle = <0x40>;

				pins_cmd_dat {
					output-low;
					pinmux = <0x9000>;
					slew-rate = <0x01>;
				};
			};

			cam1@3 {
				phandle = <0x41>;

				pins_cmd_dat {
					output-high;
					pinmux = <0x9000>;
					slew-rate = <0x01>;
				};
			};

			cam1@vcam0 {
				phandle = <0x52>;

				pins_cmd_dat {
					output-low;
					pinmux = <0x8a00>;
					slew-rate = <0x01>;
				};
			};

			cam1@vcam1 {
				phandle = <0x53>;

				pins_cmd_dat {
					output-high;
					pinmux = <0x8a00>;
					slew-rate = <0x01>;
				};
			};

			cam1@vcam2 {
				phandle = <0x54>;

				pins_cmd_dat {
					output-low;
					pinmux = <0x8a00>;
					slew-rate = <0x01>;
				};
			};

			cam1@vcam3 {
				phandle = <0x55>;

				pins_cmd_dat {
					output-high;
					pinmux = <0x8a00>;
					slew-rate = <0x01>;
				};
			};

			cam2@0 {
				phandle = <0x42>;

				pins_cmd_dat {
					output-low;
					pinmux = <0x9100>;
					slew-rate = <0x01>;
				};
			};

			cam2@1 {
				phandle = <0x43>;

				pins_cmd_dat {
					output-high;
					pinmux = <0x9100>;
					slew-rate = <0x01>;
				};
			};

			cam2@2 {
				phandle = <0x44>;

				pins_cmd_dat {
					output-low;
					pinmux = <0x9100>;
					slew-rate = <0x01>;
				};
			};

			cam2@3 {
				phandle = <0x45>;

				pins_cmd_dat {
					output-high;
					pinmux = <0x9100>;
					slew-rate = <0x01>;
				};
			};

			cam2@vcam0 {
				phandle = <0x56>;

				pins_cmd_dat {
					output-low;
					pinmux = <0x9300>;
					slew-rate = <0x01>;
				};
			};

			cam2@vcam1 {
				phandle = <0x57>;

				pins_cmd_dat {
					output-high;
					pinmux = <0x9300>;
					slew-rate = <0x01>;
				};
			};

			cam2@vcam2 {
				phandle = <0x58>;

				pins_cmd_dat {
					output-low;
					pinmux = <0x8a00>;
					slew-rate = <0x01>;
				};
			};

			cam2@vcam3 {
				phandle = <0x59>;

				pins_cmd_dat {
					output-high;
					pinmux = <0x8a00>;
					slew-rate = <0x01>;
				};
			};

			cam3@0 {
				phandle = <0x46>;

				pins_cmd_dat {
					output-low;
					pinmux = <0x8200>;
					slew-rate = <0x01>;
				};
			};

			cam3@1 {
				phandle = <0x47>;

				pins_cmd_dat {
					output-high;
					pinmux = <0x8200>;
					slew-rate = <0x01>;
				};
			};

			cam3@2 {
				phandle = <0x48>;

				pins_cmd_dat {
					output-low;
					pinmux = <0x8200>;
					slew-rate = <0x01>;
				};
			};

			cam3@3 {
				phandle = <0x49>;

				pins_cmd_dat {
					output-high;
					pinmux = <0x8200>;
					slew-rate = <0x01>;
				};
			};

			cam3@vcam0 {
				phandle = <0x5a>;

				pins_cmd_dat {
					output-low;
					pinmux = <0x8500>;
					slew-rate = <0x01>;
				};
			};

			cam3@vcam1 {
				phandle = <0x5b>;

				pins_cmd_dat {
					output-high;
					pinmux = <0x8500>;
					slew-rate = <0x01>;
				};
			};

			cam3@vcam2 {
				phandle = <0x5c>;

				pins_cmd_dat {
					output-low;
					pinmux = <0x8a00>;
					slew-rate = <0x01>;
				};
			};

			cam3@vcam3 {
				phandle = <0x5d>;

				pins_cmd_dat {
					output-high;
					pinmux = <0x8a00>;
					slew-rate = <0x01>;
				};
			};

			cam4@0 {
				phandle = <0x4a>;

				pins_cmd_dat {
					output-low;
					pinmux = <0x8300>;
					slew-rate = <0x01>;
				};
			};

			cam4@1 {
				phandle = <0x4b>;

				pins_cmd_dat {
					output-high;
					pinmux = <0x8300>;
					slew-rate = <0x01>;
				};
			};

			cam4@2 {
				phandle = <0x4c>;

				pins_cmd_dat {
					output-low;
					pinmux = <0x8300>;
					slew-rate = <0x01>;
				};
			};

			cam4@3 {
				phandle = <0x4d>;

				pins_cmd_dat {
					output-high;
					pinmux = <0x8300>;
					slew-rate = <0x01>;
				};
			};

			cam4@vcam0 {
				phandle = <0x5e>;

				pins_cmd_dat {
					output-low;
					pinmux = <0x9400>;
					slew-rate = <0x01>;
				};
			};

			cam4@vcam1 {
				phandle = <0x5f>;

				pins_cmd_dat {
					output-high;
					pinmux = <0x9400>;
					slew-rate = <0x01>;
				};
			};

			cam4@vcam2 {
				phandle = <0x60>;

				pins_cmd_dat {
					output-low;
					pinmux = <0x8a00>;
					slew-rate = <0x01>;
				};
			};

			cam4@vcam3 {
				phandle = <0x61>;

				pins_cmd_dat {
					output-high;
					pinmux = <0x8a00>;
					slew-rate = <0x01>;
				};
			};

			camdefault {
				phandle = <0x39>;
			};

			camera_pins_cam0_mclk_2ma {
				phandle = <0x63>;

				pins_cmd_dat {
					drive-strength = <0x00>;
					pinmux = <0x9501>;
				};
			};

			camera_pins_cam0_mclk_4ma {
				phandle = <0x64>;

				pins_cmd_dat {
					drive-strength = <0x01>;
					pinmux = <0x9501>;
				};
			};

			camera_pins_cam0_mclk_6ma {
				phandle = <0x65>;

				pins_cmd_dat {
					drive-strength = <0x02>;
					pinmux = <0x9501>;
				};
			};

			camera_pins_cam0_mclk_8ma {
				phandle = <0x66>;

				pins_cmd_dat {
					drive-strength = <0x03>;
					pinmux = <0x9501>;
				};
			};

			camera_pins_cam0_mclk_off {
				phandle = <0x62>;

				pins_cmd_dat {
					drive-strength = <0x01>;
					pinmux = <0x9500>;
				};
			};

			camera_pins_cam1_mclk_2ma {
				phandle = <0x68>;

				pins_cmd_dat {
					drive-strength = <0x00>;
					pinmux = <0x9601>;
				};
			};

			camera_pins_cam1_mclk_4ma {
				phandle = <0x69>;

				pins_cmd_dat {
					drive-strength = <0x01>;
					pinmux = <0x9601>;
				};
			};

			camera_pins_cam1_mclk_6ma {
				phandle = <0x6a>;

				pins_cmd_dat {
					drive-strength = <0x02>;
					pinmux = <0x9601>;
				};
			};

			camera_pins_cam1_mclk_8ma {
				phandle = <0x6b>;

				pins_cmd_dat {
					drive-strength = <0x03>;
					pinmux = <0x9601>;
				};
			};

			camera_pins_cam1_mclk_off {
				phandle = <0x67>;

				pins_cmd_dat {
					drive-strength = <0x01>;
					pinmux = <0x9600>;
				};
			};

			camera_pins_cam2_mclk_2ma {
				phandle = <0x6d>;

				pins_cmd_dat {
					drive-strength = <0x00>;
					pinmux = <0x8901>;
				};
			};

			camera_pins_cam2_mclk_4ma {
				phandle = <0x6e>;

				pins_cmd_dat {
					drive-strength = <0x01>;
					pinmux = <0x8901>;
				};
			};

			camera_pins_cam2_mclk_6ma {
				phandle = <0x6f>;

				pins_cmd_dat {
					drive-strength = <0x02>;
					pinmux = <0x8901>;
				};
			};

			camera_pins_cam2_mclk_8ma {
				phandle = <0x70>;

				pins_cmd_dat {
					drive-strength = <0x03>;
					pinmux = <0x8901>;
				};
			};

			camera_pins_cam2_mclk_off {
				phandle = <0x6c>;

				pins_cmd_dat {
					drive-strength = <0x01>;
					pinmux = <0x8900>;
				};
			};

			camera_pins_cam3_mclk_2ma {
				phandle = <0x72>;

				pins_cmd_dat {
					drive-strength = <0x00>;
					pinmux = <0x8801>;
				};
			};

			camera_pins_cam3_mclk_4ma {
				phandle = <0x73>;

				pins_cmd_dat {
					drive-strength = <0x01>;
					pinmux = <0x8801>;
				};
			};

			camera_pins_cam3_mclk_6ma {
				phandle = <0x74>;

				pins_cmd_dat {
					drive-strength = <0x02>;
					pinmux = <0x8801>;
				};
			};

			camera_pins_cam3_mclk_8ma {
				phandle = <0x75>;

				pins_cmd_dat {
					drive-strength = <0x03>;
					pinmux = <0x8801>;
				};
			};

			camera_pins_cam3_mclk_off {
				phandle = <0x71>;

				pins_cmd_dat {
					drive-strength = <0x01>;
					pinmux = <0x8800>;
				};
			};

			camera_pins_cam4_mclk_2ma {
				phandle = <0x77>;

				pins_cmd_dat {
					drive-strength = <0x00>;
					pinmux = <0x9701>;
				};
			};

			camera_pins_cam4_mclk_4ma {
				phandle = <0x78>;

				pins_cmd_dat {
					drive-strength = <0x01>;
					pinmux = <0x9701>;
				};
			};

			camera_pins_cam4_mclk_6ma {
				phandle = <0x79>;

				pins_cmd_dat {
					drive-strength = <0x02>;
					pinmux = <0x9701>;
				};
			};

			camera_pins_cam4_mclk_8ma {
				phandle = <0x7a>;

				pins_cmd_dat {
					drive-strength = <0x03>;
					pinmux = <0x9701>;
				};
			};

			camera_pins_cam4_mclk_off {
				phandle = <0x76>;

				pins_cmd_dat {
					drive-strength = <0x01>;
					pinmux = <0x9700>;
				};
			};

			mipi_sel@0 {
				phandle = <0x7c>;

				pins_cmd_dat {
					output-low;
					pinmux = <0x9200>;
					slew-rate = <0x01>;
				};
			};

			mipi_sel@1 {
				phandle = <0x7b>;

				pins_cmd_dat {
					output-high;
					pinmux = <0x9200>;
					slew-rate = <0x01>;
				};
			};
		};
	};

	fragment@33 {
		target = <0xffffffff>;

		__overlay__ {
			cam0_enable_sensor = "ov48bsunny_mipi_raw ov48bofilm_mipi_raw s5kgw1ofilm_mipi_raw";
			cam0_vcama-supply = <0xffffffff>;
			cam0_vcamd-supply = <0xffffffff>;
			cam0_vcamio-supply = <0xffffffff>;
			cam1_enable_sensor = "s5k3t2sunny_mipi_raw s5k3t2ofilm_mipi_raw ov16a1qsunny_mipi_raw ov16a1qofilm_mipi_raw";
			cam1_vcama-supply = <0xffffffff>;
			cam1_vcamd-supply = <0xffffffff>;
			cam1_vcamio-supply = <0xffffffff>;
			cam2_enable_sensor = "gc02m1b_mipi_raw hi847sunny_mipi_raw hi847ofilm_mipi_raw";
			cam2_vcama-supply = <0xffffffff>;
			cam2_vcamio-supply = <0xffffffff>;
			cam3_enable_sensor = "gc5035sunny_mipi_raw gc5035ofilm_mipi_raw";
			cam3_vcama-supply = <0xffffffff>;
			cam3_vcamio-supply = <0xffffffff>;
			cam4_enable_sensor = "s5k4h7sunny_mipi_raw s5k4h7ofilm_mipi_raw";
			cam4_vcama-supply = <0xffffffff>;
			cam4_vcamio-supply = <0xffffffff>;
			pinctrl-0 = <0x39>;
			pinctrl-1 = <0x3a>;
			pinctrl-10 = <0x43>;
			pinctrl-11 = <0x44>;
			pinctrl-12 = <0x45>;
			pinctrl-13 = <0x46>;
			pinctrl-14 = <0x47>;
			pinctrl-15 = <0x48>;
			pinctrl-16 = <0x49>;
			pinctrl-17 = <0x4a>;
			pinctrl-18 = <0x4b>;
			pinctrl-19 = <0x4c>;
			pinctrl-2 = <0x3b>;
			pinctrl-20 = <0x4d>;
			pinctrl-21 = <0x4e>;
			pinctrl-22 = <0x4f>;
			pinctrl-23 = <0x50>;
			pinctrl-24 = <0x51>;
			pinctrl-25 = <0x52>;
			pinctrl-26 = <0x53>;
			pinctrl-27 = <0x54>;
			pinctrl-28 = <0x55>;
			pinctrl-29 = <0x56>;
			pinctrl-3 = <0x3c>;
			pinctrl-30 = <0x57>;
			pinctrl-31 = <0x58>;
			pinctrl-32 = <0x59>;
			pinctrl-33 = <0x5a>;
			pinctrl-34 = <0x5b>;
			pinctrl-35 = <0x5c>;
			pinctrl-36 = <0x5d>;
			pinctrl-37 = <0x5e>;
			pinctrl-38 = <0x5f>;
			pinctrl-39 = <0x60>;
			pinctrl-4 = <0x3d>;
			pinctrl-40 = <0x61>;
			pinctrl-41 = <0x62>;
			pinctrl-42 = <0x63>;
			pinctrl-43 = <0x64>;
			pinctrl-44 = <0x65>;
			pinctrl-45 = <0x66>;
			pinctrl-46 = <0x67>;
			pinctrl-47 = <0x68>;
			pinctrl-48 = <0x69>;
			pinctrl-49 = <0x6a>;
			pinctrl-5 = <0x3e>;
			pinctrl-50 = <0x6b>;
			pinctrl-51 = <0x6c>;
			pinctrl-52 = <0x6d>;
			pinctrl-53 = <0x6e>;
			pinctrl-54 = <0x6f>;
			pinctrl-55 = <0x70>;
			pinctrl-56 = <0x71>;
			pinctrl-57 = <0x72>;
			pinctrl-58 = <0x73>;
			pinctrl-59 = <0x74>;
			pinctrl-6 = <0x3f>;
			pinctrl-60 = <0x75>;
			pinctrl-61 = <0x76>;
			pinctrl-62 = <0x77>;
			pinctrl-63 = <0x78>;
			pinctrl-64 = <0x79>;
			pinctrl-65 = <0x7a>;
			pinctrl-66 = <0x7b>;
			pinctrl-67 = <0x7c>;
			pinctrl-7 = <0x40>;
			pinctrl-8 = <0x41>;
			pinctrl-9 = <0x42>;
			pinctrl-names = "default\0cam0_rst0\0cam0_rst1\0cam0_pnd0\0cam0_pnd1\0cam1_rst0\0cam1_rst1\0cam1_pnd0\0cam1_pnd1\0cam2_rst0\0cam2_rst1\0cam2_pnd0\0cam2_pnd1\0cam3_rst0\0cam3_rst1\0cam3_pnd0\0cam3_pnd1\0cam4_rst0\0cam4_rst1\0cam4_pnd0\0cam4_pnd1\0cam0_ldo_vcamd_0\0cam0_ldo_vcamd_1\0cam0_ldo_vcama_0\0cam0_ldo_vcama_1\0cam1_ldo_vcamd_0\0cam1_ldo_vcamd_1\0cam1_ldo_vcama_0\0cam1_ldo_vcama_1\0cam2_ldo_vcamd_0\0cam2_ldo_vcamd_1\0cam2_ldo_vcama_0\0cam2_ldo_vcama_1\0cam3_ldo_vcamd_0\0cam3_ldo_vcamd_1\0cam3_ldo_vcama_0\0cam3_ldo_vcama_1\0cam4_ldo_vcamd_0\0cam4_ldo_vcamd_1\0cam4_ldo_vcama_0\0cam4_ldo_vcama_1\0cam0_mclk_off\0cam0_mclk_2mA\0cam0_mclk_4mA\0cam0_mclk_6mA\0cam0_mclk_8mA\0cam1_mclk_off\0cam1_mclk_2mA\0cam1_mclk_4mA\0cam1_mclk_6mA\0cam1_mclk_8mA\0cam2_mclk_off\0cam2_mclk_2mA\0cam2_mclk_4mA\0cam2_mclk_6mA\0cam2_mclk_8mA\0cam3_mclk_off\0cam3_mclk_2mA\0cam3_mclk_4mA\0cam3_mclk_6mA\0cam3_mclk_8mA\0cam4_mclk_off\0cam4_mclk_2mA\0cam4_mclk_4mA\0cam4_mclk_6mA\0cam4_mclk_8mA\0cam_mipi_switch_sel_1\0cam_mipi_switch_sel_0";
			status = "okay";
		};
	};

	fragment@34 {
		target = <0xffffffff>;

		__overlay__ {

			camera_eeprom0@50 {
				compatible = "mediatek,camera_eeprom";
				phandle = <0x91>;
				reg = <0x50>;
				status = "okay";
			};
		};
	};

	fragment@35 {
		target = <0xffffffff>;

		__overlay__ {

			camera_eeprom1@51 {
				compatible = "mediatek,camera_eeprom";
				phandle = <0x92>;
				reg = <0x51>;
				status = "okay";
			};

			camera_eeprom4@54 {
				compatible = "mediatek,camera_eeprom";
				phandle = <0x93>;
				reg = <0x54>;
				status = "okay";
			};
		};
	};

	fragment@36 {
		target = <0xffffffff>;

		__overlay__ {

			camera_eeprom2@52 {
				compatible = "mediatek,camera_eeprom";
				phandle = <0x94>;
				reg = <0x52>;
				status = "okay";
			};

			camera_eeprom3@53 {
				compatible = "mediatek,camera_eeprom";
				phandle = <0x95>;
				reg = <0x53>;
				status = "okay";
			};
		};
	};

	fragment@37 {
		target = <0xffffffff>;

		__overlay__ {

			adc_channel@ {
				compatible = "mediatek,adc_channel";
				mediatek,adc_fdd_rf_params_dynamic_custom_ch = <0x02>;
				mediatek,temperature0 = <0x00>;
				mediatek,temperature1 = <0x01>;
				status = "okay";
			};
		};
	};

	fragment@38 {
		target = <0xffffffff>;

		__overlay__ {
			io-channels = <0xffffffff 0x02>;
		};
	};

	fragment@39 {
		target = <0xffffffff>;

		__overlay__ {
			mediatek,clkbuf-config = <0x02 0x01 0x01 0x02 0x00 0x00 0x01>;
			mediatek,clkbuf-controls-for-desense = <0x00 0x04 0x00 0x04 0x00 0x00 0x00>;
			mediatek,clkbuf-output-impedance = <0x06 0x00 0x04 0x04 0x00 0x00 0x04>;
			mediatek,clkbuf-quantity = <0x07>;
			status = "okay";
		};
	};

	fragment@4 {
		target = <0xffffffff>;

		__overlay__ {
			clock-frequency = <0x61a80>;
			pinctrl-0 = <0x14>;
			pinctrl-1 = <0x15>;
			pinctrl-2 = <0x16>;
			pinctrl-3 = <0x17>;
			pinctrl-4 = <0x18>;
			pinctrl-5 = <0x19>;
			pinctrl-names = "default\0ts_int_active\0ts_reset_active\0ts_int_suspend\0ts_reset_suspend\0ts_i2c_mode";

			gt9886@5d {
				compatible = "goodix,gt9886";
				goodix,config-version = "6885v9c";
				goodix,firmware-version = "6885b1";
				goodix,input-max-x = <0x438>;
				goodix,input-max-y = <0x8e8>;
				goodix,irq-flags = <0x02>;
				goodix,irq-gpio = <0xffffffff 0x15 0x00>;
				goodix,key-of-pen = <0x14b 0x14c>;
				goodix,panel-key-map = <0x9e 0xac 0xd9>;
				goodix,panel-max-id = <0x0a>;
				goodix,panel-max-p = <0x100>;
				goodix,panel-max-w = <0x100>;
				goodix,panel-max-x = <0x438>;
				goodix,panel-max-y = <0x8e8>;
				goodix,pen-enable;
				goodix,power-off-delay-us = <0x1388>;
				goodix,power-on-delay-us = <0x2710>;
				goodix,reset-gpio = <0xffffffff 0x14 0x00>;
				goodix,x2x;
				goodix,y2y;
				interrupt-parent = <0xffffffff>;
				interrupts = <0x15 0x02 0x15 0x00>;
				reg = <0x5d>;
				status = "disable";
				tpd-filter-custom-prameters = <0x00 0x00 0x00 0x00 0x00 0x00 0x00 0x00 0x00 0x00 0x00 0x00>;
				tpd-filter-custom-speed = <0x00 0x00 0x00>;
				tpd-filter-enable = <0x00>;
				tpd-filter-pixel-density = <0xa1>;
				vtouch-supply = <0xffffffff>;

				sensor0 {
					normal-cfg;
				};
			};
		};
	};

	fragment@40 {
		target = <0xffffffff>;

		__overlay__ {
			#address-cells = <0x01>;
			#size-cells = <0x00>;
			clock-frequency = <0x61a80>;
			mediatek,use-open-drain;
		};
	};

	fragment@41 {
		target = <0xffffffff>;

		__overlay__ {
			#address-cells = <0x01>;
			#size-cells = <0x00>;
			clock-frequency = <0x61a80>;
			mediatek,use-open-drain;
		};
	};

	fragment@42 {
		target = <0xffffffff>;

		__overlay__ {
			#address-cells = <0x01>;
			#size-cells = <0x00>;
			clock-frequency = <0x61a80>;
			mediatek,use-open-drain;

			camera_main@5a {
				compatible = "mediatek,camera_main";
				phandle = <0x96>;
				reg = <0x5a>;
				status = "okay";
			};

			camera_main_af@18 {
				compatible = "mediatek,camera_main_af";
				phandle = <0x97>;
				reg = <0x18>;
				status = "okay";
			};
		};
	};

	fragment@43 {
		target = <0xffffffff>;

		__overlay__ {
			#address-cells = <0x01>;
			#size-cells = <0x00>;
			clock-frequency = <0x61a80>;
			mediatek,use-open-drain;

			nfc@08 {
				compatible = "mediatek,nfc";
				phandle = <0x98>;
				reg = <0x08>;
				status = "okay";
			};
		};
	};

	fragment@44 {
		target = <0xffffffff>;

		__overlay__ {
			#address-cells = <0x01>;
			#size-cells = <0x00>;
			clock-frequency = <0x61a80>;
			mediatek,use-open-drain;

			camera_main_three@5a {
				compatible = "mediatek,camera_main_three";
				phandle = <0x9a>;
				reg = <0x5a>;
				status = "okay";
			};

			camera_sub@20 {
				compatible = "mediatek,camera_sub";
				phandle = <0x99>;
				reg = <0x20>;
				status = "okay";
			};
		};
	};

	fragment@45 {
		target = <0xffffffff>;

		__overlay__ {
			#address-cells = <0x01>;
			#size-cells = <0x00>;
			clock-frequency = <0x33e140>;
			mediatek,use-push-pull;

			subpmic@34 {
				compatible = "mediatek,subpmic";
				phandle = <0x9b>;
				reg = <0x34>;
				status = "okay";
			};

			subpmic_ldo@64 {
				compatible = "mediatek,subpmic_ldo";
				phandle = <0x9e>;
				reg = <0x64>;
				status = "okay";
			};

			subpmic_pmic@1a {
				compatible = "mediatek,subpmic_pmic";
				phandle = <0x9d>;
				reg = <0x1a>;
				status = "okay";
			};

			usb_type_c@4e {
				compatible = "mediatek,usb_type_c";
				phandle = <0x9c>;
				reg = <0x4e>;
				status = "okay";
			};
		};
	};

	fragment@46 {
		target = <0xffffffff>;

		__overlay__ {
			#address-cells = <0x01>;
			#size-cells = <0x00>;
			clock-frequency = <0x61a80>;
			mediatek,use-open-drain;

			aw8624_haptic@5a {
				compatible = "mediatek,aw8624_haptic";
				phandle = <0xa1>;
				reg = <0x5a>;
				status = "okay";
			};

			i2c_lcd_bias@3e {
				compatible = "mediatek,i2c_lcd_bias";
				phandle = <0xa0>;
				reg = <0x3e>;
				status = "okay";
			};

			speaker_amp@40 {
				compatible = "mediatek,speaker_amp";
				phandle = <0x9f>;
				reg = <0x40>;
				status = "okay";
			};
		};
	};

	fragment@47 {
		target = <0xffffffff>;

		__overlay__ {
			#address-cells = <0x01>;
			#size-cells = <0x00>;
			clock-frequency = <0x61a80>;
			mediatek,use-open-drain;
		};
	};

	fragment@48 {
		target = <0xffffffff>;

		__overlay__ {
			#address-cells = <0x01>;
			#size-cells = <0x00>;
			clock-frequency = <0x61a80>;
			mediatek,use-open-drain;

			camera_main_two@40 {
				compatible = "mediatek,camera_main_two";
				phandle = <0xa2>;
				reg = <0x40>;
				status = "okay";
			};

			camera_main_two_af@1e {
				compatible = "mediatek,camera_main_two_af";
				phandle = <0xa4>;
				reg = <0x1e>;
				status = "okay";
			};

			camera_sub_two@6e {
				compatible = "mediatek,camera_sub_two";
				phandle = <0xa3>;
				reg = <0x6e>;
				status = "okay";
			};

			camera_sub_two_af@18 {
				compatible = "mediatek,camera_sub_two_af";
				phandle = <0xa5>;
				reg = <0x18>;
				status = "okay";
			};
		};
	};

	fragment@49 {
		target = <0xffffffff>;

		__overlay__ {
			#address-cells = <0x01>;
			#size-cells = <0x00>;
			clock-frequency = <0x61a80>;
			mediatek,use-open-drain;
		};
	};

	fragment@5 {
		target = <0xffffffff>;

		__overlay__ {

			eintdefault {
				phandle = <0x14>;
			};

			i2cmode_default {
				phandle = <0x19>;

				pins_cmd_dat {
					mediatek,drive-strength-adv = <0x00>;
					pinmux = <0xcc01 0xcd01>;
				};
			};

			int1_active {
				phandle = <0x0f>;

				pins_cmd_dat {
					bias-pull-up = <0x0b>;
					pinmux = <0x1500>;
					slew-rate = <0x00>;
				};
			};

			int1_suspend {
				phandle = <0x11>;

				pins_cmd_dat {
					output-low;
					pinmux = <0x1500>;
					slew-rate = <0x01>;
				};
			};

			int_active {
				phandle = <0x15>;

				pins_cmd_dat {
					bias-pull-up = <0x0b>;
					pinmux = <0x1500>;
					slew-rate = <0x00>;
				};
			};

			int_suspend {
				phandle = <0x17>;

				pins_cmd_dat {
					output-low;
					pinmux = <0x1500>;
					slew-rate = <0x01>;
				};
			};

			pins_default {
				phandle = <0x0e>;
			};

			reset1_active {
				phandle = <0x10>;

				pins_cmd_dat {
					output-high;
					pinmux = <0x1400>;
					slew-rate = <0x01>;
				};
			};

			reset1_suspend {
				phandle = <0x12>;

				pins_cmd_dat {
					output-low;
					pinmux = <0x1400>;
					slew-rate = <0x01>;
				};
			};

			reset_active {
				phandle = <0x16>;

				pins_cmd_dat {
					output-high;
					pinmux = <0x1400>;
					slew-rate = <0x01>;
				};
			};

			reset_suspend {
				phandle = <0x18>;

				pins_cmd_dat {
					output-low;
					pinmux = <0x1400>;
					slew-rate = <0x01>;
				};
			};

			spimode_default {
				phandle = <0x13>;

				pins_cmd_dat {
					drive-strength = <0x02>;
					pinmux = <0x1006 0x1106 0xcc06 0xcd06>;
				};
			};
		};
	};

	fragment@50 {
		target = <0xffffffff>;

		__overlay__ {
			GPIO_FDD_BAND_SUPPORT_DETECT_1ST_PIN = <0xffffffff 0x3f 0x00>;
			GPIO_FDD_BAND_SUPPORT_DETECT_2ND_PIN = <0xffffffff 0x40 0x00>;
			GPIO_FDD_BAND_SUPPORT_DETECT_3RD_PIN = <0xffffffff 0x41 0x00>;
			GPIO_FDD_BAND_SUPPORT_DETECT_4TH_PIN = <0xffffffff 0x42 0x00>;
			GPIO_SIM1_HOT_PLUG = <0xffffffff 0x2b 0x00>;
			GPIO_SIM1_SCLK = <0xffffffff 0x32 0x00>;
			GPIO_SIM1_SIO = <0xffffffff 0x30 0x00>;
			GPIO_SIM1_SRST = <0xffffffff 0x31 0x00>;
			GPIO_SIM2_SCLK = <0xffffffff 0x2d 0x00>;
			GPIO_SIM2_SIO = <0xffffffff 0x2f 0x00>;
			GPIO_SIM2_SRST = <0xffffffff 0x2e 0x00>;
		};
	};

	fragment@51 {
		target = <0xffffffff>;

		__overlay__ {
			gpio_init_default = <0x00 0x00 0x00 0x00 0x01 0x01 0x01 0x01 0x00 0x00 0x00 0x01 0x01 0x00 0x02 0x00 0x00 0x00 0x01 0x00 0x01 0x03 0x00 0x00 0x00 0x01 0x01 0x00 0x04 0x00 0x00 0x00 0x01 0x01 0x01 0x05 0x00 0x00 0x00 0x01 0x00 0x01 0x06 0x00 0x01 0x00 0x01 0x00 0x01 0x07 0x00 0x01 0x00 0x01 0x00 0x01 0x08 0x00 0x01 0x00 0x01 0x00 0x01 0x09 0x00 0x00 0x00 0x01 0x00 0x01 0x0a 0x00 0x01 0x00 0x01 0x00 0x00 0x0b 0x00 0x00 0x00 0x01 0x00 0x00 0x0c 0x00 0x00 0x00 0x01 0x00 0x00 0x0d 0x00 0x00 0x00 0x00 0x00 0x00 0x0e 0x00 0x01 0x01 0x01 0x00 0x00 0x0f 0x00 0x00 0x00 0x01 0x00 0x00 0x10 0x06 0x00 0x00 0x01 0x00 0x01 0x11 0x00 0x01 0x00 0x01 0x00 0x00 0x12 0x01 0x00 0x00 0x01 0x00 0x01 0x13 0x00 0x00 0x00 0x01 0x00 0x01 0x14 0x00 0x01 0x00 0x01 0x00 0x01 0x15 0x00 0x00 0x00 0x01 0x01 0x01 0x16 0x00 0x00 0x00 0x01 0x00 0x01 0x17 0x00 0x00 0x00 0x01 0x01 0x01 0x18 0x00 0x00 0x00 0x01 0x01 0x01 0x19 0x00 0x00 0x00 0x01 0x01 0x01 0x1a 0x00 0x01 0x00 0x01 0x00 0x01 0x1b 0x00 0x01 0x01 0x01 0x00 0x01 0x1c 0x00 0x01 0x01 0x01 0x00 0x00 0x1d 0x00 0x01 0x01 0x01 0x00 0x00 0x1e 0x00 0x01 0x00 0x01 0x00 0x01 0x1f 0x00 0x00 0x00 0x01 0x01 0x01 0x20 0x00 0x01 0x01 0x00 0x00 0x01 0x21 0x00 0x01 0x01 0x00 0x00 0x01 0x22 0x01 0x00 0x00 0x01 0x00 0x01 0x23 0x00 0x01 0x01 0x00 0x00 0x01 0x24 0x01 0x00 0x00 0x00 0x00 0x00 0x25 0x01 0x00 0x00 0x00 0x00 0x00 0x26 0x01 0x00 0x00 0x01 0x01 0x00 0x27 0x01 0x00 0x00 0x00 0x00 0x00 0x28 0x01 0x00 0x00 0x00 0x00 0x01 0x29 0x01 0x00 0x00 0x01 0x00 0x01 0x2a 0x01 0x00 0x00 0x00 0x00 0x00 0x2b 0x01 0x00 0x00 0x01 0x01 0x01 0x2c 0x00 0x00 0x00 0x01 0x00 0x01 0x2d 0x01 0x00 0x00 0x00 0x00 0x01 0x2e 0x01 0x00 0x00 0x00 0x00 0x01 0x2f 0x01 0x00 0x00 0x01 0x01 0x01 0x30 0x01 0x00 0x00 0x01 0x01 0x01 0x31 0x01 0x00 0x00 0x00 0x00 0x01 0x32 0x01 0x00 0x00 0x00 0x00 0x01 0x33 0x01 0x00 0x00 0x00 0x00 0x01 0x34 0x01 0x00 0x00 0x01 0x01 0x01 0x35 0x01 0x00 0x00 0x01 0x01 0x01 0x36 0x01 0x00 0x00 0x01 0x01 0x01 0x37 0x01 0x00 0x00 0x01 0x01 0x01 0x38 0x01 0x00 0x00 0x01 0x01 0x01 0x39 0x01 0x00 0x00 0x00 0x00 0x00 0x3a 0x01 0x00 0x00 0x01 0x00 0x00 0x3b 0x01 0x00 0x00 0x01 0x00 0x01 0x3c 0x01 0x00 0x00 0x01 0x00 0x01 0x3d 0x01 0x00 0x00 0x01 0x00 0x01 0x3e 0x01 0x00 0x00 0x01 0x00 0x01 0x3f 0x00 0x00 0x00 0x01 0x00 0x00 0x40 0x01 0x00 0x00 0x01 0x00 0x00 0x41 0x01 0x00 0x00 0x01 0x00 0x00 0x42 0x00 0x00 0x00 0x01 0x00 0x00 0x43 0x01 0x00 0x00 0x00 0x00 0x00 0x44 0x01 0x00 0x00 0x00 0x00 0x00 0x45 0x01 0x00 0x00 0x00 0x00 0x00 0x46 0x01 0x00 0x00 0x00 0x00 0x00 0x47 0x01 0x00 0x00 0x00 0x00 0x00 0x48 0x01 0x00 0x00 0x00 0x00 0x00 0x49 0x01 0x00 0x00 0x00 0x00 0x00 0x4a 0x01 0x00 0x00 0x00 0x00 0x00 0x4b 0x01 0x00 0x00 0x00 0x00 0x00 0x4c 0x01 0x00 0x00 0x00 0x00 0x00 0x4d 0x01 0x00 0x00 0x00 0x00 0x00 0x4e 0x01 0x00 0x00 0x00 0x00 0x00 0x4f 0x01 0x00 0x00 0x00 0x00 0x00 0x50 0x01 0x00 0x00 0x00 0x00 0x00 0x51 0x01 0x00 0x00 0x00 0x00 0x00 0x52 0x01 0x00 0x00 0x00 0x00 0x00 0x53 0x01 0x00 0x00 0x00 0x00 0x00 0x54 0x01 0x00 0x00 0x00 0x00 0x00 0x55 0x01 0x00 0x00 0x00 0x00 0x00 0x56 0x01 0x00 0x00 0x01 0x00 0x00 0x57 0x01 0x00 0x00 0x00 0x00 0x00 0x58 0x01 0x00 0x00 0x01 0x00 0x00 0x59 0x01 0x00 0x00 0x00 0x00 0x01 0x5a 0x01 0x00 0x00 0x00 0x00 0x01 0x5c 0x01 0x00 0x00 0x01 0x01 0x00 0x5d 0x01 0x00 0x00 0x00 0x00 0x00 0x5e 0x01 0x00 0x00 0x01 0x01 0x00 0x5f 0x01 0x00 0x00 0x00 0x00 0x00 0x60 0x07 0x00 0x00 0x01 0x00 0x00 0x61 0x07 0x00 0x00 0x01 0x00 0x00 0x62 0x07 0x00 0x00 0x01 0x00 0x00 0x63 0x07 0x00 0x00 0x00 0x00 0x00 0x64 0x07 0x00 0x00 0x01 0x00 0x00 0x65 0x07 0x00 0x00 0x01 0x00 0x00 0x66 0x07 0x00 0x00 0x01 0x00 0x00 0x67 0x07 0x00 0x00 0x00 0x00 0x00 0x68 0x07 0x00 0x00 0x01 0x00 0x00 0x69 0x07 0x00 0x00 0x01 0x00 0x00 0x6a 0x07 0x00 0x00 0x01 0x00 0x00 0x6b 0x07 0x00 0x00 0x01 0x00 0x00 0x6c 0x07 0x00 0x00 0x01 0x00 0x00 0x6d 0x07 0x00 0x00 0x01 0x00 0x00 0x6e 0x00 0x01 0x00 0x01 0x00 0x00 0x6f 0x00 0x01 0x00 0x01 0x00 0x00 0x70 0x00 0x01 0x00 0x01 0x00 0x00 0x71 0x00 0x01 0x00 0x01 0x00 0x00 0x72 0x02 0x00 0x00 0x01 0x00 0x00 0x73 0x02 0x00 0x00 0x00 0x00 0x00 0x74 0x02 0x00 0x00 0x00 0x00 0x00 0x75 0x02 0x00 0x00 0x00 0x00 0x00 0x76 0x02 0x00 0x00 0x01 0x01 0x01 0x77 0x02 0x00 0x00 0x01 0x01 0x01 0x78 0x01 0x00 0x00 0x01 0x01 0x01 0x79 0x01 0x00 0x00 0x01 0x01 0x01 0x7a 0x01 0x00 0x00 0x01 0x01 0x01 0x7b 0x01 0x00 0x00 0x01 0x01 0x01 0x7c 0x01 0x00 0x00 0x01 0x01 0x01 0x7d 0x01 0x00 0x00 0x01 0x01 0x01 0x7e 0x00 0x01 0x00 0x01 0x00 0x00 0x7f 0x00 0x01 0x00 0x01 0x00 0x00 0x80 0x00 0x01 0x00 0x01 0x00 0x00 0x81 0x00 0x01 0x00 0x01 0x00 0x00 0x82 0x01 0x00 0x00 0x01 0x00 0x00 0x83 0x01 0x00 0x00 0x00 0x00 0x00 0x84 0x01 0x00 0x00 0x01 0x00 0x00 0x85 0x00 0x01 0x00 0x01 0x00 0x00 0x86 0x00 0x01 0x00 0x01 0x00 0x00 0x87 0x00 0x01 0x00 0x01 0x00 0x00 0x88 0x01 0x00 0x00 0x00 0x00 0x00 0x89 0x00 0x01 0x00 0x01 0x00 0x00 0x8a 0x00 0x00 0x00 0x01 0x00 0x00 0x8b 0x01 0x00 0x00 0x01 0x01 0x01 0x8c 0x01 0x00 0x00 0x01 0x01 0x01 0x8d 0x01 0x00 0x00 0x01 0x01 0x01 0x8e 0x01 0x00 0x00 0x01 0x01 0x01 0x8f 0x00 0x01 0x00 0x01 0x00 0x00 0x90 0x00 0x01 0x00 0x01 0x00 0x00 0x91 0x00 0x01 0x00 0x01 0x00 0x00 0x92 0x00 0x01 0x00 0x01 0x00 0x00 0x93 0x00 0x01 0x00 0x01 0x00 0x00 0x94 0x00 0x01 0x00 0x01 0x00 0x00 0x95 0x01 0x00 0x00 0x00 0x00 0x00 0x96 0x01 0x00 0x00 0x00 0x00 0x00 0x97 0x01 0x00 0x00 0x00 0x00 0x00 0x98 0x00 0x00 0x00 0x01 0x00 0x00 0x99 0x01 0x00 0x00 0x01 0x00 0x00 0x9a 0x01 0x00 0x00 0x01 0x01 0x00 0x9b 0x01 0x00 0x00 0x01 0x01 0x00 0x9c 0x01 0x00 0x00 0x00 0x00 0x00 0x9d 0x01 0x00 0x00 0x00 0x00 0x00 0x9e 0x01 0x00 0x00 0x01 0x00 0x00 0x9f 0x01 0x00 0x00 0x00 0x00 0x00 0xa0 0x01 0x00 0x00 0x01 0x01 0x01 0xa1 0x01 0x00 0x00 0x01 0x01 0x01 0xa2 0x00 0x00 0x00 0x01 0x00 0x00 0xa3 0x00 0x00 0x00 0x01 0x00 0x00 0xa4 0x00 0x00 0x00 0x01 0x00 0x00 0xa5 0x01 0x00 0x00 0x01 0x00 0x00 0xa6 0x01 0x00 0x00 0x01 0x00 0x00 0xa7 0x00 0x00 0x00 0x01 0x00 0x00 0xa8 0x06 0x00 0x00 0x01 0x00 0x00 0xa9 0x06 0x00 0x00 0x01 0x00 0x00 0xaa 0x00 0x01 0x00 0x01 0x00 0x00 0xab 0x00 0x01 0x00 0x01 0x00 0x00 0xac 0x00 0x00 0x00 0x01 0x00 0x00 0xad 0x00 0x00 0x00 0x01 0x00 0x00 0xae 0x00 0x00 0x00 0x01 0x00 0x00 0xaf 0x00 0x00 0x00 0x01 0x00 0x00 0xb0 0x00 0x00 0x00 0x01 0x00 0x00 0xb1 0x00 0x00 0x00 0x01 0x00 0x00 0xb2 0x00 0x00 0x00 0x01 0x00 0x00 0xb3 0x00 0x00 0x00 0x01 0x00 0x00 0xb4 0x00 0x00 0x00 0x01 0x00 0x00 0xb5 0x00 0x00 0x00 0x01 0x00 0x00 0xb6 0x00 0x00 0x00 0x01 0x00 0x00 0xc3 0x01 0x00 0x00 0x00 0x00 0x01 0xc4 0x01 0x00 0x00 0x00 0x00 0x01 0xc5 0x01 0x00 0x00 0x00 0x00 0x01 0xc6 0x01 0x00 0x00 0x00 0x00 0x01 0xc7 0x01 0x00 0x00 0x01 0x00 0x01 0xc8 0x01 0x00 0x00 0x01 0x01 0x01 0xc9 0x01 0x00 0x00 0x01 0x01 0x01 0xca 0x01 0x00 0x00 0x01 0x01 0x01 0xcb 0x01 0x00 0x00 0x01 0x01 0x01 0xcc 0x01 0x00 0x00 0x01 0x01 0x01 0xcd 0x01 0x00 0x00 0x01 0x01 0x01 0xce 0x01 0x00 0x00 0x00 0x00 0x01 0xcf 0x01 0x00 0x00 0x00 0x00 0x01 0xd0 0x01 0x00 0x00 0x00 0x00 0x00 0xd1 0x01 0x00 0x00 0x01 0x00 0x00 0xd2 0x01 0x00 0x00 0x00 0x00 0x00 0xd3 0x01 0x00 0x00 0x01 0x00 0x00 0xd4 0x01 0x00 0x00 0x00 0x00 0x00 0xd5 0x01 0x00 0x00 0x01 0x00 0x01 0xd6 0x01 0x00 0x00 0x00 0x00 0x01 0xd7 0x01 0x00 0x00 0x00 0x00 0x01 0xd8 0x01 0x00 0x00 0x00 0x00 0x01 0xd9 0x01 0x00 0x00 0x00 0x00 0x01 0xda 0x01 0x00 0x00 0x01 0x00 0x01 0xdb 0x01 0x00 0x00 0x01 0x00 0x01 0xdc 0x00 0x00 0x00 0x01 0x00 0x00 0xdd 0x00 0x00 0x00 0x01 0x00 0x00 0xde 0x00 0x00 0x00 0x01 0x00 0x00 0xdf 0x00 0x00 0x00 0x01 0x00 0x00 0xe0 0x00 0x00 0x00 0x01 0x00 0x00 0xe1 0x00 0x00 0x00 0x01 0x00 0x00 0xe2 0x00 0x00 0x00 0x01 0x00 0x00 0xe3 0x00 0x00 0x00 0x01 0x00 0x00>;
		};
	};

	fragment@52 {
		target = <0xffffffff>;

		__overlay__ {
			deb-gpios = <0xffffffff 0x00 0x00>;
			debounce = <0x7d000>;
			interrupt-parent = <0xffffffff>;
			interrupts = <0x00 0x08 0x00 0x00>;
			status = "okay";
		};
	};

	fragment@53 {
		target = <0xffffffff>;

		__overlay__ {
			interrupt-parent = <0xffffffff>;
			interrupts = <0x0d 0x01 0x0d 0x00>;
			status = "okay";
		};
	};

	fragment@54 {
		target = <0xffffffff>;

		__overlay__ {
			interrupt-parent = <0xffffffff>;
			interrupts = <0x15 0x02 0x15 0x00>;
			status = "okay";
		};
	};

	fragment@55 {
		target = <0xffffffff>;

		__overlay__ {
			interrupt-parent = <0xffffffff>;
			interrupts = <0x18 0x02 0x18 0x00>;
			status = "okay";
		};
	};

	fragment@56 {
		target = <0xffffffff>;

		__overlay__ {
			interrupt-parent = <0xffffffff>;
			interrupts = <0x19 0x02 0x19 0x00>;
			status = "okay";
		};
	};

	fragment@57 {
		target = <0xffffffff>;

		__overlay__ {
			interrupt-parent = <0xffffffff>;
			interrupts = <0x1f 0x08 0x1f 0x00>;
			status = "okay";
		};
	};

	fragment@58 {
		target = <0xffffffff>;

		__overlay__ {
			compatible = "mediatek,md1_sim1_hot_plug_eint-eint";
			debounce = <0x00 0xc350>;
			dedicated = <0x00 0x00>;
			interrupts = <0x00 0x08>;
			sockettype = <0x00 0x00>;
			src_pin = <0x00 0x01>;
			status = "okay";
		};
	};

	fragment@59 {
		target = <0xffffffff>;

		__overlay__ {
			regulator-default-on = <0x01>;
			regulator-name = "vcamio";
			status = "okay";
		};
	};

	fragment@6 {
		target = <0xffffffff>;

		__overlay__ {

			focaltech@38 {
				avdd-supply = <0xffffffff>;
				compatible = "focaltech,focal";
				focaltech,avdd-load = <0x30d40>;
				focaltech,display-coords = <0x00 0x00 0x438 0x960>;
				focaltech,irq-gpio = <0xffffffff 0x15 0x00>;
				focaltech,lockdown-info-addr = <0x1e000>;
				focaltech,max-touch-number = <0x0a>;
				focaltech,open-min = <0xa8c>;
				focaltech,reset-gpio = <0xffffffff 0x14 0x00>;
				focaltech,reset-when-resume;
				interrupt-parent = <0xffffffff>;
				interrupts = <0x15 0x02 0x15 0x00>;
				pinctrl-0 = <0x1a 0x1b>;
				pinctrl-1 = <0x1c 0x1d>;
				pinctrl-names = "pmx_tp_active\0pmx_tp_suspend";
				reg = <0x38>;
				status = "ok";
			};
		};
	};

	fragment@60 {
		target = <0xffffffff>;

		__overlay__ {
			regulator-default-on = <0x01>;
			regulator-name = "vtp";
			status = "okay";
		};
	};

	fragment@61 {
		target = <0xffffffff>;

		__overlay__ {
			status = "okay";
			vcamaf-supply = <0xffffffff>;
			vcamaf_sub-supply = <0xffffffff>;
		};
	};

	fragment@62 {
		target = <0xffffffff>;

		__overlay__ {
			status = "okay";
			vtouch-supply = <0xffffffff>;
		};
	};

	fragment@63 {
		target = <0xffffffff>;

		__overlay__ {
			mediatek,kpd-hw-factory-key = <0x01>;
			mediatek,kpd-hw-init-map = <0x73 0x72 0x00 0x00 0x00 0x00 0x00 0x00 0x00 0x00 0x00 0x00 0x00 0x00 0x00 0x00 0x00 0x00 0x00 0x00 0x00 0x00 0x00 0x00 0x00 0x00 0x00 0x00 0x00 0x00 0x00 0x00 0x00 0x00 0x00 0x00 0x00 0x00 0x00 0x00 0x00 0x00 0x00 0x00 0x00 0x00 0x00 0x00 0x00 0x00 0x00 0x00 0x00 0x00 0x00 0x00 0x00 0x00 0x00 0x00 0x00 0x00 0x00 0x00 0x00 0x00 0x00 0x00 0x00 0x00 0x00 0x00>;
			mediatek,kpd-hw-map-num = <0x48>;
			mediatek,kpd-hw-pwrkey = <0x08>;
			mediatek,kpd-hw-recovery-key = <0x00>;
			mediatek,kpd-key-debounce = <0x400>;
			mediatek,kpd-pwkey-gpio-din = <0x00>;
			mediatek,kpd-pwrkey-eint-gpio = <0x00>;
			mediatek,kpd-sw-pwrkey = <0x74>;
			mediatek,kpd-use-extend-type = <0x00>;
			status = "okay";
		};
	};

	fragment@64 {
		target = <0xffffffff>;

		__overlay__ {
			ac_charger_current = <0x16e360>;
			ac_charger_input_current = <0x16e360>;
			charging_host_charger_current = <0x16e360>;
			max_charger_voltage = <0xdd40a0>;
			non_std_ac_charger_current = <0xf4240>;
			pd_charger_current = <0x16e360>;
			ta_ac_charger_current = <0x16e360>;
			usb_charger_current = <0x7a120>;
		};
	};

	fragment@65 {
		target = <0xffffffff>;

		__overlay__ {
			ac_charger_current = <0x1e8480>;
			ac_charger_input_current = <0x16e360>;
			algorithm_name = "SwitchCharging2";
			battery_cv = <0x440de0>;
			bc12_charger = <0x01>;
			charging_host_charger_current = <0x16e360>;
			current_a = <0x5265c0>;
			current_b = <0x35f480>;
			current_max = <0x5b8d80>;
			enable_cv_step;
			enable_ffc;
			enable_min_charge_temp;
			enable_sw_jeita;
			enable_vote;
			ffc_cv = "\0D\\";
			ffc_ieoc = <0x86470>;
			jeita_temp_above_t4_cv = <0x3e8fa0>;
			jeita_temp_below_t0_cv = <0x43e6d0>;
			jeita_temp_t0_to_t1_cv = <0x43e6d0>;
			jeita_temp_t1_to_t1p5_cv = <0x43e6d0>;
			jeita_temp_t1p5_to_t2_cv = <0x43e6d0>;
			jeita_temp_t2_to_t3_cv = <0x43e6d0>;
			jeita_temp_t3_to_t4_cv = <0x3e8fa0>;
			jeita_temp_tn1_to_t0_cv = <0x43e6d0>;
			max_charge_temp = <0x3c>;
			max_charge_temp_minus_x_degree = <0x3a>;
			max_charger_voltage = <0xdd40a0>;
			mi,fcc-batt-unverify-ua = <0x1e8480>;
			min_charge_temp = <0x00>;
			min_charge_temp_plus_x_degree = <0x02>;
			non_ffc_cv = <0x43e6d0>;
			non_ffc_ieoc = <0x30d40>;
			non_std_ac_charger_current = <0xf4240>;
			pd_vbus_upper_bound = <0x895440>;
			qcom,soc_decimal_rate = <0x00 0x26 0x0a 0x23 0x14 0x21 0x1e 0x21 0x28 0x21 0x32 0x21 0x3c 0x21 0x46 0x21 0x50 0x19 0x5a 0x14 0x5f 0x0a 0x63 0x05>;
			qcom,thermal-mitigation-dcp = <0x186a00 0x186a00 0x186a00 0x186a00 0x186a00 0x186a00 0x186a00 0x186a00 0x186a00 0x186a00 0x186a00 0x186a00 0x16e360 0x155cc0 0x124f80 0xf4240>;
			qcom,thermal-mitigation-pd-base = <0x5b8d80 0x4f5880 0x4c4b40 0x432380 0x3e8fa0 0x3d0900 0x3567e0 0x2f4d60 0x2dc6c0 0x2ab980 0x27ac40 0x249f00 0x2191c0 0x1e8480 0xf4240 0xaae60>;
			qcom,thermal-mitigation-qc2 = <0x16e360 0x16e360 0x16e360 0x16e360 0x16e360 0x16e360 0x155cc0 0x13d620 0x124f80 0x10c8e0 0xf4240 0xdbba0 0xc3500 0xaae60 0x927c0 0x7a120>;
			qcom,thermal-mitigation-qc3 = <0x36ee80 0x36ee80 0x36ee80 0x3567e0 0x33e140 0x325aa0 0x30d400 0x2f4d60 0x2dc6c0 0x2ab980 0x27ac40 0x249f00 0x2191c0 0x1e8480 0xf4240 0xaae60>;
			qcom,thermal-mitigation-qc3-classb = <0x4dd1e0 0x47b760 0x419ce0 0x3d0900 0x36ee80 0x3567e0 0x33e140 0x33e140 0x33e140 0x30d400 0x2625a0 0x2191c0 0x1e8480 0x13d620 0xf4240 0xaae60>;
			qcom,thermal-mitigation-qc3p5 = <0x44aa20 0x401640 0x3d0900 0x39fbc0 0x36ee80 0x33e140 0x30d400 0x2f4d60 0x2dc6c0 0x2ab980 0x27ac40 0x249f00 0x2191c0 0x1e8480 0xf4240 0xaae60>;
			step_a = <0x40d990>;
			step_b = <0x43e6d0>;
			step_hy_down_a = <0x249f0>;
			step_hy_down_b = <0x249f0>;
			temp_neg_10_thres = <0xfffffff6>;
			temp_t0_thres = <0x00>;
			temp_t0_thres_plus_x_degree = <0xfffffffe>;
			temp_t0_to_t1_fcc = <0xd7d20>;
			temp_t1_thres = <0x05>;
			temp_t1_thres_plus_x_degree = <0x02>;
			temp_t1_to_t1p5_fcc = <0x21b8d0>;
			temp_t1p5_thres = <0x0a>;
			temp_t1p5_thres_plus_x_degree = <0x08>;
			temp_t1p5_to_t2_fcc = <0x35f480>;
			temp_t2_thres = <0x0f>;
			temp_t2_thres_plus_x_degree = <0x0d>;
			temp_t2_to_t3_fcc = <0x5b8d80>;
			temp_t3_thres = <0x30>;
			temp_t3_thres_minus_x_degree = <0x2f>;
			temp_t3_to_t4_fcc = <0x21b8d0>;
			temp_t4_thres = <0x3c>;
			temp_t4_thres_minus_x_degree = <0x3a>;
			temp_tn1_thres = <0xfffffff6>;
			temp_tn1_thres_plus_x_degree = <0xfffffff6>;
			temp_tn1_to_t0_fcc = <0x6be90>;
			use_xmusb350_do_apsd;
			xm_pps_dual_charger_chg1_current = <0x7a120>;
			xm_pps_dual_charger_chg2_current = <0x2625a0>;
			xm_pps_dual_charger_input_current = <0x2dc6c0>;
			xm_pps_max_ibus = <0x2dc6c0>;
			xm_pps_max_vbus = <0xb71b00>;
			xm_pps_single_charger_current = <0x5b8d80>;
			xm_pps_single_charger_current_non_verified_pps = "\0I>";
			xm_pps_single_charger_input_current = <0x2dc6c0>;
		};
	};

	fragment@66 {
		target = <0xffffffff>;

		__overlay__ {

			chg {
				cv = <0x440de0>;
				ieoc = <0x30d40>;
				ircmp_resistor = <0x61a8>;
				ircmp_vclamp = <0x7d00>;
			};
		};
	};

	fragment@67 {
		target = <0xffffffff>;

		__overlay__ {

			simtray {
				compatible = "xiaomi,simtray-status";
				status-gpio = <0xffffffff 0x2b 0x00>;
			};
		};
	};

	fragment@68 {
		target = <0xffffffff>;

		__overlay__ {

			bq2597x_int_default {
				phandle = <0x7d>;

				pins_cmd_dat {
					bias-pull-up = <0x0b>;
					pinmux = <0x300>;
					slew-rate = <0x00>;
				};
			};

			bq2597x_int_suspend {
				phandle = <0x7e>;

				pins_cmd_dat {
					bias-pull-up = <0x0b>;
					pinmux = <0x300>;
					slew-rate = <0x00>;
				};
			};

			xmusb350_int_isp {
				phandle = <0xa7>;

				pins_cmd_dat {
					bias-pull-up = <0x0b>;
					input-enable;
					pinmux = <0x100>;
					slew-rate = <0x00>;
				};
			};

			xmusb350_int_normal {
				phandle = <0xa6>;

				pins_cmd_dat {
					bias-pull-up = <0x0b>;
					input-enable;
					pinmux = <0x100>;
					slew-rate = <0x00>;
				};
			};

			xmusb350_rst_isp {
				phandle = <0x82>;

				pins_cmd_dat {
					bias-disable;
					output-low;
					pinmux = <0x7e00>;
					slew-rate = <0x01>;
				};
			};

			xmusb350_rst_normal {
				phandle = <0x7f>;

				pins_cmd_dat {
					bias-disable;
					output-low;
					pinmux = <0x7e00>;
					slew-rate = <0x01>;
				};
			};

			xmusb350_scl_isp {
				phandle = <0x84>;

				pins_cmd_dat {
					bias-disable;
					output-low;
					pinmux = <0x7800>;
					slew-rate = <0x01>;
				};
			};

			xmusb350_scl_normal {
				phandle = <0x81>;

				pins_cmd_dat {
					bias-pull-up = <0x0b>;
					input-enable;
					pinmux = <0x7801>;
					slew-rate = <0x00>;
				};
			};

			xmusb350_sda_isp {
				phandle = <0x83>;

				pins_cmd_dat {
					bias-disable;
					output-low;
					pinmux = <0x7900>;
					slew-rate = <0x01>;
				};
			};

			xmusb350_sda_normal {
				phandle = <0x80>;

				pins_cmd_dat {
					bias-pull-up = <0x0b>;
					input-enable;
					pinmux = <0x7901>;
					slew-rate = <0x00>;
				};
			};
		};
	};

	fragment@69 {
		target = <0xffffffff>;

		__overlay__ {
			clock-frequency = <0x186a0>;

			bq2597x-standalone@66 {
				compatible = "ti,bq2597x-standalone";
				interrupt-parent = <0xffffffff>;
				interrupts = <0x03 0x02 0x03 0x00>;
				pinctrl-0 = <0x7d 0x7e>;
				pinctrl-names = "default";
				reg = <0x66>;
				sc8551,ac-ovp-threshold = <0x0d>;
				ti,bq2597x,ac-ovp-threshold = <0x0e>;
				ti,bq2597x,bat-ocp-alarm-threshold = <0x1770>;
				ti,bq2597x,bat-ocp-threshold = <0x1b58>;
				ti,bq2597x,bat-ovp-alarm-disable;
				ti,bq2597x,bat-ovp-alarm-threshold = <0x118a>;
				ti,bq2597x,bat-ovp-threshold = <0x11ad>;
				ti,bq2597x,bat-therm-disable;
				ti,bq2597x,bat-therm-threshold = <0x15>;
				ti,bq2597x,bat-ucp-alarm-disable;
				ti,bq2597x,bat-ucp-disable;
				ti,bq2597x,bus-ocp-alarm-threshold = <0xdac>;
				ti,bq2597x,bus-ocp-threshold = <0xea6>;
				ti,bq2597x,bus-ovp-alarm-threshold = <0x2af8>;
				ti,bq2597x,bus-ovp-threshold = <0x2ee0>;
				ti,bq2597x,bus-therm-disable;
				ti,bq2597x,bus-therm-threshold = <0x15>;
				ti,bq2597x,die-therm-disable;
				ti,bq2597x,die-therm-threshold = <0x91>;
				ti,bq2597x,sense-resistor-mohm = <0x05>;
			};

			xmusb350-charger@35 {
				alias_name = "xmusb350";
				charger_name = "secondary_chg";
				compatible = "xm,xmusb350-charger";
				en_bc12;
				en_hvdcp;
				en_intb;
				en_sleep;
				interrupt-parent = <0xffffffff>;
				interrupts = <0x01 0x02 0x01 0x00>;
				mi,connect_therm = <0xffffffff 0x7f 0x00>;
				pinctrl-0 = <0x7f 0x80 0x81>;
				pinctrl-1 = <0x82 0x83 0x84>;
				pinctrl-names = "xmusb350_normal\0xmusb350_isp";
				reg = <0x35>;
				xm,xmusb350_rst_gpio = <0xffffffff 0x7e 0x00>;
				xm,xmusb350_scl_gpio = <0xffffffff 0x78 0x00>;
				xm,xmusb350_sda_gpio = <0xffffffff 0x79 0x00>;
			};
		};
	};

	fragment@7 {
		target = <0xffffffff>;

		__overlay__ {

			tp_int_active {
				phandle = <0x1a>;

				pins_cmd_dat {
					bias-pull-up = <0x0b>;
					pinmux = <0x1500>;
					slew-rate = <0x00>;
				};
			};

			tp_int_suspend {
				phandle = <0x1c>;

				pins_cmd_dat {
					input-enable;
					pinmux = <0x1500>;
					slew-rate = <0x01>;
				};
			};

			tp_reset_active {
				phandle = <0x1b>;

				pins_cmd_dat {
					bias-pull-up;
					drive-strength = <0x02>;
					pinmux = <0x1400>;
					slew-rate = <0x01>;
				};
			};

			tp_reset_suspend {
				phandle = <0x1d>;

				pins_cmd_dat {
					bias-disable;
					pinmux = <0x1400>;
					slew-rate = <0x01>;
				};
			};
		};
	};

	fragment@70 {
		target = <0xffffffff>;

		__overlay__ {
			compatible = "xiaomi,cp-qc30";
			mi,qc3-27w-bat-curr-max = <0x1518>;
			mi,qc3-27w-bus-curr-max = <0xa8c>;
			mi,qc3-bat-curr-max = <0xe10>;
			mi,qc3-bat-volt-max = <0x1180>;
			mi,qc3-bus-curr-max = <0x834>;
			mi,qc3-bus-volt-max = <0x2ee0>;
			mi,qc3-non-ffc-bat-volt-max = <0x1162>;
			mi,qc3p-bat-curr-max = <0x1194>;
			mi,qc3p-bus-curr-max = <0x8fc>;
			status = "okay";
		};
	};

	fragment@71 {
		target = <0xffffffff>;

		__overlay__ {
			compatible = "xiaomi,usbpd-pm";
			mi,pd-bat-curr-max = <0x1770>;
			mi,pd-bat-volt-max = <0x1180>;
			mi,pd-bus-curr-max = <0xbb8>;
			mi,pd-bus-volt-max = <0x2ee0>;
			mi,pd-non-ffc-bat-volt-max = <0x1162>;
			status = "okay";
		};
	};

	fragment@72 {
		target = <0xffffffff>;

		__overlay__ {

			onewire_gpio_active@gpio28 {
				phandle = <0x85>;

				pins_cmd_dat {
					bias-disable;
					drive-strength = <0x04>;
					output-high;
					pinmux = <0x1c00>;
					slew-rate = <0x01>;
				};
			};

			onewire_gpio_sleep@gpio28 {
				phandle = <0x86>;

				pins_cmd_dat {
					bias-disable;
					drive-strength = <0x04>;
					output-high;
					pinmux = <0x1c00>;
					slew-rate = <0x01>;
				};
			};
		};
	};

	fragment@73 {
		target = <0xffffffff>;

		__overlay__ {
			compatible = "xiaomi,onewire_gpio";
			label = "xm_onewire";
			mi,onewire-gpio-din-addr = <0x10005200>;
			mi,onewire-gpio-dir-addr = <0x10005000>;
			mi,onewire-gpio-dir-clr-addr = <0x10005008>;
			mi,onewire-gpio-dir-set-addr = <0x10005004>;
			mi,onewire-gpio-dout-addr = <0x10005100>;
			mi,onewire-gpio-dout-clr-addr = <0x10005108>;
			mi,onewire-gpio-dout-set-addr = <0x10005104>;
			pinctrl-0 = <0x85>;
			pinctrl-1 = <0x86>;
			pinctrl-names = "onewire_active\0onewire_sleep";
			status = "ok";
			xiaomi,gpio_number = <0x1c>;
			xiaomi,ow_gpio = <0xffffffff 0x1c 0x00>;
			xiaomi,version = <0x01>;
		};
	};

	fragment@74 {
		target = <0xffffffff>;

		__overlay__ {
			compatible = "maxim,ds28e16";
			label = "max_ds28e16";
			maxim,version = <0x01>;
			status = "ok";
		};
	};

	fragment@75 {
		target = <0xffffffff>;

		__overlay__ {
			compatible = "xiaomi-touch";
			status = "ok";
			touch,name = "xiaomi-touch";
		};
	};

	fragment@76 {
		target = <0xffffffff>;

		__overlay__ {
			mi,non-mtk-pps-ctrl;
		};
	};

	fragment@77 {
		target = <0xffffffff>;

		__overlay__ {
			board-sensor = "VIRTUAL-SENSOR";
		};
	};

	fragment@78 {
		target = <0xffffffff>;

		__overlay__ {

			usb_phy_tuning {
				compatible = "mediatek,phy_tuning";
				u2_discth = <0x07>;
				u2_enhance = <0x01>;
				u2_intr_cal = <0x1e>;
				u2_term_ref = <0x02>;
				u2_vrt_ref = <0x02>;
			};
		};
	};

	fragment@79 {
		target = <0xffffffff>;

		__overlay__ {
			battery0_profile_t0 = <0x00 0xac44 0x370 0x1c8 0xabc3 0x36c 0x391 0xab47 0x36b 0x559 0xaad3 0x36b 0x721 0xaa68 0x36b 0x8ea 0xa9f6 0x36b 0xab2 0xa983 0x36b 0xc7b 0xa915 0x373 0xe43 0xa8a9 0x384 0x100b 0xa837 0x384 0x11d4 0xa7bf 0x384 0x139c 0xa745 0x384 0x1564 0xa6cd 0x387 0x172d 0xa65b 0x39a 0x18f5 0xa5e2 0x39d 0x1abd 0xa568 0x3c2 0x1c86 0xa4ee 0x3fc 0x1e4e 0xa474 0x3b0 0x2017 0xa400 0x39d 0x21df 0xa38a 0x39d 0x23a7 0xa311 0x39d 0x2570 0xa297 0x39d 0x2738 0xa224 0x39d 0x2900 0xa1b1 0x39d 0x2ac9 0xa141 0x3a0 0x2c91 0xa0d6 0x3b3 0x2e59 0xa065 0x3b6 0x3022 0x9ff7 0x3b6 0x31ea 0x9f8d 0x3b6 0x33b3 0x9f22 0x3b6 0x357b 0x9eb8 0x3b6 0x3743 0x9e52 0x3c2 0x390c 0x9def 0x3cf 0x3ad4 0x9d8c 0x3cf 0x3c9c 0x9d31 0x3e2 0x3e65 0x9cd0 0x3e8 0x402d 0x9c70 0x3ef 0x41f5 0x9c15 0x402 0x43be 0x9bba 0x415 0x4586 0x9b5e 0x435 0x474f 0x9afa 0x44c 0x4917 0x9a83 0x443 0x4adf 0x99e1 0x3e3 0x4ca8 0x9959 0x3b1 0x4e70 0x98ea 0x39d 0x5038 0x9890 0x39a 0x5201 0x983c 0x387 0x53c9 0x97f6 0x384 0x5591 0x97b5 0x38e 0x575a 0x9778 0x39d 0x5922 0x973c 0x39d 0x5aeb 0x96ff 0x38c 0x5cb3 0x96c6 0x38f 0x5e7b 0x968f 0x398 0x6044 0x9652 0x385 0x620c 0x9624 0x384 0x63d4 0x95f6 0x390 0x659d 0x95c9 0x39d 0x6765 0x959b 0x39d 0x692d 0x956d 0x39d 0x6af6 0x9540 0x39d 0x6cbe 0x9518 0x3ac 0x6e87 0x94f9 0x3cf 0x704f 0x94d3 0x3cf 0x7217 0x94ad 0x3cf 0x73e0 0x9487 0x3cf 0x75a8 0x9460 0x3d2 0x7770 0x9432 0x3e5 0x7939 0x93ec 0x3c9 0x7b01 0x939c 0x3a3 0x7cc9 0x934d 0x388 0x7e92 0x9310 0x39b 0x805a 0x92e0 0x3ae 0x8223 0x92ae 0x3ab 0x83eb 0x9277 0x398 0x85b3 0x923a 0x385 0x877c 0x9213 0x396 0x8944 0x91e8 0x3a9 0x8b0c 0x91ba 0x3bc 0x8cd5 0x918d 0x3cf 0x8e9d 0x9149 0x3cf 0x9065 0x9104 0x3c2 0x922e 0x90c0 0x3b6 0x93f6 0x907b 0x3b4 0x95bf 0x902f 0x38e 0x9787 0x8ff9 0x376 0x994f 0x8fd8 0x37b 0x9b18 0x8fc9 0x3a4 0x9ce0 0x8fc2 0x3f0 0x9ea8 0x8fae 0x44b 0xa071 0x8f82 0x499 0xa239 0x8f1a 0x4b2 0xa401 0x8dea 0x41a 0xa5ca 0x8c21 0x421 0xa792 0x89cf 0x447 0xa95b 0x86c1 0x481 0xab23 0x825b 0x506 0xaceb 0x77f6 0xe7b 0xaeb4 0x6fd6 0x6a4 0xb07c 0x6fd6 0x6a4>;
			battery0_profile_t0_col = <0x03>;
			battery0_profile_t0_num = <0x64>;
			battery0_profile_t1 = <0x00 0xac8a 0x438 0x1c8 0xac18 0x434 0x391 0xabab 0x433 0x559 0xab41 0x433 0x721 0xaad6 0x433 0x8ea 0xaa74 0x433 0xab2 0xaa0b 0x433 0xc7b 0xa9a1 0x43b 0xe43 0xa935 0x44c 0x100b 0xa8c3 0x44c 0x11d4 0xa851 0x44c 0x139c 0xa7db 0x443 0x1564 0xa762 0x433 0x172d 0xa6e8 0x433 0x18f5 0xa675 0x443 0x1abd 0xa5fe 0x483 0x1c86 0xa584 0x4da 0x1e4e 0xa50a 0x468 0x2017 0xa490 0x44c 0x21df 0xa416 0x44c 0x23a7 0xa39e 0x44c 0x2570 0xa32c 0x44c 0x2738 0xa2b3 0x44c 0x2900 0xa23d 0x44c 0x2ac9 0xa1cb 0x44f 0x2c91 0xa159 0x462 0x2e59 0xa0e7 0x465 0x3022 0xa079 0x46f 0x31ea 0xa00f 0x47e 0x33b3 0x9fa4 0x47e 0x357b 0x9f3a 0x490 0x3743 0x9ecf 0x497 0x390c 0x9e67 0x49d 0x3ad4 0x9e04 0x4b0 0x3c9c 0x9da1 0x4c3 0x3e65 0x9d43 0x4e2 0x402d 0x9ce6 0x4fb 0x41f5 0x9c83 0x4fc 0x43be 0x9c28 0x522 0x4586 0x9bc7 0x53b 0x474f 0x9b61 0x546 0x4917 0x9af4 0x541 0x4adf 0x9a71 0x507 0x4ca8 0x99dd 0x4af 0x4e70 0x9957 0x46c 0x5038 0x98e9 0x449 0x5201 0x988d 0x436 0x53c9 0x9839 0x423 0x5591 0x97ed 0x41a 0x575a 0x97aa 0x41e 0x5922 0x976e 0x431 0x5aeb 0x9731 0x433 0x5cb3 0x96f4 0x428 0x5e7b 0x96b9 0x41a 0x6044 0x9684 0x41a 0x620c 0x964f 0x41a 0x63d4 0x9623 0x426 0x659d 0x95f8 0x433 0x6765 0x95c3 0x433 0x692d 0x959d 0x446 0x6af6 0x9572 0x44c 0x6cbe 0x9547 0x44c 0x6e87 0x9521 0x44d 0x704f 0x94fb 0x460 0x7217 0x94db 0x473 0x73e0 0x94b9 0x47e 0x75a8 0x9494 0x481 0x7770 0x9476 0x494 0x7939 0x9451 0x497 0x7b01 0x9427 0x48d 0x7cc9 0x93f9 0x47a 0x7e92 0x93cc 0x467 0x805a 0x9398 0x454 0x8223 0x9362 0x441 0x83eb 0x932f 0x438 0x85b3 0x9301 0x44b 0x877c 0x92cd 0x43a 0x8944 0x92a1 0x433 0x8b0c 0x927b 0x439 0x8cd5 0x9255 0x44c 0x8e9d 0x9220 0x44c 0x9065 0x91e5 0x44c 0x922e 0x91a5 0x445 0x93f6 0x9160 0x434 0x95bf 0x9123 0x447 0x9787 0x90d0 0x430 0x994f 0x9088 0x412 0x9b18 0x905f 0x405 0x9ce0 0x9058 0x42c 0x9ea8 0x904a 0x442 0xa071 0x903b 0x471 0xa239 0x9025 0x4bd 0xa401 0x8ff0 0x509 0xa5ca 0x8f17 0x4c2 0xa792 0x8da3 0x4a1 0xa95b 0x8b97 0x4c1 0xab23 0x88f2 0x50d 0xaceb 0x84cf 0x5b0 0xaeb4 0x7c48 0xca3 0xb07c 0x7256 0xccb>;
			battery0_profile_t1_col = <0x03>;
			battery0_profile_t1_num = <0x64>;
			battery0_profile_t2 = <0x00 0xaca8 0x640 0x1c8 0xac36 0x640 0x391 0xabc9 0x640 0x559 0xab5f 0x639 0x721 0xaaf4 0x628 0x8ea 0xaa92 0x63b 0xab2 0xaa2f 0x640 0xc7b 0xa9c5 0x638 0xe43 0xa954 0x629 0x100b 0xa8ea 0x63c 0x11d4 0xa879 0x640 0x139c 0xa803 0x637 0x1564 0xa78a 0x627 0x172d 0xa710 0x627 0x18f5 0xa696 0x627 0x1abd 0xa61c 0x670 0x1c86 0xa5a2 0x6e4 0x1e4e 0xa528 0x64c 0x2017 0xa4ae 0x627 0x21df 0xa438 0x62f 0x23a7 0xa3c5 0x63e 0x2570 0xa34b 0x62b 0x2738 0xa2d1 0x627 0x2900 0xa25b 0x630 0x2ac9 0xa1e9 0x640 0x2c91 0xa177 0x640 0x2e59 0xa105 0x650 0x3022 0xa097 0x663 0x31ea 0xa02b 0x672 0x33b3 0x9fb9 0x672 0x357b 0x9f55 0x684 0x3743 0x9eed 0x697 0x390c 0x9e85 0x6af 0x3ad4 0x9e22 0x6d5 0x3c9c 0x9db8 0x6e9 0x3e65 0x9d52 0x708 0x402d 0x9cf0 0x728 0x41f5 0x9c8d 0x73a 0x43be 0x9c2a 0x73a 0x4586 0x9bc7 0x73a 0x474f 0x9b5b 0x72b 0x4917 0x9ae0 0x701 0x4adf 0x9a54 0x6b4 0x4ca8 0x99cb 0x667 0x4e70 0x994d 0x625 0x5038 0x98df 0x5f5 0x5201 0x9883 0x5f5 0x53c9 0x982f 0x5d5 0x5591 0x97e3 0x5c3 0x575a 0x979f 0x5c3 0x5922 0x975a 0x5c3 0x5aeb 0x971d 0x5c3 0x5cb3 0x96e0 0x5c3 0x5e7b 0x96a5 0x5c3 0x6044 0x9670 0x5c3 0x620c 0x963b 0x5c3 0x63d4 0x960a 0x5cf 0x659d 0x95da 0x5d6 0x6765 0x95a5 0x5c4 0x692d 0x957f 0x5ea 0x6af6 0x9554 0x5f5 0x6cbe 0x9529 0x5f5 0x6e87 0x9503 0x5f6 0x704f 0x94dd 0x609 0x7217 0x94bd 0x61c 0x73e0 0x949b 0x627 0x75a8 0x9476 0x627 0x7770 0x9458 0x627 0x7939 0x9433 0x627 0x7b01 0x9411 0x627 0x7cc9 0x93f2 0x62b 0x7e92 0x93d4 0x63e 0x805a 0x93af 0x62f 0x8223 0x9385 0x61c 0x83eb 0x9355 0x605 0x85b3 0x9320 0x5df 0x877c 0x92f2 0x5dc 0x8944 0x92c9 0x5e8 0x8b0c 0x92a3 0x5f5 0x8cd5 0x927d 0x5f5 0x8e9d 0x9248 0x608 0x9065 0x9208 0x60e 0x922e 0x91c6 0x615 0x93f6 0x9188 0x628 0x95bf 0x914b 0x63b 0x9787 0x90f8 0x640 0x994f 0x90ad 0x648 0x9b18 0x907b 0x65b 0x9ce0 0x9065 0x66e 0x9ea8 0x9054 0x691 0xa071 0x9041 0x6c9 0xa239 0x9026 0x715 0xa401 0x8ff8 0x761 0xa5ca 0x8f2e 0x78d 0xa792 0x8dbd 0x7bd 0xa95b 0x8ba9 0x810 0xab23 0x88fd 0x8bb 0xaceb 0x84cb 0xa37 0xaeb4 0x7c47 0x11ae 0xb07c 0x709e 0x8ca>;
			battery0_profile_t2_col = <0x03>;
			battery0_profile_t2_num = <0x64>;
			battery0_profile_t3 = <0x00 0xacb2 0x97e 0x1c8 0xac31 0x97a 0x391 0xabbf 0x986 0x559 0xab57 0x999 0x721 0xaaf4 0x9aa 0x8ea 0xaa8a 0x997 0xab2 0xaa1f 0x992 0xc7b 0xa9b5 0x992 0xe43 0xa949 0x990 0x100b 0xa8d7 0x97d 0x11d4 0xa865 0x979 0x139c 0xa7f3 0x970 0x1564 0xa780 0x960 0x172d 0xa706 0x960 0x18f5 0xa68c 0x950 0x1abd 0xa612 0x9ac 0x1c86 0xa598 0xa4b 0x1e4e 0xa51e 0x97a 0x2017 0xa4a4 0x939 0x21df 0xa42e 0x93f 0x23a7 0xa3bb 0x95e 0x2570 0xa341 0x94b 0x2738 0xa2c7 0x947 0x2900 0xa251 0x947 0x2ac9 0xa1df 0x947 0x2c91 0xa16d 0x947 0x2e59 0xa0fb 0x957 0x3022 0xa08d 0x96a 0x31ea 0xa021 0x979 0x33b3 0x9faf 0x979 0x357b 0x9f4b 0x99c 0x3743 0x9ee8 0x9ce 0x390c 0x9e81 0x9fc 0x3ad4 0x9e0f 0xa0f 0x3c9c 0x9da4 0xa22 0x3e65 0x9d34 0xa28 0x402d 0x9cc8 0xa2f 0x41f5 0x9c64 0xa40 0x43be 0x9bf2 0xa1a 0x4586 0x9b85 0xa01 0x474f 0x9b12 0x9d7 0x4917 0x9a90 0x98b 0x4adf 0x9a0d 0x93e 0x4ca8 0x9991 0x901 0x4e70 0x991f 0x8d1 0x5038 0x98b7 0x8ae 0x5201 0x985b 0x89b 0x53c9 0x9807 0x888 0x5591 0x97bb 0x87f 0x575a 0x9777 0x87b 0x5922 0x9732 0x868 0x5aeb 0x96f5 0x877 0x5cb3 0x96b8 0x87f 0x5e7b 0x967d 0x884 0x6044 0x9648 0x897 0x620c 0x9613 0x898 0x63d4 0x95dd 0x898 0x659d 0x95ab 0x89e 0x6765 0x957d 0x8b1 0x692d 0x954f 0x8b1 0x6af6 0x9527 0x8be 0x6cbe 0x9501 0x8d1 0x6e87 0x94db 0x8e4 0x704f 0x94b5 0x8f7 0x7217 0x948f 0x90a 0x73e0 0x946c 0x915 0x75a8 0x944d 0x915 0x7770 0x9427 0x915 0x7939 0x940d 0x934 0x7b01 0x93f3 0x947 0x7cc9 0x93d6 0x94b 0x7e92 0x93bf 0x95e 0x805a 0x93a8 0x971 0x8223 0x938d 0x979 0x83eb 0x936d 0x97e 0x85b3 0x9347 0x991 0x877c 0x931a 0x992 0x8944 0x92ec 0x99e 0x8b0c 0x92be 0x9bc 0x8cd5 0x9291 0x9f5 0x8e9d 0x925c 0xa2e 0x9065 0x9217 0xa5a 0x922e 0x91d0 0xa95 0x93f6 0x9191 0xaf5 0x95bf 0x9145 0xb41 0x9787 0x90ee 0xb9b 0x994f 0x90a0 0xbfa 0x9b18 0x9066 0xc60 0x9ce0 0x9048 0xcf8 0x9ea8 0x902a 0xd9f 0xa071 0x900f 0xe79 0xa239 0x8ff0 0xf8a 0xa401 0x8fac 0x10ba 0xa5ca 0x8ede 0x122c 0xa792 0x8d61 0x13fb 0xa95b 0x8b32 0x1689 0xab23 0x8860 0x1ab2 0xaceb 0x83ec 0x2438 0xaeb4 0x7d5d 0x2828 0xb07c 0x75e4 0x15ae>;
			battery0_profile_t3_col = <0x03>;
			battery0_profile_t3_num = <0x64>;
			battery0_profile_t4 = <0x00 0xacda 0x1194 0x1c8 0xac3a 0x1194 0x391 0xabaf 0x1194 0x559 0xab34 0x1194 0x721 0xaac2 0x1193 0x8ea 0xaa50 0x1180 0xab2 0xa9e3 0x117b 0xc7b 0xa975 0x1173 0xe43 0xa903 0x115e 0x100b 0xa891 0x1138 0x11d4 0xa81f 0x1121 0x139c 0xa7a9 0x1105 0x1564 0xa731 0x10e5 0x172d 0xa6bf 0x10e5 0x18f5 0xa646 0x10d5 0x1abd 0xa5cc 0x1168 0x1c86 0xa552 0x125c 0x1e4e 0xa4d8 0x10f3 0x2017 0xa464 0x108c 0x21df 0xa3ee 0x1079 0x23a7 0xa376 0x1068 0x2570 0xa304 0x1068 0x2738 0xa292 0x1068 0x2900 0xa21f 0x1071 0x2ac9 0xa1ad 0x1081 0x2c91 0xa13b 0x1081 0x2e59 0xa0c9 0x1081 0x3022 0xa05b 0x108b 0x31ea 0x9ff1 0x109f 0x33b3 0x9f86 0x10b2 0x357b 0x9f1c 0x10d6 0x3743 0x9ead 0x10f1 0x390c 0x9e38 0x10fe 0x3ad4 0x9dbf 0x10fe 0x3c9c 0x9d45 0x10eb 0x3e65 0x9ccb 0x10cc 0x402d 0x9c52 0x10a6 0x41f5 0x9bd8 0x107e 0x43be 0x9b5e 0x101f 0x4586 0x9aea 0xfe9 0x474f 0x9a78 0xfc3 0x4917 0x9a06 0xf9d 0x4adf 0x9992 0xf76 0x4ca8 0x9925 0xf50 0x4e70 0x98c2 0xf33 0x5038 0x9867 0xf20 0x5201 0x980b 0xf0d 0x53c9 0x97bd 0xf1a 0x5591 0x9771 0xf23 0x575a 0x9728 0xf27 0x5922 0x96ec 0xf3a 0x5aeb 0x96af 0xf4d 0x5cb3 0x9672 0xf60 0x5e7b 0x9635 0xf6e 0x6044 0x95f8 0xf6e 0x620c 0x95ca 0xf93 0x63d4 0x9597 0xfac 0x659d 0x9565 0xfc6 0x6765 0x9537 0xfeb 0x692d 0x9509 0xffe 0x6af6 0x94e1 0x1011 0x6cbe 0x94bb 0x102c 0x6e87 0x9496 0x1053 0x704f 0x9477 0x108c 0x7217 0x9459 0x10b7 0x73e0 0x943e 0x10dd 0x75a8 0x9427 0x1103 0x7770 0x9410 0x1129 0x7939 0x93f9 0x115f 0x7b01 0x93e6 0x11a1 0x7cc9 0x93d6 0x11ed 0x7e92 0x93bf 0x1239 0x805a 0x93a8 0x1296 0x8223 0x938d 0x12ea 0x83eb 0x936f 0x1340 0x85b3 0x9350 0x13b2 0x877c 0x9324 0x1412 0x8944 0x92f6 0x1489 0x8b0c 0x92c6 0x1513 0x8cd5 0x9291 0x15ac 0x8e9d 0x9254 0x1656 0x9065 0x920d 0x1702 0x922e 0x91c3 0x17bb 0x93f6 0x917d 0x1892 0x95bf 0x9131 0x1989 0x9787 0x90d4 0x1a72 0x994f 0x907e 0x1b6f 0x9b18 0x903e 0x1c95 0x9ce0 0x9018 0x1dff 0x9ea8 0x8ff1 0x1fa5 0xa071 0x8fcb 0x219b 0xa239 0x8fa4 0x2407 0xa401 0x8f76 0x275f 0xa5ca 0x8ec6 0x2bbc 0xa792 0x8d6c 0x31f6 0xa95b 0x8b69 0x3b38 0xab23 0x88bf 0x4494 0xaceb 0x853d 0x3bf5 0xaeb4 0x8458 0x39d0 0xb07c 0x8458 0x39d0>;
			battery0_profile_t4_col = <0x03>;
			battery0_profile_t4_num = <0x64>;
			battery1_profile_t0 = <0x00 0xac4e 0x370 0x1cf 0xabda 0x36c 0x39e 0xab6c 0x36b 0x56d 0xab03 0x373 0x73d 0xaa9e 0x384 0x90c 0xaa32 0x384 0xadb 0xa9c1 0x384 0xcaa 0xa952 0x384 0xe79 0xa8e4 0x388 0x1048 0xa870 0x39b 0x1217 0xa7f6 0x38b 0x13e6 0xa77f 0x390 0x15b6 0xa709 0x39d 0x1785 0xa68d 0x39d 0x1954 0xa612 0x39d 0x1b23 0xa592 0x3cf 0x1cf2 0xa512 0x3ed 0x1ec1 0xa496 0x3a0 0x2090 0xa41b 0x39d 0x225f 0xa3a5 0x3aa 0x242f 0xa32b 0x3af 0x25fe 0xa2a9 0x39d 0x27cd 0xa237 0x39d 0x299c 0xa1c4 0x3ac 0x2b6b 0xa14d 0x3ad 0x2d3a 0xa0d4 0x3a0 0x2f09 0xa068 0x3b4 0x30d9 0x9ff5 0x3b6 0x32a8 0x9f86 0x3b6 0x3477 0x9f19 0x3bb 0x3646 0x9ead 0x3cf 0x3815 0x9e41 0x3bc 0x39e4 0x9ddb 0x3c3 0x3bb3 0x9d77 0x3d7 0x3d82 0x9d14 0x3e8 0x3f52 0x9cb0 0x3e8 0x4121 0x9c51 0x3f7 0x42f0 0x9bf5 0x40a 0x44bf 0x9b97 0x421 0x468e 0x9b32 0x448 0x485d 0x9ac7 0x45d 0x4a2c 0x9a44 0x437 0x4bfc 0x99af 0x3e9 0x4dcb 0x9915 0x39d 0x4f9a 0x98b2 0x38a 0x5169 0x9859 0x384 0x5338 0x9807 0x37c 0x5507 0x97bc 0x36d 0x56d6 0x977e 0x380 0x58a5 0x973a 0x384 0x5a75 0x96f8 0x384 0x5c44 0x96bc 0x384 0x5e13 0x9686 0x384 0x5fe2 0x9650 0x384 0x61b1 0x961b 0x384 0x6380 0x95e5 0x37e 0x654f 0x95af 0x36b 0x671e 0x9581 0x37f 0x68ee 0x9553 0x384 0x6abd 0x9528 0x38c 0x6c8c 0x9501 0x39d 0x6e5b 0x94db 0x39d 0x702a 0x94b4 0x39d 0x71f9 0x9492 0x3a7 0x73c8 0x9471 0x3b6 0x7598 0x944a 0x3b6 0x7767 0x942b 0x3da 0x7936 0x9403 0x3e8 0x7b05 0x93cb 0x3d5 0x7cd4 0x937d 0x39c 0x7ea3 0x9330 0x389 0x8072 0x92f4 0x384 0x8241 0x92c1 0x38d 0x8411 0x9292 0x39a 0x85e0 0x925c 0x387 0x87af 0x922d 0x384 0x897e 0x91ff 0x38f 0x8b4d 0x91d3 0x3a2 0x8d1c 0x91ac 0x3b5 0x8eeb 0x917e 0x3b6 0x90bb 0x9146 0x3b6 0x928a 0x9105 0x3af 0x9459 0x90c0 0x39f 0x9628 0x9083 0x3c6 0x97f7 0x9039 0x3a3 0x99c6 0x8ff7 0x372 0x9b95 0x8fc7 0x355 0x9d64 0x8fb8 0x369 0x9f34 0x8faf 0x3be 0xa103 0x8fa3 0x41e 0xa2d2 0x8f90 0x47e 0xa4a1 0x8f71 0x4df 0xa670 0x8eb5 0x44d 0xa83f 0x8d54 0x41a 0xaa0e 0x8b5e 0x430 0xabdd 0x88da 0x470 0xadad 0x852c 0x4f7 0xaf7c 0x7df1 0xb00 0xb14b 0x7170 0xabe 0xb31a 0x7170 0xabe>;
			battery1_profile_t0_col = <0x03>;
			battery1_profile_t0_num = <0x64>;
			battery1_profile_t1 = <0x00 0xac9e 0x49c 0x1cf 0xac3a 0x498 0x39e 0xabd5 0x497 0x56d 0xab71 0x497 0x73d 0xab0d 0x495 0x90c 0xaaa8 0x482 0xadb 0xaa45 0x48e 0xcaa 0xa9da 0x48d 0xe79 0xa968 0x482 0x1048 0xa8fc 0x495 0x1217 0xa889 0x497 0x13e6 0xa810 0x48b 0x15b6 0xa795 0x47e 0x1785 0xa719 0x47e 0x1954 0xa69e 0x47e 0x1b23 0xa623 0x4c8 0x1cf2 0xa5a8 0x4f6 0x1ec1 0xa52c 0x482 0x2090 0xa4b1 0x47e 0x225f 0xa435 0x47e 0x242f 0xa3ba 0x47e 0x25fe 0xa33f 0x47e 0x27cd 0xa2c5 0x47e 0x299c 0xa250 0x48d 0x2b6b 0xa1d9 0x497 0x2d3a 0xa15e 0x497 0x2f09 0xa0eb 0x497 0x30d9 0xa07e 0x4a8 0x32a8 0xa00d 0x4b0 0x3477 0x9f9b 0x4b5 0x3646 0x9f2f 0x4c9 0x3815 0x9ec3 0x4dc 0x39e4 0x9e5d 0x4ef 0x3bb3 0x9df6 0x503 0x3d82 0x9d8c 0x516 0x3f52 0x9d28 0x529 0x4121 0x9cc3 0x54b 0x42f0 0x9c5f 0x568 0x44bf 0x9bfb 0x57c 0x468e 0x9b96 0x58f 0x485d 0x9b2b 0x591 0x4a2c 0x9aac 0x563 0x4bfc 0x9a1f 0x510 0x4dcb 0x998d 0x4af 0x4f9a 0x9911 0x476 0x5169 0x98a7 0x457 0x5338 0x984a 0x444 0x5507 0x97f7 0x433 0x56d6 0x97b1 0x433 0x58a5 0x9772 0x443 0x5a75 0x9731 0x442 0x5c44 0x96ee 0x433 0x5e13 0x96b8 0x433 0x5fe2 0x9682 0x445 0x61b1 0x964c 0x440 0x6380 0x9619 0x439 0x654f 0x95eb 0x44c 0x671e 0x95b5 0x438 0x68ee 0x9585 0x441 0x6abd 0x955a 0x44c 0x6c8c 0x9533 0x44e 0x6e5b 0x950d 0x462 0x702a 0x94e6 0x465 0x71f9 0x94c4 0x46f 0x73c8 0x94a3 0x47e 0x7598 0x947c 0x47e 0x7767 0x945d 0x490 0x7936 0x943a 0x48b 0x7b05 0x9416 0x484 0x7cd4 0x93f6 0x496 0x7ea3 0x93c8 0x46f 0x8072 0x939a 0x465 0x8241 0x936b 0x45c 0x8411 0x933d 0x44c 0x85e0 0x930f 0x44c 0x87af 0x92e1 0x43c 0x897e 0x92b2 0x433 0x8b4d 0x9286 0x433 0x8d1c 0x9260 0x433 0x8eeb 0x923a 0x445 0x90bb 0x9209 0x44c 0x928a 0x91d0 0x44c 0x9459 0x9192 0x44c 0x9628 0x9155 0x44c 0x97f7 0x9117 0x45b 0x99c6 0x90ce 0x45c 0x9b95 0x9080 0x44c 0x9d64 0x9052 0x44c 0x9f34 0x903f 0x45d 0xa103 0x9034 0x47b 0xa2d2 0x902a 0x4ab 0xa4a1 0x901b 0x4f8 0xa670 0x8ff5 0x558 0xa83f 0x8f61 0x55e 0xaa0e 0x8e36 0x546 0xabdd 0x8c56 0x54e 0xadad 0x89b6 0x5ae 0xaf7c 0x85db 0x688 0xb14b 0x7f15 0x10e0 0xb31a 0x75da 0x1563>;
			battery1_profile_t1_col = <0x03>;
			battery1_profile_t1_num = <0x64>;
			battery1_profile_t2 = <0x00 0xac9e 0x960 0x1cf 0xac2a 0x960 0x39e 0xabbc 0x960 0x56d 0xab53 0x960 0x73d 0xaaee 0x95e 0x90c 0xaa82 0x94b 0xadb 0xaa1d 0x957 0xcaa 0xa9b6 0x956 0xe79 0xa948 0x943 0x1048 0xa8d4 0x930 0x1217 0xa861 0x92e 0x13e6 0xa7e8 0x922 0x15b6 0xa76d 0x90f 0x1785 0xa6f1 0x8fc 0x1954 0xa676 0x8e8 0x1b23 0xa5fb 0x978 0x1cf2 0xa57e 0x9ce 0x1ec1 0xa4fb 0x8d3 0x2090 0xa47f 0x8ca 0x225f 0xa409 0x8ca 0x242f 0xa392 0x8ca 0x25fe 0xa317 0x8c9 0x27cd 0xa29d 0x8b6 0x299c 0xa228 0x8c0 0x2b6b 0xa1b4 0x8ca 0x2d3a 0xa13f 0x8ca 0x2f09 0xa0c4 0x8ca 0x30d9 0xa056 0x8db 0x32a8 0x9fe5 0x8e3 0x3477 0x9f76 0x8ee 0x3646 0x9f11 0x914 0x3815 0x9ea5 0x928 0x39e4 0x9e39 0x949 0x3bb3 0x9dce 0x968 0x3d82 0x9d63 0x977 0x3f52 0x9cef 0x964 0x4121 0x9c87 0x96f 0x42f0 0x9c1f 0x970 0x44bf 0x9bb3 0x95c 0x468e 0x9b47 0x949 0x485d 0x9ad4 0x924 0x4a2c 0x9a52 0x8e7 0x4bfc 0x99ca 0x894 0x4dcb 0x9947 0x833 0x4f9a 0x98d5 0x7fa 0x5169 0x986c 0x7ce 0x5338 0x9811 0x7b7 0x5507 0x97c4 0x7b7 0x56d6 0x9777 0x7b7 0x58a5 0x9730 0x7a7 0x5a75 0x96ee 0x79e 0x5c44 0x96b2 0x7a2 0x5e13 0x967c 0x7b5 0x5fe2 0x9646 0x7c9 0x61b1 0x9611 0x7d0 0x6380 0x95db 0x7d0 0x654f 0x95a5 0x7d0 0x671e 0x9577 0x7e4 0x68ee 0x9549 0x7e9 0x6abd 0x951e 0x7f1 0x6c8c 0x94f7 0x804 0x6e5b 0x94d1 0x818 0x702a 0x94aa 0x81b 0x71f9 0x9483 0x81b 0x73c8 0x945f 0x820 0x7598 0x9440 0x833 0x7767 0x9421 0x846 0x7936 0x9403 0x84d 0x7b05 0x93e4 0x84d 0x7cd4 0x93c5 0x84e 0x7ea3 0x93ae 0x861 0x8072 0x9397 0x874 0x8241 0x937c 0x888 0x8411 0x935c 0x895 0x85e0 0x9336 0x882 0x87af 0x930f 0x8a0 0x897e 0x92e5 0x8bc 0x8b4d 0x92b9 0x8d8 0x8d1c 0x9292 0x912 0x8eeb 0x9264 0x94c 0x90bb 0x922c 0x979 0x928a 0x91eb 0x9a6 0x9459 0x91a6 0x9e3 0x9628 0x9169 0xa43 0x97f7 0x911f 0xaa4 0x99c6 0x90d2 0xb04 0x9b95 0x9089 0xb68 0x9d64 0x9053 0xbdc 0x9f34 0x9031 0xc6f 0xa103 0x9017 0xd3e 0xa2d2 0x8ffe 0xe52 0xa4a1 0x8fdf 0xfae 0xa670 0x8f8c 0x1166 0xa83f 0x8edf 0x1349 0xaa0e 0x8da7 0x155c 0xabdd 0x8bbb 0x17dd 0xadad 0x88e6 0x1d24 0xaf7c 0x848c 0x293a 0xb14b 0x7e31 0x2a56 0xb31a 0x772e 0x189c>;
			battery1_profile_t2_col = <0x03>;
			battery1_profile_t2_num = <0x64>;
			battery1_profile_t3 = <0x00 0xacb2 0x12ac 0x1cf 0xac1f 0x12a8 0x39e 0xab98 0x12c2 0x56d 0xab1b 0x12d1 0x73d 0xaaa7 0x12be 0x90c 0xaa33 0x12ab 0xadb 0xa9c1 0x12a7 0xcaa 0xa94a 0x1294 0xe79 0xa8cf 0x126d 0x1048 0xa853 0x1246 0x1217 0xa7df 0x1231 0x13e6 0xa761 0x1206 0x15b6 0xa6e1 0x11d9 0x1785 0xa665 0x11c5 0x1954 0xa5ea 0x119f 0x1b23 0xa56a 0x1298 0x1cf2 0xa4ea 0x132e 0x1ec1 0xa46e 0x1172 0x2090 0xa3fa 0x114f 0x225f 0xa381 0x112f 0x242f 0xa309 0x1117 0x25fe 0xa295 0x1116 0x27cd 0xa21b 0x1103 0x299c 0xa1a6 0x10fe 0x2b6b 0xa132 0x10f5 0x2d3a 0xa0be 0x10e5 0x2f09 0xa04b 0x10e5 0x30d9 0x9fde 0x10e5 0x32a8 0x9f72 0x10f0 0x3477 0x9f05 0x1109 0x3646 0x9e99 0x112f 0x3815 0x9e26 0x1130 0x39e4 0x9db2 0x1123 0x3bb3 0x9d3c 0x1100 0x3d82 0x9cc3 0x10ca 0x3f52 0x9c57 0x10b7 0x4121 0x9beb 0x1095 0x42f0 0x9b7c 0x106e 0x44bf 0x9b09 0x104b 0x468e 0x9a9d 0x1038 0x485d 0x9a23 0xff1 0x4a2c 0x99a8 0xfa4 0x4bfc 0x9931 0xf62 0x4dcb 0x98c5 0xf3c 0x4f9a 0x985b 0xf16 0x5169 0x97fa 0xefd 0x5338 0x97a3 0xef1 0x5507 0x9757 0xef3 0x56d6 0x9711 0xf06 0x58a5 0x96cc 0xf0a 0x5a75 0x968a 0xf14 0x5c44 0x964d 0xf27 0x5e13 0x960f 0xf3a 0x5fe2 0x95d8 0xf4e 0x61b1 0x95a3 0xf61 0x6380 0x9570 0xf7a 0x654f 0x9541 0xfa0 0x671e 0x9513 0xfb4 0x68ee 0x94ea 0xfd5 0x6abd 0x94c4 0xffb 0x6c8c 0x949d 0x1022 0x6e5b 0x9477 0x1048 0x702a 0x9450 0x105f 0x71f9 0x9432 0x1087 0x73c8 0x941a 0x10c1 0x7598 0x9403 0x10fb 0x7767 0x93f4 0x1134 0x7936 0x93e0 0x1179 0x7b05 0x93cb 0x11cd 0x7cd4 0x93bb 0x122e 0x7ea3 0x93ac 0x12a2 0x8072 0x9391 0x1307 0x8241 0x9372 0x1379 0x8411 0x9353 0x1406 0x85e0 0x9335 0x14b3 0x87af 0x930f 0x1551 0x897e 0x92e0 0x15f4 0x8b4d 0x92ad 0x16ae 0x8d1c 0x927f 0x1795 0x8eeb 0x9242 0x186a 0x90bb 0x9204 0x1971 0x928a 0x91c3 0x1a92 0x9459 0x917e 0x1bb6 0x9628 0x9130 0x1cfe 0x97f7 0x90e9 0x1e72 0x99c6 0x90a4 0x2018 0x9b95 0x9061 0x21fe 0x9d64 0x902b 0x2455 0x9f34 0x8ffc 0x2738 0xa103 0x8fce 0x2a82 0xa2d2 0x8f9c 0x2e1c 0xa4a1 0x8f5e 0x31e1 0xa670 0x8ef3 0x34c5 0xa83f 0x8e44 0x3714 0xaa0e 0x8d2b 0x3999 0xabdd 0x8b86 0x3d5a 0xadad 0x88f7 0x44fe 0xaf7c 0x8523 0x3bde 0xb14b 0x83fe 0x38ef 0xb31a 0x83fe 0x38ef>;
			battery1_profile_t3_col = <0x03>;
			battery1_profile_t3_num = <0x64>;
			battery1_profile_t4 = <0x00 0xacda 0x280a 0x1cf 0xac28 0x280a 0x39e 0xab82 0x2869 0x56d 0xaae0 0x28a1 0x73d 0xaa3e 0x2863 0x90c 0xa99c 0x2803 0xadb 0xa902 0x27a3 0xcaa 0xa86d 0x2744 0xe79 0xa7da 0x26e3 0x1048 0xa747 0x2683 0x1217 0xa6b5 0x2611 0x13e6 0xa62b 0x259d 0x15b6 0xa5a6 0x2535 0x1785 0xa51b 0x24e8 0x1954 0xa498 0x249b 0x1b23 0xa411 0x25d4 0x1cf2 0xa38e 0x2675 0x1ec1 0xa31a 0x23be 0x2090 0xa29f 0x235b 0x225f 0xa229 0x231a 0x242f 0xa1b2 0x22d9 0x25fe 0xa138 0x228e 0x27cd 0xa0ce 0x2255 0x299c 0xa062 0x222a 0x2b6b 0x9ff9 0x2215 0x2d3a 0x9f91 0x220b 0x2f09 0x9f16 0x21d1 0x30d9 0x9e9a 0x2197 0x32a8 0x9e1f 0x2152 0x3477 0x9da3 0x2105 0x3646 0x9d28 0x20b8 0x3815 0x9cb4 0x207e 0x39e4 0x9c45 0x2044 0x3bb3 0x9bda 0x200a 0x3d82 0x9b70 0x1fd3 0x3f52 0x9b0c 0x1fac 0x4121 0x9aa7 0x1f95 0x42f0 0x9a3f 0x1f65 0x44bf 0x99d5 0x1f23 0x468e 0x9970 0x1f10 0x485d 0x990c 0x1efd 0x4a2c 0x98a8 0x1ede 0x4bfc 0x9846 0x1ebd 0x4dcb 0x97e9 0x1eaa 0x4f9a 0x9796 0x1e97 0x5169 0x9747 0x1e9e 0x5338 0x96fc 0x1eb2 0x5507 0x96b7 0x1ec5 0x56d6 0x9671 0x1ed8 0x58a5 0x9632 0x1efb 0x5a75 0x95f8 0x1f22 0x5c44 0x95c2 0x1f48 0x5e13 0x958c 0x1f6f 0x5fe2 0x955d 0x1f95 0x61b1 0x9530 0x1fc8 0x6380 0x9504 0x2001 0x654f 0x94de 0x203b 0x671e 0x94bf 0x2088 0x68ee 0x94a5 0x20e3 0x6abd 0x948b 0x213b 0x6c8c 0x946e 0x218d 0x6e5b 0x945f 0x2201 0x702a 0x9449 0x2285 0x71f9 0x9436 0x230c 0x73c8 0x9424 0x2398 0x7598 0x940d 0x2432 0x7767 0x93fe 0x24dc 0x7936 0x93ea 0x25a1 0x7b05 0x93d2 0x2675 0x7cd4 0x93bb 0x274a 0x7ea3 0x93a4 0x2832 0x8072 0x9387 0x2927 0x8241 0x9368 0x2a22 0x8411 0x9349 0x2b20 0x85e0 0x932b 0x2c2e 0x87af 0x9305 0x2d2c 0x897e 0x92df 0x2e24 0x8b4d 0x92b7 0x2f1c 0x8d1c 0x9289 0x3017 0x8eeb 0x9253 0x3100 0x90bb 0x9218 0x31ce 0x928a 0x91da 0x328f 0x9459 0x919c 0x3350 0x9628 0x9157 0x3411 0x97f7 0x9111 0x34d2 0x99c6 0x90cc 0x359c 0x9b95 0x9086 0x366d 0x9d64 0x9041 0x372e 0x9f34 0x9017 0x383f 0xa103 0x8ff5 0x3995 0xa2d2 0x8fd6 0x3b44 0xa4a1 0x8fb7 0x3d74 0xa670 0x8f89 0x40e1 0xa83f 0x8f2c 0x4645 0xaa0e 0x8e67 0x4d46 0xabdd 0x8cc3 0x4e9d 0xadad 0x8a3a 0x48f1 0xaf7c 0x8a2a 0x48f3 0xb14b 0x8a2a 0x48f3 0xb31a 0x8a2a 0x48f3>;
			battery1_profile_t4_col = <0x03>;
			battery1_profile_t4_num = <0x64>;
			suppld-maxim;
		};
	};

	fragment@8 {
		target = <0xffffffff>;

		__overlay__ {

			aw8624_interrupt_active {
				phandle = <0x20>;

				pins_cmd_dat {
					bias-pull-up;
					drive-strength = <0x02>;
					input-enable;
					pinmux = <0x1600>;
				};
			};

			aw8624_reset_active {
				phandle = <0x1e>;

				pins_cmd_dat {
					bias-disable;
					drive-strength = <0x02>;
					output-low;
					pinmux = <0x8100>;
				};
			};

			aw8624_reset_reset {
				phandle = <0x1f>;

				pins_cmd_dat {
					bias-disable;
					drive-strength = <0x02>;
					output-high;
					pinmux = <0x8100>;
				};
			};
		};
	};

	fragment@9 {
		target = <0xffffffff>;

		__overlay__ {
			status = "ok";

			aw8624_haptic@5a {
				compatible = "mediatek,aw8624_haptic";
				irq-gpio = <0xffffffff 0x16 0x00>;
				pinctrl-0 = <0x1e>;
				pinctrl-1 = <0x1f>;
				pinctrl-2 = <0x20>;
				pinctrl-names = "aw8624_reset_reset\0aw8624_reset_active\0aw8624_interrupt_active";
				reg = <0x5a>;
				reset-gpio = <0xffffffff 0x81 0x00>;
				status = "ok";
				vib_bemf_config = <0x10 0x08 0x23 0xf8>;
				vib_bst_vol_default = <0x1b>;
				vib_bst_vol_ram = <0x1b>;
				vib_bst_vol_rtp = <0x16>;
				vib_cont_drv_lev = <0x64>;
				vib_cont_drv_lvl_ov = <0x69>;
				vib_cont_num_brk = <0x03>;
				vib_cont_td = <0xf06c>;
				vib_cont_zc_thr = <0x8f8>;
				vib_effect_id_boundary = <0x0a>;
				vib_effect_max = <0xaa>;
				vib_f0_cali_percen = <0x07>;
				vib_f0_coeff = <0x104>;
				vib_f0_pre = <0x802>;
				vib_f0_trace_parameter = <0x09 0x03 0x01 0x1f>;
				vib_func_parameter1 = <0x01>;
				vib_gain_flag = <0x00>;
				vib_mode = <0x00>;
				vib_r_spare = <0x68>;
				vib_rtp_time = <0x14 0x14 0x14 0x14 0x14 0x14 0x14 0x14 0x4e20 0x3a98 0x3a98 0x4e20 0x61a8 0x3a98 0x7530 0x61a8 0x4e20 0x4e20 0x4e20 0x4e20 0x4e20 0x4e20 0x4e20 0x4e20 0x4e20 0x4e20 0x4e20 0x4e20 0x4e20 0x4e20 0x4e20 0x4e20 0x4e20 0x4e20 0x4e20 0x4e20 0x4e20 0x4e20 0x4e20 0x4e20 0x4e20 0x4e20 0x4e20 0x4e20 0x4e20 0x4e20 0x4e20 0x4e20 0x4e20 0x4e20 0x4e20 0x4e20 0x4e20 0x4e20 0x4e20 0x4e20 0x4e20 0x4e20 0x4e20 0x4e20 0x4e20 0x4e20 0x4e20 0x4e20 0x4e20 0x4e20 0x4e20 0x4e20 0x4e20 0x4e20 0x4e20 0x4e20 0x4e20 0x4e20 0x4e20 0x4e20 0x4e20 0x4e20 0x4e20 0x4e20 0x4e20 0x4e20 0x4e20 0x4e20 0x4e20 0x4e20 0x4e20 0x4e20 0x4e20 0x4e20 0x4e20 0x4e20 0x4e20 0x4e20 0x4e20 0x4e20 0x4e20 0x4e20 0x4e20 0x4e20 0x4e20 0x4e20 0x4e20 0x4e20 0x4e20 0x4e20 0x4e20 0x4e20 0x4e20 0x4e20 0x4e20 0x4e20 0x4e20 0x4e20 0x4e20 0x4e20 0x4e20 0x4e20 0x4e20 0x4e20 0x4e20 0x4e20 0x4e20 0x4e20 0x4e20 0x4e20 0x4e20 0x4e20 0x4e20 0x4e20 0x4e20 0x4e20 0x4e20 0x4e20 0x4e20 0x4e20 0x4e20 0x4e20 0x4e20 0x4e20 0x4e20 0x4e20 0x4e20 0x4e20 0x4e20 0x4e20 0x4e20 0x4e20 0x4e20 0x4e20 0x4e20 0x4e20 0x4e20 0x4e20 0x4e20 0x4e20 0x4e20 0x4e20 0x4e20 0x4e20 0x4e20 0x4e20 0x4e20 0x4e20 0x4e20 0x4e20 0x4e20 0x4e20 0x4e20 0x4e20 0x4e20 0x4e20 0x4e20 0x4e20 0x4e20>;
				vib_sw_brake = <0x2c>;
				vib_trig_config = <0x00 0x01 0x00 0x01 0x02 0x00 0x01 0x00 0x01 0x02 0x00 0x01 0x00 0x01 0x02>;
				vib_tset = <0x11>;

				wf_0 {
					mtk,effect-id = <0x00>;
					mtk,wf-brake-pattern = <0x2010000>;
					mtk,wf-pattern = [3e 3e];
					mtk,wf-play-rate-us = <0x4e20>;
					mtk,wf-vmax-mv = <0xe10>;
				};

				wf_1 {
					mtk,effect-id = <0x01>;
					mtk,wf-brake-pattern = <0x3010000>;
					mtk,wf-pattern = [7e 3e];
					mtk,wf-play-rate-us = <0x4e20>;
					mtk,wf-vmax-mv = <0xe10>;
				};

				wf_10 {
					mtk,effect-id = <0x0a>;
					mtk,wf-brake-pattern = <0x2010000>;
					mtk,wf-pattern = [3e 3e];
					mtk,wf-play-rate-us = <0x3a98>;
					mtk,wf-vmax-mv = <0xe10>;
				};

				wf_2 {
					mtk,effect-id = <0x02>;
					mtk,wf-brake-pattern = <0x2010000>;
					mtk,wf-pattern = [7e 3e];
					mtk,wf-play-rate-us = <0x32c8>;
					mtk,wf-vmax-mv = <0xe10>;
				};

				wf_3 {
					mtk,effect-id = <0x03>;
					mtk,wf-brake-pattern = <0x2010000>;
					mtk,wf-pattern = [3e 3e];
					mtk,wf-play-rate-us = <0x2710>;
					mtk,wf-vmax-mv = <0xe10>;
				};

				wf_4 {
					mtk,effect-id = <0x04>;
					mtk,wf-brake-pattern = <0x2010000>;
					mtk,wf-pattern = [3e 3e];
					mtk,wf-play-rate-us = <0x6d60>;
					mtk,wf-vmax-mv = <0xe10>;
				};

				wf_5 {
					mtk,effect-id = <0x05>;
					mtk,wf-brake-pattern = <0x3030100>;
					mtk,wf-pattern = [7e 7e 7e];
					mtk,wf-play-rate-us = <0x2710>;
					mtk,wf-vmax-mv = <0xe10>;
				};

				wf_6 {
					mtk,effect-id = <0x06>;
					mtk,wf-brake-pattern = <0x2010000>;
					mtk,wf-pattern = [3e 3e];
					mtk,wf-play-rate-us = <0x61a8>;
					mtk,wf-vmax-mv = <0xe10>;
				};

				wf_7 {
					mtk,effect-id = <0x07>;
					mtk,wf-brake-pattern = <0x3010000>;
					mtk,wf-pattern = [7e 3e];
					mtk,wf-play-rate-us = <0x61a8>;
					mtk,wf-vmax-mv = <0xe10>;
				};

				wf_8 {
					mtk,effect-id = <0x08>;
					mtk,wf-brake-pattern = <0x2010000>;
					mtk,wf-pattern = [7e 3e];
					mtk,wf-play-rate-us = <0x88b8>;
					mtk,wf-vmax-mv = <0xe10>;
				};

				wf_9 {
					mtk,effect-id = <0x09>;
					mtk,wf-brake-pattern = <0x2010000>;
					mtk,wf-pattern = [3e 3e];
					mtk,wf-play-rate-us = <0x3a98>;
					mtk,wf-vmax-mv = <0xe10>;
				};
			};
		};
	};
};
