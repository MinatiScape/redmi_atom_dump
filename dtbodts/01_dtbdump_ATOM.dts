/dts-v1/;

/ {
	compatible = "mediatek,MT6873";
	model = "ATOM";

	__fixups__ {
		accdet = "/fragment@15:target:0";
		auxadc = "/fragment@37:target:0\0/fragment@38/__overlay__:io-channels:0";
		bat_gm30 = "/fragment@76:target:0";
		camera_af_hw_node = "/fragment@11:target:0";
		charger = "/fragment@65:target:0";
		chosen = "/fragment@1:target:0";
		consys = "/fragment@26:target:0";
		cp_qc30 = "/fragment@70:target:0";
		dispsys_config = "/fragment@13:target:0";
		dsi0 = "/fragment@14:target:0";
		dsi_te = "/fragment@53:target:0";
		fan53870_l1 = "/fragment@33/__overlay__:cam0_vcamd-supply:0";
		fan53870_l2 = "/fragment@33/__overlay__:cam1_vcamd-supply:0";
		fan53870_l3 = "/fragment@33/__overlay__:cam0_vcama-supply:0";
		fan53870_l4 = "/fragment@33/__overlay__:cam2_vcama-supply:0\0/fragment@33/__overlay__:cam4_vcama-supply:0";
		fan53870_l5 = "/fragment@33/__overlay__:cam1_vcama-supply:0\0/fragment@33/__overlay__:cam3_vcama-supply:0";
		fan53870_l6 = "/fragment@11/__overlay__:vcamois-supply:0";
		fan53870_l7 = "/fragment@11/__overlay__:vcamaf-supply:0";
		goodix_fp = "/fragment@19:target:0";
		gpio = "/fragment@51:target:0";
		gpio_usage_mapping = "/fragment@50:target:0";
		i2c0 = "/fragment@4:target:0\0/fragment@6:target:0\0/fragment@40:target:0";
		i2c1 = "/fragment@41:target:0";
		i2c2 = "/fragment@34:target:0\0/fragment@42:target:0";
		i2c3 = "/fragment@27:target:0\0/fragment@43:target:0";
		i2c4 = "/fragment@35:target:0\0/fragment@44:target:0";
		i2c5 = "/fragment@45:target:0";
		i2c6 = "/fragment@9:target:0\0/fragment@30:target:0\0/fragment@46:target:0";
		i2c7 = "/fragment@47:target:0";
		i2c8 = "/fragment@36:target:0\0/fragment@48:target:0";
		i2c9 = "/fragment@49:target:0\0/fragment@69:target:0";
		irtx_pwm = "/fragment@16:target:0";
		kd_camera_hw1 = "/fragment@33:target:0\0/fragment@61:target:0";
		keypad = "/fragment@63:target:0";
		lk_charger = "/fragment@64:target:0";
		md1_sim1_hot_plug_eint = "/fragment@58:target:0";
		md_auxadc = "/fragment@38:target:0";
		mrdump_ext_rst = "/fragment@52:target:0";
		mt6360_pmic = "/fragment@22:target:0";
		mt6360_pmu = "/fragment@21:target:0\0/fragment@66:target:0";
		mt6360_typec = "/fragment@23:target:0";
		mt_pmic_vcamio_ldo_reg = "/fragment@31:target:0\0/fragment@33/__overlay__:cam0_vcamio-supply:0\0/fragment@33/__overlay__:cam1_vcamio-supply:0\0/fragment@33/__overlay__:cam2_vcamio-supply:0\0/fragment@33/__overlay__:cam3_vcamio-supply:0\0/fragment@33/__overlay__:cam4_vcamio-supply:0\0/fragment@59:target:0\0/fragment@61/__overlay__:vcamaf-supply:0\0/fragment@61/__overlay__:vcamaf_sub-supply:0";
		mt_pmic_vfp_ldo_reg = "/fragment@18/__overlay__/fingerprint@0:vfp-supply:0";
		mt_pmic_vtp_ldo_reg = "/fragment@3/__overlay__/gt9896s@0:vtouch-supply:0\0/fragment@4/__overlay__/gt9886@5d:vtouch-supply:0\0/fragment@6/__overlay__/focaltech@38:avdd-supply:0\0/fragment@60:target:0\0/fragment@62/__overlay__:vtouch-supply:0";
		mtkfb = "/fragment@12:target:0";
		odm = "/fragment@2:target:0\0/fragment@67:target:0";
		pd_adapter = "/fragment@73:target:0";
		pio = "/fragment@3/__overlay__/gt9896s@0:goodix,reset-gpio:0\0/fragment@3/__overlay__/gt9896s@0:goodix,irq-gpio:0\0/fragment@4/__overlay__/gt9886@5d:interrupt-parent:0\0/fragment@4/__overlay__/gt9886@5d:goodix,reset-gpio:0\0/fragment@4/__overlay__/gt9886@5d:goodix,irq-gpio:0\0/fragment@5:target:0\0/fragment@6/__overlay__/focaltech@38:interrupt-parent:0\0/fragment@6/__overlay__/focaltech@38:focaltech,reset-gpio:0\0/fragment@6/__overlay__/focaltech@38:focaltech,irq-gpio:0\0/fragment@7:target:0\0/fragment@8:target:0\0/fragment@9/__overlay__/aw8624_haptic@5a:reset-gpio:0\0/fragment@9/__overlay__/aw8624_haptic@5a:irq-gpio:0\0/fragment@10:target:0\0/fragment@14/__overlay__/panel@0:pm-enable-gpios:0\0/fragment@14/__overlay__/panel@0:reset-gpios:0\0/fragment@17:target:0\0/fragment@19/__overlay__:interrupt-parent:0\0/fragment@20:target:0\0/fragment@21/__overlay__:mt6360,intr_gpio:0\0/fragment@23/__overlay__:mt6360pd,intr_gpio:0\0/fragment@23/__overlay__:mt6360pd,pcb_gpio:0\0/fragment@24:target:0\0/fragment@25:target:0\0/fragment@27/__overlay__/nxp@28:qcom,nq-irq:0\0/fragment@27/__overlay__/nxp@28:interrupt-parent:0\0/fragment@27/__overlay__/nxp@28:qcom,nq-ven:0\0/fragment@27/__overlay__/nxp@28:qcom,nq-firm:0\0/fragment@27/__overlay__/nxp@28:qcom,nq-clkreq:0\0/fragment@28:target:0\0/fragment@30/__overlay__/cs35l41@40:reset-gpio:0\0/fragment@30/__overlay__/cs35l41@40:interrupt-parent:0\0/fragment@30/__overlay__/cs35l41@40:irq-gpio:0\0/fragment@32:target:0\0/fragment@50/__overlay__:GPIO_SIM1_HOT_PLUG:0\0/fragment@50/__overlay__:GPIO_SIM2_SCLK:0\0/fragment@50/__overlay__:GPIO_SIM2_SRST:0\0/fragment@50/__overlay__:GPIO_SIM2_SIO:0\0/fragment@50/__overlay__:GPIO_SIM1_SIO:0\0/fragment@50/__overlay__:GPIO_SIM1_SRST:0\0/fragment@50/__overlay__:GPIO_SIM1_SCLK:0\0/fragment@50/__overlay__:GPIO_FDD_BAND_SUPPORT_DETECT_1ST_PIN:0\0/fragment@50/__overlay__:GPIO_FDD_BAND_SUPPORT_DETECT_2ND_PIN:0\0/fragment@50/__overlay__:GPIO_FDD_BAND_SUPPORT_DETECT_3RD_PIN:0\0/fragment@50/__overlay__:GPIO_FDD_BAND_SUPPORT_DETECT_4TH_PIN:0\0/fragment@52/__overlay__:interrupt-parent:0\0/fragment@52/__overlay__:deb-gpios:0\0/fragment@53/__overlay__:interrupt-parent:0\0/fragment@54/__overlay__:interrupt-parent:0\0/fragment@55/__overlay__:interrupt-parent:0\0/fragment@56/__overlay__:interrupt-parent:0\0/fragment@57/__overlay__:interrupt-parent:0\0/fragment@67/__overlay__/simtray:status-gpio:0\0/fragment@68:target:0\0/fragment@69/__overlay__/bq2597x-standalone@66:interrupt-parent:0\0/fragment@69/__overlay__/xmusb350-charger@35:interrupt-parent:0\0/fragment@69/__overlay__/xmusb350-charger@35:xm,xmusb350_rst_gpio:0\0/fragment@69/__overlay__/xmusb350-charger@35:xm,xmusb350_sda_gpio:0\0/fragment@69/__overlay__/xmusb350-charger@35:xm,xmusb350_scl_gpio:0\0/fragment@69/__overlay__/xmusb350-charger@35:mi,connect_therm:0";
		pmic_clock_buffer_ctrl = "/fragment@39:target:0";
		reserved_memory = "/fragment@0:target:0";
		smart_pa = "/fragment@57:target:0";
		spi1 = "/fragment@18:target:0";
		spi5 = "/fragment@29:target:0";
		spi7 = "/fragment@3:target:0";
		subpmic_pmu_eint = "/fragment@55:target:0";
		tcpc_pd = "/fragment@56:target:0";
		thermal_message = "/fragment@74:target:0";
		touch = "/fragment@54:target:0\0/fragment@62:target:0";
		usb0phy = "/fragment@75:target:0";
		usbpd_pm = "/fragment@71:target:0";
		xiaomi_touch = "/fragment@72:target:0";
	};

	__local_fixups__ {

		fragment@12 {

			__overlay__ {
				pinctrl-0 = <0x00>;
				pinctrl-1 = <0x00>;
				pinctrl-2 = <0x00>;
			};
		};

		fragment@13 {

			__overlay__ {
				pinctrl-0 = <0x00>;
				pinctrl-1 = <0x00>;
				pinctrl-2 = <0x00>;
			};
		};

		fragment@14 {

			__overlay__ {

				panel@0 {

					port {

						endpoint {
							remote-endpoint = <0x00>;
						};
					};
				};

				ports {

					port {

						endpoint {
							remote-endpoint = <0x00>;
						};
					};
				};
			};
		};

		fragment@16 {

			__overlay__ {
				pinctrl-0 = <0x00>;
				pinctrl-1 = <0x00>;
			};
		};

		fragment@19 {

			__overlay__ {
				pinctrl-0 = <0x00>;
				pinctrl-1 = <0x00>;
				pinctrl-2 = <0x00>;
				pinctrl-3 = <0x00>;
			};
		};

		fragment@2 {

			__overlay__ {

				usb_c_pinctrl {
					pinctrl-0 = <0x00>;
					pinctrl-1 = <0x00>;
					pinctrl-10 = <0x00>;
					pinctrl-11 = <0x00>;
					pinctrl-12 = <0x00>;
					pinctrl-2 = <0x00>;
					pinctrl-3 = <0x00>;
					pinctrl-4 = <0x00>;
					pinctrl-5 = <0x00>;
					pinctrl-6 = <0x00>;
					pinctrl-7 = <0x00>;
					pinctrl-8 = <0x00>;
					pinctrl-9 = <0x00>;
				};
			};
		};

		fragment@26 {

			__overlay__ {
				pinctrl-0 = <0x00>;
				pinctrl-1 = <0x00>;
				pinctrl-2 = <0x00>;
				pinctrl-3 = <0x00>;
			};
		};

		fragment@27 {

			__overlay__ {

				nxp@28 {
					pinctrl-0 = <0x00>;
					pinctrl-1 = <0x00 0x04 0x08 0x0c>;
					pinctrl-2 = <0x00 0x04 0x08 0x0c>;
				};
			};
		};

		fragment@3 {

			__overlay__ {
				pinctrl-0 = <0x00>;
				pinctrl-1 = <0x00>;
				pinctrl-2 = <0x00>;
				pinctrl-3 = <0x00>;
				pinctrl-4 = <0x00>;
				pinctrl-5 = <0x00>;
			};
		};

		fragment@33 {

			__overlay__ {
				pinctrl-0 = <0x00>;
				pinctrl-1 = <0x00>;
				pinctrl-10 = <0x00>;
				pinctrl-11 = <0x00>;
				pinctrl-12 = <0x00>;
				pinctrl-13 = <0x00>;
				pinctrl-14 = <0x00>;
				pinctrl-15 = <0x00>;
				pinctrl-16 = <0x00>;
				pinctrl-17 = <0x00>;
				pinctrl-18 = <0x00>;
				pinctrl-19 = <0x00>;
				pinctrl-2 = <0x00>;
				pinctrl-20 = <0x00>;
				pinctrl-21 = <0x00>;
				pinctrl-22 = <0x00>;
				pinctrl-23 = <0x00>;
				pinctrl-24 = <0x00>;
				pinctrl-25 = <0x00>;
				pinctrl-26 = <0x00>;
				pinctrl-27 = <0x00>;
				pinctrl-28 = <0x00>;
				pinctrl-29 = <0x00>;
				pinctrl-3 = <0x00>;
				pinctrl-30 = <0x00>;
				pinctrl-31 = <0x00>;
				pinctrl-32 = <0x00>;
				pinctrl-33 = <0x00>;
				pinctrl-34 = <0x00>;
				pinctrl-35 = <0x00>;
				pinctrl-36 = <0x00>;
				pinctrl-37 = <0x00>;
				pinctrl-38 = <0x00>;
				pinctrl-39 = <0x00>;
				pinctrl-4 = <0x00>;
				pinctrl-40 = <0x00>;
				pinctrl-41 = <0x00>;
				pinctrl-42 = <0x00>;
				pinctrl-43 = <0x00>;
				pinctrl-44 = <0x00>;
				pinctrl-45 = <0x00>;
				pinctrl-46 = <0x00>;
				pinctrl-47 = <0x00>;
				pinctrl-48 = <0x00>;
				pinctrl-49 = <0x00>;
				pinctrl-5 = <0x00>;
				pinctrl-50 = <0x00>;
				pinctrl-51 = <0x00>;
				pinctrl-52 = <0x00>;
				pinctrl-53 = <0x00>;
				pinctrl-54 = <0x00>;
				pinctrl-55 = <0x00>;
				pinctrl-56 = <0x00>;
				pinctrl-57 = <0x00>;
				pinctrl-58 = <0x00>;
				pinctrl-59 = <0x00>;
				pinctrl-6 = <0x00>;
				pinctrl-60 = <0x00>;
				pinctrl-61 = <0x00>;
				pinctrl-62 = <0x00>;
				pinctrl-63 = <0x00>;
				pinctrl-64 = <0x00>;
				pinctrl-65 = <0x00>;
				pinctrl-66 = <0x00>;
				pinctrl-67 = <0x00>;
				pinctrl-7 = <0x00>;
				pinctrl-8 = <0x00>;
				pinctrl-9 = <0x00>;
			};
		};

		fragment@4 {

			__overlay__ {
				pinctrl-0 = <0x00>;
				pinctrl-1 = <0x00>;
				pinctrl-2 = <0x00>;
				pinctrl-3 = <0x00>;
				pinctrl-4 = <0x00>;
				pinctrl-5 = <0x00>;
			};
		};

		fragment@6 {

			__overlay__ {

				focaltech@38 {
					pinctrl-0 = <0x00 0x04>;
					pinctrl-1 = <0x00 0x04>;
				};
			};
		};

		fragment@69 {

			__overlay__ {

				bq2597x-standalone@66 {
					pinctrl-0 = <0x00 0x04>;
				};

				xmusb350-charger@35 {
					pinctrl-0 = <0x00 0x04 0x08>;
					pinctrl-1 = <0x00 0x04 0x08>;
				};
			};
		};

		fragment@9 {

			__overlay__ {

				aw8624_haptic@5a {
					pinctrl-0 = <0x00>;
					pinctrl-1 = <0x00>;
					pinctrl-2 = <0x00>;
				};
			};
		};
	};

	__symbols__ {
		aw8624_haptic_mtk = "/fragment@46/__overlay__/aw8624_haptic@5a";
		aw8624_interrupt = "/fragment@8/__overlay__/aw8624_interrupt_active";
		aw8624_reset_high = "/fragment@8/__overlay__/aw8624_reset_reset";
		aw8624_reset_low = "/fragment@8/__overlay__/aw8624_reset_active";
		bq2597x_int_default = "/fragment@68/__overlay__/bq2597x_int_default";
		bq2597x_int_suspend = "/fragment@68/__overlay__/bq2597x_int_suspend";
		camera_main_af_mtk = "/fragment@42/__overlay__/camera_main_af@18";
		camera_main_mtk = "/fragment@42/__overlay__/camera_main@5a";
		camera_main_three_mtk = "/fragment@44/__overlay__/camera_main_three@5a";
		camera_main_two_af_mtk = "/fragment@48/__overlay__/camera_main_two_af@1e";
		camera_main_two_mtk = "/fragment@48/__overlay__/camera_main_two@40";
		camera_pins_cam0_mclk_2ma = "/fragment@32/__overlay__/camera_pins_cam0_mclk_2ma";
		camera_pins_cam0_mclk_4ma = "/fragment@32/__overlay__/camera_pins_cam0_mclk_4ma";
		camera_pins_cam0_mclk_6ma = "/fragment@32/__overlay__/camera_pins_cam0_mclk_6ma";
		camera_pins_cam0_mclk_8ma = "/fragment@32/__overlay__/camera_pins_cam0_mclk_8ma";
		camera_pins_cam0_mclk_off = "/fragment@32/__overlay__/camera_pins_cam0_mclk_off";
		camera_pins_cam0_pnd_0 = "/fragment@32/__overlay__/cam0@2";
		camera_pins_cam0_pnd_1 = "/fragment@32/__overlay__/cam0@3";
		camera_pins_cam0_rst_0 = "/fragment@32/__overlay__/cam0@0";
		camera_pins_cam0_rst_1 = "/fragment@32/__overlay__/cam0@1";
		camera_pins_cam0_vcama_0 = "/fragment@32/__overlay__/cam0@vcam2";
		camera_pins_cam0_vcama_1 = "/fragment@32/__overlay__/cam0@vcam3";
		camera_pins_cam0_vcamd_0 = "/fragment@32/__overlay__/cam0@vcam0";
		camera_pins_cam0_vcamd_1 = "/fragment@32/__overlay__/cam0@vcam1";
		camera_pins_cam1_mclk_2ma = "/fragment@32/__overlay__/camera_pins_cam1_mclk_2ma";
		camera_pins_cam1_mclk_4ma = "/fragment@32/__overlay__/camera_pins_cam1_mclk_4ma";
		camera_pins_cam1_mclk_6ma = "/fragment@32/__overlay__/camera_pins_cam1_mclk_6ma";
		camera_pins_cam1_mclk_8ma = "/fragment@32/__overlay__/camera_pins_cam1_mclk_8ma";
		camera_pins_cam1_mclk_off = "/fragment@32/__overlay__/camera_pins_cam1_mclk_off";
		camera_pins_cam1_pnd_0 = "/fragment@32/__overlay__/cam1@2";
		camera_pins_cam1_pnd_1 = "/fragment@32/__overlay__/cam1@3";
		camera_pins_cam1_rst_0 = "/fragment@32/__overlay__/cam1@0";
		camera_pins_cam1_rst_1 = "/fragment@32/__overlay__/cam1@1";
		camera_pins_cam1_vcama_0 = "/fragment@32/__overlay__/cam1@vcam2";
		camera_pins_cam1_vcama_1 = "/fragment@32/__overlay__/cam1@vcam3";
		camera_pins_cam1_vcamd_0 = "/fragment@32/__overlay__/cam1@vcam0";
		camera_pins_cam1_vcamd_1 = "/fragment@32/__overlay__/cam1@vcam1";
		camera_pins_cam2_mclk_2ma = "/fragment@32/__overlay__/camera_pins_cam2_mclk_2ma";
		camera_pins_cam2_mclk_4ma = "/fragment@32/__overlay__/camera_pins_cam2_mclk_4ma";
		camera_pins_cam2_mclk_6ma = "/fragment@32/__overlay__/camera_pins_cam2_mclk_6ma";
		camera_pins_cam2_mclk_8ma = "/fragment@32/__overlay__/camera_pins_cam2_mclk_8ma";
		camera_pins_cam2_mclk_off = "/fragment@32/__overlay__/camera_pins_cam2_mclk_off";
		camera_pins_cam2_pnd_0 = "/fragment@32/__overlay__/cam2@2";
		camera_pins_cam2_pnd_1 = "/fragment@32/__overlay__/cam2@3";
		camera_pins_cam2_rst_0 = "/fragment@32/__overlay__/cam2@0";
		camera_pins_cam2_rst_1 = "/fragment@32/__overlay__/cam2@1";
		camera_pins_cam2_vcama_0 = "/fragment@32/__overlay__/cam2@vcam2";
		camera_pins_cam2_vcama_1 = "/fragment@32/__overlay__/cam2@vcam3";
		camera_pins_cam2_vcamd_0 = "/fragment@32/__overlay__/cam2@vcam0";
		camera_pins_cam2_vcamd_1 = "/fragment@32/__overlay__/cam2@vcam1";
		camera_pins_cam3_mclk_2ma = "/fragment@32/__overlay__/camera_pins_cam3_mclk_2ma";
		camera_pins_cam3_mclk_4ma = "/fragment@32/__overlay__/camera_pins_cam3_mclk_4ma";
		camera_pins_cam3_mclk_6ma = "/fragment@32/__overlay__/camera_pins_cam3_mclk_6ma";
		camera_pins_cam3_mclk_8ma = "/fragment@32/__overlay__/camera_pins_cam3_mclk_8ma";
		camera_pins_cam3_mclk_off = "/fragment@32/__overlay__/camera_pins_cam3_mclk_off";
		camera_pins_cam3_pnd_0 = "/fragment@32/__overlay__/cam3@2";
		camera_pins_cam3_pnd_1 = "/fragment@32/__overlay__/cam3@3";
		camera_pins_cam3_rst_0 = "/fragment@32/__overlay__/cam3@0";
		camera_pins_cam3_rst_1 = "/fragment@32/__overlay__/cam3@1";
		camera_pins_cam3_vcama_0 = "/fragment@32/__overlay__/cam3@vcam2";
		camera_pins_cam3_vcama_1 = "/fragment@32/__overlay__/cam3@vcam3";
		camera_pins_cam3_vcamd_0 = "/fragment@32/__overlay__/cam3@vcam0";
		camera_pins_cam3_vcamd_1 = "/fragment@32/__overlay__/cam3@vcam1";
		camera_pins_cam4_mclk_2ma = "/fragment@32/__overlay__/camera_pins_cam4_mclk_2ma";
		camera_pins_cam4_mclk_4ma = "/fragment@32/__overlay__/camera_pins_cam4_mclk_4ma";
		camera_pins_cam4_mclk_6ma = "/fragment@32/__overlay__/camera_pins_cam4_mclk_6ma";
		camera_pins_cam4_mclk_8ma = "/fragment@32/__overlay__/camera_pins_cam4_mclk_8ma";
		camera_pins_cam4_mclk_off = "/fragment@32/__overlay__/camera_pins_cam4_mclk_off";
		camera_pins_cam4_pnd_0 = "/fragment@32/__overlay__/cam4@2";
		camera_pins_cam4_pnd_1 = "/fragment@32/__overlay__/cam4@3";
		camera_pins_cam4_rst_0 = "/fragment@32/__overlay__/cam4@0";
		camera_pins_cam4_rst_1 = "/fragment@32/__overlay__/cam4@1";
		camera_pins_cam4_vcama_0 = "/fragment@32/__overlay__/cam4@vcam2";
		camera_pins_cam4_vcama_1 = "/fragment@32/__overlay__/cam4@vcam3";
		camera_pins_cam4_vcamd_0 = "/fragment@32/__overlay__/cam4@vcam0";
		camera_pins_cam4_vcamd_1 = "/fragment@32/__overlay__/cam4@vcam1";
		camera_pins_cam_mipi_switch_sel_0 = "/fragment@32/__overlay__/mipi_sel@0";
		camera_pins_cam_mipi_switch_sel_1 = "/fragment@32/__overlay__/mipi_sel@1";
		camera_pins_default = "/fragment@32/__overlay__/camdefault";
		camera_sub_mtk = "/fragment@44/__overlay__/camera_sub@20";
		camera_sub_two_af_mtk = "/fragment@48/__overlay__/camera_sub_two_af@18";
		camera_sub_two_mtk = "/fragment@48/__overlay__/camera_sub_two@6e";
		consys_pins_default = "/fragment@25/__overlay__/consys_default";
		cs35l41 = "/fragment@30/__overlay__/cs35l41@40";
		ctp_gt9896s_int_active = "/fragment@5/__overlay__/int1_active";
		ctp_gt9896s_int_suspend = "/fragment@5/__overlay__/int1_suspend";
		ctp_gt9896s_pins_default = "/fragment@5/__overlay__/pins_default";
		ctp_gt9896s_reset_active = "/fragment@5/__overlay__/reset1_active";
		ctp_gt9896s_reset_suspend = "/fragment@5/__overlay__/reset1_suspend";
		ctp_gt9896s_spi_mode = "/fragment@5/__overlay__/spimode_default";
		ctp_pins_default = "/fragment@5/__overlay__/eintdefault";
		ctp_ts_i2c_mode = "/fragment@5/__overlay__/i2cmode_default";
		ctp_ts_int_active = "/fragment@5/__overlay__/int_active";
		ctp_ts_int_suspend = "/fragment@5/__overlay__/int_suspend";
		ctp_ts_reset_active = "/fragment@5/__overlay__/reset_active";
		ctp_ts_reset_suspend = "/fragment@5/__overlay__/reset_suspend";
		dsi_out = "/fragment@14/__overlay__/ports/port/endpoint";
		fingerprint_default = "/fragment@20/__overlay__/state_default";
		fingerprint_eint_init = "/fragment@20/__overlay__/state_eint_init";
		fingerprint_reset_high = "/fragment@20/__overlay__/state_reset_high";
		fingerprint_reset_low = "/fragment@20/__overlay__/state_reset_low";
		gpio_redriver_c1_high = "/fragment@24/__overlay__/c1_high";
		gpio_redriver_c1_hiz = "/fragment@24/__overlay__/c1_highz";
		gpio_redriver_c1_init = "/fragment@24/__overlay__/c1_init";
		gpio_redriver_c1_low = "/fragment@24/__overlay__/c1_low";
		gpio_redriver_c2_high = "/fragment@24/__overlay__/c2_high";
		gpio_redriver_c2_hiz = "/fragment@24/__overlay__/c2_highz";
		gpio_redriver_c2_init = "/fragment@24/__overlay__/c2_init";
		gpio_redriver_c2_low = "/fragment@24/__overlay__/c2_low";
		gpio_u3_switch_disable = "/fragment@24/__overlay__/u3_sw_dis";
		gpio_u3_switch_enable = "/fragment@24/__overlay__/u3_sw_en";
		gpio_u3_switch_sel1 = "/fragment@24/__overlay__/u3_sw_sel1";
		gpio_u3_switch_sel2 = "/fragment@24/__overlay__/u3_sw_sel2";
		gpslna_pins_init = "/fragment@25/__overlay__/gpslna@0";
		gpslna_pins_oh = "/fragment@25/__overlay__/gpslna@1";
		gpslna_pins_ol = "/fragment@25/__overlay__/gpslna@2";
		i2c_lcd_bias_mtk = "/fragment@46/__overlay__/i2c_lcd_bias@3e";
		irtx_gpio_led_default = "/fragment@17/__overlay__/irtx_gpio_led_def@gpio135";
		irtx_gpio_led_set = "/fragment@17/__overlay__/irtx_gpio_led_set@gpio135";
		led0 = "/fragment@2/__overlay__/led@0";
		led1 = "/fragment@2/__overlay__/led@1";
		led2 = "/fragment@2/__overlay__/led@2";
		led3 = "/fragment@2/__overlay__/led@3";
		led4 = "/fragment@2/__overlay__/led@4";
		led5 = "/fragment@2/__overlay__/led@5";
		led6 = "/fragment@2/__overlay__/led@6";
		mtk_camera_eeprom0 = "/fragment@34/__overlay__/camera_eeprom0@50";
		mtk_camera_eeprom1 = "/fragment@35/__overlay__/camera_eeprom1@51";
		mtk_camera_eeprom2 = "/fragment@36/__overlay__/camera_eeprom2@52";
		mtk_camera_eeprom3 = "/fragment@36/__overlay__/camera_eeprom3@53";
		mtk_camera_eeprom4 = "/fragment@35/__overlay__/camera_eeprom4@54";
		mtkfb_pins_lcm_dsi_te = "/fragment@10/__overlay__/lcm_dsi_te";
		mtkfb_pins_lcm_rst_out0_gpio = "/fragment@10/__overlay__/lcm_rst_out0_gpio";
		mtkfb_pins_lcm_rst_out1_gpio = "/fragment@10/__overlay__/lcm_rst_out1_gpio";
		nfc_clk_req_active = "/fragment@28/__overlay__/nfc_clk_req_active";
		nfc_clk_req_suspend = "/fragment@28/__overlay__/nfc_clk_req_suspend";
		nfc_default = "/fragment@28/__overlay__/nfc_default";
		nfc_enable_active = "/fragment@28/__overlay__/nfc_enable_active";
		nfc_enable_suspend = "/fragment@28/__overlay__/nfc_enable_suspend";
		nfc_firmwaredownload_active = "/fragment@28/__overlay__/nfc_firmwaredownload_active";
		nfc_firmwaredownload_suspend = "/fragment@28/__overlay__/nfc_firmwaredownload_suspend";
		nfc_int_active = "/fragment@28/__overlay__/nfc_int_active";
		nfc_int_suspend = "/fragment@28/__overlay__/nfc_int_suspend";
		nfc_mtk = "/fragment@43/__overlay__/nfc@08";
		panel_in = "/fragment@14/__overlay__/panel@0/port/endpoint";
		speaker_amp_mtk = "/fragment@46/__overlay__/speaker_amp@40";
		subpmic_ldo_mtk = "/fragment@45/__overlay__/subpmic_ldo@64";
		subpmic_mtk = "/fragment@45/__overlay__/subpmic@34";
		subpmic_pmic_mtk = "/fragment@45/__overlay__/subpmic_pmic@1a";
		tp_int_active = "/fragment@7/__overlay__/tp_int_active";
		tp_int_suspend = "/fragment@7/__overlay__/tp_int_suspend";
		tp_reset_active = "/fragment@7/__overlay__/tp_reset_active";
		tp_reset_suspend = "/fragment@7/__overlay__/tp_reset_suspend";
		usb_c_pinctrl = "/fragment@2/__overlay__/usb_c_pinctrl";
		usb_default = "/fragment@24/__overlay__/usb_default";
		usb_type_c_mtk = "/fragment@45/__overlay__/usb_type_c@4e";
		vibrator0 = "/fragment@2/__overlay__/vibrator@0";
		xmusb350_int_isp = "/fragment@68/__overlay__/xmusb350_int_isp";
		xmusb350_int_normal = "/fragment@68/__overlay__/xmusb350_int_normal";
		xmusb350_rst_isp = "/fragment@68/__overlay__/xmusb350_rst_isp";
		xmusb350_rst_normal = "/fragment@68/__overlay__/xmusb350_rst_normal";
		xmusb350_scl_isp = "/fragment@68/__overlay__/xmusb350_scl_isp";
		xmusb350_scl_normal = "/fragment@68/__overlay__/xmusb350_scl_normal";
		xmusb350_sda_isp = "/fragment@68/__overlay__/xmusb350_sda_isp";
		xmusb350_sda_normal = "/fragment@68/__overlay__/xmusb350_sda_normal";
	};

	fragment@0 {
		target = <0xffffffff>;

		__overlay__ {
		};
	};

	fragment@1 {
		target = <0xffffffff>;

		__overlay__ {
			atag,videolfb-fb_base_h = <0x00>;
			atag,videolfb-fb_base_l = "~`P";
			atag,videolfb-fps = <0x1770>;
			atag,videolfb-islcm_inited = <0x00>;
			atag,videolfb-islcmfound = <0x01>;
			atag,videolfb-lcmname = "nt35595_fhd_dsi_cmd_truly_nt50358_drv";
			atag,videolfb-vramSize = <0x1be0000>;
		};
	};

	fragment@10 {
		target = <0xffffffff>;

		__overlay__ {

			lcm_dsi_te {
				phandle = <0x23>;

				pins_cmd_dat {
					pinmux = <0x2901>;
				};
			};

			lcm_rst_out0_gpio {
				phandle = <0x22>;

				pins_cmd_dat {
					output-low;
					pinmux = <0x2a00>;
					slew-rate = <0x01>;
				};
			};

			lcm_rst_out1_gpio {
				phandle = <0x21>;

				pins_cmd_dat {
					output-high;
					pinmux = <0x2a00>;
					slew-rate = <0x01>;
				};
			};
		};
	};

	fragment@11 {
		target = <0xffffffff>;

		__overlay__ {
			status = "okay";
			vcamaf-supply = <0xffffffff>;
			vcamois-supply = <0xffffffff>;
		};
	};

	fragment@12 {
		target = <0xffffffff>;

		__overlay__ {
			pinctrl-0 = <0x21>;
			pinctrl-1 = <0x22>;
			pinctrl-2 = <0x23>;
			pinctrl-names = "lcm_rst_out1_gpio\0lcm_rst_out0_gpio\0mode_te_te";
			status = "okay";
		};
	};

	fragment@13 {
		target = <0xffffffff>;

		__overlay__ {
			pinctrl-0 = <0x21>;
			pinctrl-1 = <0x22>;
			pinctrl-2 = <0x23>;
			pinctrl-names = "lcm_rst_out1_gpio\0lcm_rst_out0_gpio\0mode_te_te";
			status = "okay";
		};
	};

	fragment@14 {
		target = <0xffffffff>;

		__overlay__ {
			#address-cells = <0x01>;
			#size-cells = <0x00>;
			status = "okay";

			panel@0 {
				compatible = "s6e8fc01,lcm";
				pinctrl-names = "default";
				pm-enable-gpios = <0xffffffff 0x1d 0x00>;
				reg = <0x00>;
				reset-gpios = <0xffffffff 0x2a 0x00>;

				port {

					endpoint {
						phandle = <0x25>;
						remote-endpoint = <0x24>;
					};
				};
			};

			ports {

				port {

					endpoint {
						phandle = <0x24>;
						remote-endpoint = <0x25>;
					};
				};
			};
		};
	};

	fragment@15 {
		target = <0xffffffff>;

		__overlay__ {
			accdet-mic-mode = <0x02>;
			accdet-mic-vol = <0x08>;
			accdet-plugout-debounce = <0x01>;
			eint_use_ext_res = <0x04>;
			headset-four-key-threshold = <0x00 0x3a 0x79 0xc0 0x190>;
			headset-mode-setting = <0x500 0x500 0x01 0x1f0 0x800 0x1200 0x20 0x44 0x04 0x01 0x05 0x03 0x03 0x07 0x0e>;
			headset-three-key-threshold = <0x00 0x50 0xdc 0x190>;
			headset-three-key-threshold-CDD = <0x00 0x79 0xc0 0x258>;
			status = "okay";
		};
	};

	fragment@16 {
		target = <0xffffffff>;

		__overlay__ {
			pinctrl-0 = <0x26>;
			pinctrl-1 = <0x27>;
			pinctrl-names = "irtx_gpio_led_default\0irtx_gpio_led_set";
			pwm_ch = <0x00>;
			status = "okay";
		};
	};

	fragment@17 {
		target = <0xffffffff>;

		__overlay__ {

			irtx_gpio_led_def@gpio135 {
				phandle = <0x26>;

				pins_cmd_dat {
					bias-disable;
					input-schmitt-enable = <0x00>;
					output-low;
					pinmux = <0x8700>;
					slew-rate = <0x01>;
				};
			};

			irtx_gpio_led_set@gpio135 {
				phandle = <0x27>;

				pins_cmd_dat {
					output-high;
					pinmux = <0x8701>;
					slew-rate = <0x01>;
				};
			};
		};
	};

	fragment@18 {
		target = <0xffffffff>;

		__overlay__ {
			#address-cells = <0x01>;
			#size-cells = <0x00>;

			fingerprint@0 {
				compatible = "goodix,goodix-fp";
				netlink-event = <0x1e>;
				power-type = <0x01>;
				reg = <0x00>;
				spi-max-frequency = <0x7a1200>;
				status = "okay";
				vfp-supply = <0xffffffff>;
			};
		};
	};

	fragment@19 {
		target = <0xffffffff>;

		__overlay__ {
			interrupt-parent = <0xffffffff>;
			interrupts = <0x0f 0x01 0x0f 0x00>;
			pinctrl-0 = <0x28>;
			pinctrl-1 = <0x29>;
			pinctrl-2 = <0x2a>;
			pinctrl-3 = <0x2b>;
			pinctrl-names = "default\0reset_high\0reset_low\0eint_init";
			status = "okay";
		};
	};

	fragment@2 {
		target = <0xffffffff>;

		__overlay__ {

			led@0 {
				compatible = "mediatek,red";
				data = <0x01>;
				led_mode = <0x00>;
				phandle = <0x85>;
				pwm_config = <0x00 0x00 0x00 0x00 0x00>;
			};

			led@1 {
				compatible = "mediatek,green";
				data = <0x01>;
				led_mode = <0x00>;
				phandle = <0x86>;
				pwm_config = <0x00 0x00 0x00 0x00 0x00>;
			};

			led@2 {
				compatible = "mediatek,blue";
				data = <0x01>;
				led_mode = <0x00>;
				phandle = <0x87>;
				pwm_config = <0x00 0x00 0x00 0x00 0x00>;
			};

			led@3 {
				compatible = "mediatek,jogball-backlight";
				data = <0x01>;
				led_mode = <0x00>;
				phandle = <0x88>;
				pwm_config = <0x00 0x00 0x00 0x00 0x00>;
			};

			led@4 {
				compatible = "mediatek,keyboard-backlight";
				data = <0x01>;
				led_mode = <0x00>;
				phandle = <0x89>;
				pwm_config = <0x00 0x00 0x00 0x00 0x00>;
			};

			led@5 {
				compatible = "mediatek,button-backlight";
				data = <0x01>;
				led_mode = <0x00>;
				phandle = <0x8a>;
				pwm_config = <0x00 0x00 0x00 0x00 0x00>;
			};

			led@6 {
				compatible = "mediatek,lcd-backlight";
				data = <0x01>;
				led_mode = <0x04>;
				phandle = <0x8b>;
				pwm_config = <0x00 0x01 0x00 0x00 0x00>;
			};

			usb_c_pinctrl {
				compatible = "mediatek,usb_c_pinctrl";
				phandle = <0x8d>;
				pinctrl-0 = <0x01>;
				pinctrl-1 = <0x02>;
				pinctrl-10 = <0x0b>;
				pinctrl-11 = <0x0c>;
				pinctrl-12 = <0x0d>;
				pinctrl-2 = <0x03>;
				pinctrl-3 = <0x04>;
				pinctrl-4 = <0x05>;
				pinctrl-5 = <0x06>;
				pinctrl-6 = <0x07>;
				pinctrl-7 = <0x08>;
				pinctrl-8 = <0x09>;
				pinctrl-9 = <0x0a>;
				pinctrl-names = "usb_default\0redrv_c1_init\0redrv_c1_low\0redrv_c1_hiz\0redrv_c1_high\0redrv_c2_init\0redrv_c2_low\0redrv_c2_hiz\0redrv_c2_high\0switch_sel1\0switch_sel2\0switch_enable\0switch_disable";
				status = "okay";

				usb_switch-data {
					c1_pin_num = <0x71>;
					c1_pin_val = <0x02>;
					c2_pin_num = <0x70>;
					c2_pin_val = <0x01>;
					en_pin_num = <0x00>;
					en_pin_val = <0x00>;
					sel_pin_num = <0x6f>;
					sel_pin_val = <0x01>;
				};
			};

			vibrator@0 {
				compatible = "mediatek,vibrator";
				phandle = <0x8c>;
				vib_limit = <0x09>;
				vib_timer = <0x19>;
				vib_vol = <0x09>;
			};
		};
	};

	fragment@20 {
		target = <0xffffffff>;

		__overlay__ {

			state_default {
				phandle = <0x28>;
			};

			state_eint_init {
				phandle = <0x2b>;

				pins_cmd_dat {
					bias-pull-up = <0x66>;
					input-schmitt-enable;
					pinmux = <0xf00>;
					slew-rate = <0x00>;
				};
			};

			state_reset_high {
				phandle = <0x29>;

				pins_cmd_dat {
					output-high;
					pinmux = <0xe00>;
					slew-rate = <0x01>;
				};
			};

			state_reset_low {
				phandle = <0x2a>;

				pins_cmd_dat {
					output-low;
					pinmux = <0xe00>;
					slew-rate = <0x01>;
				};
			};
		};
	};

	fragment@21 {
		target = <0xffffffff>;

		__overlay__ {
			mt6360,intr_gpio = <0xffffffff 0x18 0x00>;
			mt6360,intr_gpio_num = <0x18>;
		};
	};

	fragment@22 {
		target = <0xffffffff>;

		__overlay__ {
			pwr_off_seq = <0x6000204>;
		};
	};

	fragment@23 {
		target = <0xffffffff>;

		__overlay__ {
			mt6360pd,intr_gpio = <0xffffffff 0x19 0x00>;
			mt6360pd,intr_gpio_num = <0x19>;
			mt6360pd,pcb_gpio = <0xffffffff 0x13 0x00>;
			mt6360pd,pcb_gpio_num = <0x13>;
		};
	};

	fragment@24 {
		target = <0xffffffff>;

		__overlay__ {

			c1_high {
				phandle = <0x05>;

				pins_cmd_dat {
					output-high;
					pinmux = <0x7100>;
					slew-rate = <0x01>;
				};
			};

			c1_highz {
				phandle = <0x04>;

				pins_cmd_dat {
					bias-disable;
					pinmux = <0x7100>;
					slew-rate = <0x00>;
				};
			};

			c1_init {
				phandle = <0x02>;

				pins_cmd_dat {
					output-low;
					pinmux = <0x7100>;
					slew-rate = <0x01>;
				};
			};

			c1_low {
				phandle = <0x03>;

				pins_cmd_dat {
					output-low;
					pinmux = <0x7100>;
					slew-rate = <0x01>;
				};
			};

			c2_high {
				phandle = <0x09>;

				pins_cmd_dat {
					output-high;
					pinmux = <0x7000>;
					slew-rate = <0x01>;
				};
			};

			c2_highz {
				phandle = <0x08>;

				pins_cmd_dat {
					bias-disable;
					pinmux = <0x7000>;
					slew-rate = <0x00>;
				};
			};

			c2_init {
				phandle = <0x06>;

				pins_cmd_dat {
					output-low;
					pinmux = <0x7000>;
					slew-rate = <0x01>;
				};
			};

			c2_low {
				phandle = <0x07>;

				pins_cmd_dat {
					output-low;
					pinmux = <0x7000>;
					slew-rate = <0x01>;
				};
			};

			u3_sw_dis {
				phandle = <0x0d>;
			};

			u3_sw_en {
				phandle = <0x0c>;
			};

			u3_sw_sel1 {
				phandle = <0x0a>;

				pins_cmd_dat {
					output-low;
					pinmux = <0x6f00>;
					slew-rate = <0x01>;
				};
			};

			u3_sw_sel2 {
				phandle = <0x0b>;

				pins_cmd_dat {
					output-high;
					pinmux = <0x6f00>;
					slew-rate = <0x01>;
				};
			};

			usb_default {
				phandle = <0x01>;
			};
		};
	};

	fragment@25 {
		target = <0xffffffff>;

		__overlay__ {

			consys_default {
				phandle = <0x2c>;
			};

			gpslna@0 {
				phandle = <0x2d>;

				pins_cmd_dat {
					output-low;
					pinmux = <0xa200>;
				};
			};

			gpslna@1 {
				phandle = <0x2e>;

				pins_cmd_dat {
					pinmux = <0xa202>;
				};
			};

			gpslna@2 {
				phandle = <0x2f>;

				pins_cmd_dat {
					output-low;
					pinmux = <0xa200>;
				};
			};
		};
	};

	fragment@26 {
		target = <0xffffffff>;

		__overlay__ {
			pinctrl-0 = <0x2c>;
			pinctrl-1 = <0x2d>;
			pinctrl-2 = <0x2e>;
			pinctrl-3 = <0x2f>;
			pinctrl-names = "default\0gps_lna_state_init\0gps_lna_state_oh\0gps_lna_state_ol";
			status = "okay";
		};
	};

	fragment@27 {
		target = <0xffffffff>;

		__overlay__ {
			status = "okay";

			nxp@28 {
				compatible = "qcom,nq-nci";
				interrupt-names = "nfc_irq";
				interrupt-parent = <0xffffffff>;
				interrupts = <0x0b 0x04 0x0b 0x00>;
				pinctrl-0 = <0x30>;
				pinctrl-1 = <0x31 0x32 0x33 0x34>;
				pinctrl-2 = <0x35 0x36 0x37 0x38>;
				pinctrl-names = "default\0nfc_active\0nfc_suspend";
				qcom,nq-clkreq = <0xffffffff 0x12 0x00>;
				qcom,nq-firm = <0xffffffff 0x11 0x00>;
				qcom,nq-irq = <0xffffffff 0x0b 0x00>;
				qcom,nq-ven = <0xffffffff 0x0a 0x00>;
				reg = <0x28>;
			};
		};
	};

	fragment@28 {
		target = <0xffffffff>;

		__overlay__ {

			nfc_clk_req_active {
				phandle = <0x33>;

				pins_cmd_dat {
					bias-pull-up;
					drive-strength = <0x02>;
					input-enable;
					pinmux = <0x1201>;
					slew-rate = <0x00>;
				};
			};

			nfc_clk_req_suspend {
				phandle = <0x37>;

				pins_cmd_dat {
					bias-pull-down;
					drive-strength = <0x02>;
					input-enable;
					pinmux = <0x1201>;
					slew-rate = <0x00>;
				};
			};

			nfc_default {
				phandle = <0x30>;
			};

			nfc_enable_active {
				phandle = <0x32>;

				pins_cmd_dat {
					bias-pull-up = <0x67>;
					drive-strength = <0x02>;
					output-high;
					pinmux = <0xa00>;
					slew-rate = <0x01>;
				};
			};

			nfc_enable_suspend {
				phandle = <0x36>;

				pins_cmd_dat {
					bias-disable;
					drive-strength = <0x02>;
					pinmux = <0xa00>;
					slew-rate = <0x01>;
				};
			};

			nfc_firmwaredownload_active {
				phandle = <0x34>;

				pins_cmd_dat {
					bias-pull-up;
					drive-strength = <0x02>;
					pinmux = <0x1100>;
					slew-rate = <0x01>;
				};
			};

			nfc_firmwaredownload_suspend {
				phandle = <0x38>;

				pins_cmd_dat {
					bias-disable;
					drive-strength = <0x02>;
					pinmux = <0x1100>;
					slew-rate = <0x01>;
				};
			};

			nfc_int_active {
				phandle = <0x31>;

				pins_cmd_dat {
					bias-pull-up;
					drive-strength = <0x02>;
					pinmux = <0xb00>;
					slew-rate = <0x00>;
				};
			};

			nfc_int_suspend {
				phandle = <0x35>;

				pins_cmd_dat {
					bias-pull-up;
					drive-strength = <0x02>;
					pinmux = <0xb00>;
					slew-rate = <0x00>;
				};
			};
		};
	};

	fragment@29 {
		target = <0xffffffff>;

		__overlay__ {
			#address-cells = <0x01>;
			#size-cells = <0x00>;

			p61@31 {
				compatible = "nxp,p61";
				reg = <0x00>;
				spi-max-frequency = <0x7a1200>;
				status = "okay";
			};
		};
	};

	fragment@3 {
		target = <0xffffffff>;

		__overlay__ {
			#address-cells = <0x01>;
			#size-cells = <0x00>;
			pinctrl-0 = <0x0e>;
			pinctrl-1 = <0x0f>;
			pinctrl-2 = <0x10>;
			pinctrl-3 = <0x11>;
			pinctrl-4 = <0x12>;
			pinctrl-5 = <0x13>;
			pinctrl-names = "default\0gt9896s_int_active\0gt9896s_reset_active\0gt9896s_int_suspend\0gt9896s_reset_suspend\0gt9896s_spi_mode";
			status = "okay";

			gt9896s@0 {
				compatible = "goodix,gt9896s";
				goodix,avdd-name = "vtouch";
				goodix,config-version = "6873v01";
				goodix,firmware-version = "6873v00";
				goodix,input-max-x = <0x438>;
				goodix,input-max-y = <0x8e8>;
				goodix,irq-flags = <0x02>;
				goodix,irq-gpio = <0xffffffff 0x15 0x00>;
				goodix,panel-key-map = <0x9e 0xac 0xd9>;
				goodix,panel-max-id = <0x0a>;
				goodix,panel-max-p = <0x100>;
				goodix,panel-max-w = <0x100>;
				goodix,panel-max-x = <0x438>;
				goodix,panel-max-y = <0x8e8>;
				goodix,pen-enable;
				goodix,power-off-delay-us = <0x1388>;
				goodix,power-on-delay-us = <0x2710>;
				goodix,reset-gpio = <0xffffffff 0x14 0x00>;
				reg = <0x00>;
				spi-max-frequency = <0xf4240>;
				tpd-filter-custom-prameters = <0x00 0x00 0x00 0x00 0x00 0x00 0x00 0x00 0x00 0x00 0x00 0x00>;
				tpd-filter-custom-speed = <0x00 0x00 0x00>;
				tpd-filter-enable = <0x00>;
				tpd-filter-pixel-density = <0xa1>;
				vtouch-supply = <0xffffffff>;
			};
		};
	};

	fragment@30 {
		target = <0xffffffff>;

		__overlay__ {
			status = "okay";

			cs35l41@40 {
				cirrus,boost-cap-microfarad = <0x0f>;
				cirrus,boost-ind-nanohenry = <0x3e8>;
				cirrus,boost-peak-milliamp = <0x1194>;
				compatible = "cirrus,cs35l41";
				interrupt-parent = <0xffffffff>;
				interrupts = <0x1f 0x08 0x1f 0x00>;
				irq-gpio = <0xffffffff 0x1f 0x00>;
				phandle = <0x8e>;
				reg = <0x40>;
				reset-gpio = <0xffffffff 0x1e 0x00>;

				cirrus,gpio-config2 {
					cirrus,gpio-output-enable;
					cirrus,gpio-src-select = <0x04>;
				};
			};
		};
	};

	fragment@31 {
		target = <0xffffffff>;

		__overlay__ {
			regulator-default-on = <0x01>;
			status = "okay";
		};
	};

	fragment@32 {
		target = <0xffffffff>;

		__overlay__ {

			cam0@0 {
				phandle = <0x3a>;

				pins_cmd_dat {
					output-low;
					pinmux = <0x8f00>;
					slew-rate = <0x01>;
				};
			};

			cam0@1 {
				phandle = <0x3b>;

				pins_cmd_dat {
					output-high;
					pinmux = <0x8f00>;
					slew-rate = <0x01>;
				};
			};

			cam0@2 {
				phandle = <0x3c>;

				pins_cmd_dat {
					output-low;
					pinmux = <0xa500>;
					slew-rate = <0x01>;
				};
			};

			cam0@3 {
				phandle = <0x3d>;

				pins_cmd_dat {
					output-high;
					pinmux = <0xa500>;
					slew-rate = <0x01>;
				};
			};

			cam0@vcam0 {
				phandle = <0x4e>;

				pins_cmd_dat {
					output-low;
					pinmux = <0x8a00>;
					slew-rate = <0x01>;
				};
			};

			cam0@vcam1 {
				phandle = <0x4f>;

				pins_cmd_dat {
					output-high;
					pinmux = <0x8a00>;
					slew-rate = <0x01>;
				};
			};

			cam0@vcam2 {
				phandle = <0x50>;

				pins_cmd_dat {
					output-low;
					pinmux = <0x8a00>;
					slew-rate = <0x01>;
				};
			};

			cam0@vcam3 {
				phandle = <0x51>;

				pins_cmd_dat {
					output-high;
					pinmux = <0x8a00>;
					slew-rate = <0x01>;
				};
			};

			cam1@0 {
				phandle = <0x3e>;

				pins_cmd_dat {
					output-low;
					pinmux = <0x9000>;
					slew-rate = <0x01>;
				};
			};

			cam1@1 {
				phandle = <0x3f>;

				pins_cmd_dat {
					output-high;
					pinmux = <0x9000>;
					slew-rate = <0x01>;
				};
			};

			cam1@2 {
				phandle = <0x40>;

				pins_cmd_dat {
					output-low;
					pinmux = <0x9000>;
					slew-rate = <0x01>;
				};
			};

			cam1@3 {
				phandle = <0x41>;

				pins_cmd_dat {
					output-high;
					pinmux = <0x9000>;
					slew-rate = <0x01>;
				};
			};

			cam1@vcam0 {
				phandle = <0x52>;

				pins_cmd_dat {
					output-low;
					pinmux = <0x8a00>;
					slew-rate = <0x01>;
				};
			};

			cam1@vcam1 {
				phandle = <0x53>;

				pins_cmd_dat {
					output-high;
					pinmux = <0x8a00>;
					slew-rate = <0x01>;
				};
			};

			cam1@vcam2 {
				phandle = <0x54>;

				pins_cmd_dat {
					output-low;
					pinmux = <0x8a00>;
					slew-rate = <0x01>;
				};
			};

			cam1@vcam3 {
				phandle = <0x55>;

				pins_cmd_dat {
					output-high;
					pinmux = <0x8a00>;
					slew-rate = <0x01>;
				};
			};

			cam2@0 {
				phandle = <0x42>;

				pins_cmd_dat {
					output-low;
					pinmux = <0x9100>;
					slew-rate = <0x01>;
				};
			};

			cam2@1 {
				phandle = <0x43>;

				pins_cmd_dat {
					output-high;
					pinmux = <0x9100>;
					slew-rate = <0x01>;
				};
			};

			cam2@2 {
				phandle = <0x44>;

				pins_cmd_dat {
					output-low;
					pinmux = <0x9100>;
					slew-rate = <0x01>;
				};
			};

			cam2@3 {
				phandle = <0x45>;

				pins_cmd_dat {
					output-high;
					pinmux = <0x9100>;
					slew-rate = <0x01>;
				};
			};

			cam2@vcam0 {
				phandle = <0x56>;

				pins_cmd_dat {
					output-low;
					pinmux = <0x9300>;
					slew-rate = <0x01>;
				};
			};

			cam2@vcam1 {
				phandle = <0x57>;

				pins_cmd_dat {
					output-high;
					pinmux = <0x9300>;
					slew-rate = <0x01>;
				};
			};

			cam2@vcam2 {
				phandle = <0x58>;

				pins_cmd_dat {
					output-low;
					pinmux = <0x8a00>;
					slew-rate = <0x01>;
				};
			};

			cam2@vcam3 {
				phandle = <0x59>;

				pins_cmd_dat {
					output-high;
					pinmux = <0x8a00>;
					slew-rate = <0x01>;
				};
			};

			cam3@0 {
				phandle = <0x46>;

				pins_cmd_dat {
					output-low;
					pinmux = <0x8200>;
					slew-rate = <0x01>;
				};
			};

			cam3@1 {
				phandle = <0x47>;

				pins_cmd_dat {
					output-high;
					pinmux = <0x8200>;
					slew-rate = <0x01>;
				};
			};

			cam3@2 {
				phandle = <0x48>;

				pins_cmd_dat {
					output-low;
					pinmux = <0x8200>;
					slew-rate = <0x01>;
				};
			};

			cam3@3 {
				phandle = <0x49>;

				pins_cmd_dat {
					output-high;
					pinmux = <0x8200>;
					slew-rate = <0x01>;
				};
			};

			cam3@vcam0 {
				phandle = <0x5a>;

				pins_cmd_dat {
					output-low;
					pinmux = <0x8500>;
					slew-rate = <0x01>;
				};
			};

			cam3@vcam1 {
				phandle = <0x5b>;

				pins_cmd_dat {
					output-high;
					pinmux = <0x8500>;
					slew-rate = <0x01>;
				};
			};

			cam3@vcam2 {
				phandle = <0x5c>;

				pins_cmd_dat {
					output-low;
					pinmux = <0x8a00>;
					slew-rate = <0x01>;
				};
			};

			cam3@vcam3 {
				phandle = <0x5d>;

				pins_cmd_dat {
					output-high;
					pinmux = <0x8a00>;
					slew-rate = <0x01>;
				};
			};

			cam4@0 {
				phandle = <0x4a>;

				pins_cmd_dat {
					output-low;
					pinmux = <0x8300>;
					slew-rate = <0x01>;
				};
			};

			cam4@1 {
				phandle = <0x4b>;

				pins_cmd_dat {
					output-high;
					pinmux = <0x8300>;
					slew-rate = <0x01>;
				};
			};

			cam4@2 {
				phandle = <0x4c>;

				pins_cmd_dat {
					output-low;
					pinmux = <0x8300>;
					slew-rate = <0x01>;
				};
			};

			cam4@3 {
				phandle = <0x4d>;

				pins_cmd_dat {
					output-high;
					pinmux = <0x8300>;
					slew-rate = <0x01>;
				};
			};

			cam4@vcam0 {
				phandle = <0x5e>;

				pins_cmd_dat {
					output-low;
					pinmux = <0x9400>;
					slew-rate = <0x01>;
				};
			};

			cam4@vcam1 {
				phandle = <0x5f>;

				pins_cmd_dat {
					output-high;
					pinmux = <0x9400>;
					slew-rate = <0x01>;
				};
			};

			cam4@vcam2 {
				phandle = <0x60>;

				pins_cmd_dat {
					output-low;
					pinmux = <0x8a00>;
					slew-rate = <0x01>;
				};
			};

			cam4@vcam3 {
				phandle = <0x61>;

				pins_cmd_dat {
					output-high;
					pinmux = <0x8a00>;
					slew-rate = <0x01>;
				};
			};

			camdefault {
				phandle = <0x39>;
			};

			camera_pins_cam0_mclk_2ma {
				phandle = <0x63>;

				pins_cmd_dat {
					drive-strength = <0x00>;
					pinmux = <0x9501>;
				};
			};

			camera_pins_cam0_mclk_4ma {
				phandle = <0x64>;

				pins_cmd_dat {
					drive-strength = <0x01>;
					pinmux = <0x9501>;
				};
			};

			camera_pins_cam0_mclk_6ma {
				phandle = <0x65>;

				pins_cmd_dat {
					drive-strength = <0x02>;
					pinmux = <0x9501>;
				};
			};

			camera_pins_cam0_mclk_8ma {
				phandle = <0x66>;

				pins_cmd_dat {
					drive-strength = <0x03>;
					pinmux = <0x9501>;
				};
			};

			camera_pins_cam0_mclk_off {
				phandle = <0x62>;

				pins_cmd_dat {
					drive-strength = <0x01>;
					pinmux = <0x9500>;
				};
			};

			camera_pins_cam1_mclk_2ma {
				phandle = <0x68>;

				pins_cmd_dat {
					drive-strength = <0x00>;
					pinmux = <0x9601>;
				};
			};

			camera_pins_cam1_mclk_4ma {
				phandle = <0x69>;

				pins_cmd_dat {
					drive-strength = <0x01>;
					pinmux = <0x9601>;
				};
			};

			camera_pins_cam1_mclk_6ma {
				phandle = <0x6a>;

				pins_cmd_dat {
					drive-strength = <0x02>;
					pinmux = <0x9601>;
				};
			};

			camera_pins_cam1_mclk_8ma {
				phandle = <0x6b>;

				pins_cmd_dat {
					drive-strength = <0x03>;
					pinmux = <0x9601>;
				};
			};

			camera_pins_cam1_mclk_off {
				phandle = <0x67>;

				pins_cmd_dat {
					drive-strength = <0x01>;
					pinmux = <0x9600>;
				};
			};

			camera_pins_cam2_mclk_2ma {
				phandle = <0x6d>;

				pins_cmd_dat {
					drive-strength = <0x00>;
					pinmux = <0x8901>;
				};
			};

			camera_pins_cam2_mclk_4ma {
				phandle = <0x6e>;

				pins_cmd_dat {
					drive-strength = <0x01>;
					pinmux = <0x8901>;
				};
			};

			camera_pins_cam2_mclk_6ma {
				phandle = <0x6f>;

				pins_cmd_dat {
					drive-strength = <0x02>;
					pinmux = <0x8901>;
				};
			};

			camera_pins_cam2_mclk_8ma {
				phandle = <0x70>;

				pins_cmd_dat {
					drive-strength = <0x03>;
					pinmux = <0x8901>;
				};
			};

			camera_pins_cam2_mclk_off {
				phandle = <0x6c>;

				pins_cmd_dat {
					drive-strength = <0x01>;
					pinmux = <0x8900>;
				};
			};

			camera_pins_cam3_mclk_2ma {
				phandle = <0x72>;

				pins_cmd_dat {
					drive-strength = <0x00>;
					pinmux = <0x8801>;
				};
			};

			camera_pins_cam3_mclk_4ma {
				phandle = <0x73>;

				pins_cmd_dat {
					drive-strength = <0x01>;
					pinmux = <0x8801>;
				};
			};

			camera_pins_cam3_mclk_6ma {
				phandle = <0x74>;

				pins_cmd_dat {
					drive-strength = <0x02>;
					pinmux = <0x8801>;
				};
			};

			camera_pins_cam3_mclk_8ma {
				phandle = <0x75>;

				pins_cmd_dat {
					drive-strength = <0x03>;
					pinmux = <0x8801>;
				};
			};

			camera_pins_cam3_mclk_off {
				phandle = <0x71>;

				pins_cmd_dat {
					drive-strength = <0x01>;
					pinmux = <0x8800>;
				};
			};

			camera_pins_cam4_mclk_2ma {
				phandle = <0x77>;

				pins_cmd_dat {
					drive-strength = <0x00>;
					pinmux = <0x9701>;
				};
			};

			camera_pins_cam4_mclk_4ma {
				phandle = <0x78>;

				pins_cmd_dat {
					drive-strength = <0x01>;
					pinmux = <0x9701>;
				};
			};

			camera_pins_cam4_mclk_6ma {
				phandle = <0x79>;

				pins_cmd_dat {
					drive-strength = <0x02>;
					pinmux = <0x9701>;
				};
			};

			camera_pins_cam4_mclk_8ma {
				phandle = <0x7a>;

				pins_cmd_dat {
					drive-strength = <0x03>;
					pinmux = <0x9701>;
				};
			};

			camera_pins_cam4_mclk_off {
				phandle = <0x76>;

				pins_cmd_dat {
					drive-strength = <0x01>;
					pinmux = <0x9700>;
				};
			};

			mipi_sel@0 {
				phandle = <0x7c>;

				pins_cmd_dat {
					output-low;
					pinmux = <0x9200>;
					slew-rate = <0x01>;
				};
			};

			mipi_sel@1 {
				phandle = <0x7b>;

				pins_cmd_dat {
					output-high;
					pinmux = <0x9200>;
					slew-rate = <0x01>;
				};
			};
		};
	};

	fragment@33 {
		target = <0xffffffff>;

		__overlay__ {
			cam0_enable_sensor = "ov48bsunny_mipi_raw ov48bofilm_mipi_raw s5kgw1ofilm_mipi_raw";
			cam0_vcama-supply = <0xffffffff>;
			cam0_vcamd-supply = <0xffffffff>;
			cam0_vcamio-supply = <0xffffffff>;
			cam1_enable_sensor = "s5k3t2sunny_mipi_raw s5k3t2ofilm_mipi_raw ov16a1qsunny_mipi_raw ov16a1qofilm_mipi_raw";
			cam1_vcama-supply = <0xffffffff>;
			cam1_vcamd-supply = <0xffffffff>;
			cam1_vcamio-supply = <0xffffffff>;
			cam2_enable_sensor = "gc02m1b_mipi_raw hi847sunny_mipi_raw hi847ofilm_mipi_raw";
			cam2_vcama-supply = <0xffffffff>;
			cam2_vcamio-supply = <0xffffffff>;
			cam3_enable_sensor = "gc5035sunny_mipi_raw gc5035ofilm_mipi_raw";
			cam3_vcama-supply = <0xffffffff>;
			cam3_vcamio-supply = <0xffffffff>;
			cam4_enable_sensor = "s5k4h7sunny_mipi_raw s5k4h7ofilm_mipi_raw";
			cam4_vcama-supply = <0xffffffff>;
			cam4_vcamio-supply = <0xffffffff>;
			pinctrl-0 = <0x39>;
			pinctrl-1 = <0x3a>;
			pinctrl-10 = <0x43>;
			pinctrl-11 = <0x44>;
			pinctrl-12 = <0x45>;
			pinctrl-13 = <0x46>;
			pinctrl-14 = <0x47>;
			pinctrl-15 = <0x48>;
			pinctrl-16 = <0x49>;
			pinctrl-17 = <0x4a>;
			pinctrl-18 = <0x4b>;
			pinctrl-19 = <0x4c>;
			pinctrl-2 = <0x3b>;
			pinctrl-20 = <0x4d>;
			pinctrl-21 = <0x4e>;
			pinctrl-22 = <0x4f>;
			pinctrl-23 = <0x50>;
			pinctrl-24 = <0x51>;
			pinctrl-25 = <0x52>;
			pinctrl-26 = <0x53>;
			pinctrl-27 = <0x54>;
			pinctrl-28 = <0x55>;
			pinctrl-29 = <0x56>;
			pinctrl-3 = <0x3c>;
			pinctrl-30 = <0x57>;
			pinctrl-31 = <0x58>;
			pinctrl-32 = <0x59>;
			pinctrl-33 = <0x5a>;
			pinctrl-34 = <0x5b>;
			pinctrl-35 = <0x5c>;
			pinctrl-36 = <0x5d>;
			pinctrl-37 = <0x5e>;
			pinctrl-38 = <0x5f>;
			pinctrl-39 = <0x60>;
			pinctrl-4 = <0x3d>;
			pinctrl-40 = <0x61>;
			pinctrl-41 = <0x62>;
			pinctrl-42 = <0x63>;
			pinctrl-43 = <0x64>;
			pinctrl-44 = <0x65>;
			pinctrl-45 = <0x66>;
			pinctrl-46 = <0x67>;
			pinctrl-47 = <0x68>;
			pinctrl-48 = <0x69>;
			pinctrl-49 = <0x6a>;
			pinctrl-5 = <0x3e>;
			pinctrl-50 = <0x6b>;
			pinctrl-51 = <0x6c>;
			pinctrl-52 = <0x6d>;
			pinctrl-53 = <0x6e>;
			pinctrl-54 = <0x6f>;
			pinctrl-55 = <0x70>;
			pinctrl-56 = <0x71>;
			pinctrl-57 = <0x72>;
			pinctrl-58 = <0x73>;
			pinctrl-59 = <0x74>;
			pinctrl-6 = <0x3f>;
			pinctrl-60 = <0x75>;
			pinctrl-61 = <0x76>;
			pinctrl-62 = <0x77>;
			pinctrl-63 = <0x78>;
			pinctrl-64 = <0x79>;
			pinctrl-65 = <0x7a>;
			pinctrl-66 = <0x7b>;
			pinctrl-67 = <0x7c>;
			pinctrl-7 = <0x40>;
			pinctrl-8 = <0x41>;
			pinctrl-9 = <0x42>;
			pinctrl-names = "default\0cam0_rst0\0cam0_rst1\0cam0_pnd0\0cam0_pnd1\0cam1_rst0\0cam1_rst1\0cam1_pnd0\0cam1_pnd1\0cam2_rst0\0cam2_rst1\0cam2_pnd0\0cam2_pnd1\0cam3_rst0\0cam3_rst1\0cam3_pnd0\0cam3_pnd1\0cam4_rst0\0cam4_rst1\0cam4_pnd0\0cam4_pnd1\0cam0_ldo_vcamd_0\0cam0_ldo_vcamd_1\0cam0_ldo_vcama_0\0cam0_ldo_vcama_1\0cam1_ldo_vcamd_0\0cam1_ldo_vcamd_1\0cam1_ldo_vcama_0\0cam1_ldo_vcama_1\0cam2_ldo_vcamd_0\0cam2_ldo_vcamd_1\0cam2_ldo_vcama_0\0cam2_ldo_vcama_1\0cam3_ldo_vcamd_0\0cam3_ldo_vcamd_1\0cam3_ldo_vcama_0\0cam3_ldo_vcama_1\0cam4_ldo_vcamd_0\0cam4_ldo_vcamd_1\0cam4_ldo_vcama_0\0cam4_ldo_vcama_1\0cam0_mclk_off\0cam0_mclk_2mA\0cam0_mclk_4mA\0cam0_mclk_6mA\0cam0_mclk_8mA\0cam1_mclk_off\0cam1_mclk_2mA\0cam1_mclk_4mA\0cam1_mclk_6mA\0cam1_mclk_8mA\0cam2_mclk_off\0cam2_mclk_2mA\0cam2_mclk_4mA\0cam2_mclk_6mA\0cam2_mclk_8mA\0cam3_mclk_off\0cam3_mclk_2mA\0cam3_mclk_4mA\0cam3_mclk_6mA\0cam3_mclk_8mA\0cam4_mclk_off\0cam4_mclk_2mA\0cam4_mclk_4mA\0cam4_mclk_6mA\0cam4_mclk_8mA\0cam_mipi_switch_sel_1\0cam_mipi_switch_sel_0";
			status = "okay";
		};
	};

	fragment@34 {
		target = <0xffffffff>;

		__overlay__ {

			camera_eeprom0@50 {
				compatible = "mediatek,camera_eeprom";
				phandle = <0x8f>;
				reg = <0x50>;
				status = "okay";
			};
		};
	};

	fragment@35 {
		target = <0xffffffff>;

		__overlay__ {

			camera_eeprom1@51 {
				compatible = "mediatek,camera_eeprom";
				phandle = <0x90>;
				reg = <0x51>;
				status = "okay";
			};

			camera_eeprom4@54 {
				compatible = "mediatek,camera_eeprom";
				phandle = <0x91>;
				reg = <0x54>;
				status = "okay";
			};
		};
	};

	fragment@36 {
		target = <0xffffffff>;

		__overlay__ {

			camera_eeprom2@52 {
				compatible = "mediatek,camera_eeprom";
				phandle = <0x92>;
				reg = <0x52>;
				status = "okay";
			};

			camera_eeprom3@53 {
				compatible = "mediatek,camera_eeprom";
				phandle = <0x93>;
				reg = <0x53>;
				status = "okay";
			};
		};
	};

	fragment@37 {
		target = <0xffffffff>;

		__overlay__ {

			adc_channel@ {
				compatible = "mediatek,adc_channel";
				mediatek,adc_fdd_rf_params_dynamic_custom_ch = <0x02>;
				mediatek,temperature0 = <0x00>;
				mediatek,temperature1 = <0x01>;
				status = "okay";
			};
		};
	};

	fragment@38 {
		target = <0xffffffff>;

		__overlay__ {
			io-channels = <0xffffffff 0x02>;
		};
	};

	fragment@39 {
		target = <0xffffffff>;

		__overlay__ {
			mediatek,clkbuf-config = <0x02 0x01 0x01 0x02 0x00 0x00 0x01>;
			mediatek,clkbuf-controls-for-desense = <0x00 0x04 0x00 0x04 0x00 0x00 0x00>;
			mediatek,clkbuf-output-impedance = <0x06 0x00 0x04 0x04 0x00 0x00 0x04>;
			mediatek,clkbuf-quantity = <0x07>;
			status = "okay";
		};
	};

	fragment@4 {
		target = <0xffffffff>;

		__overlay__ {
			clock-frequency = <0x61a80>;
			pinctrl-0 = <0x14>;
			pinctrl-1 = <0x15>;
			pinctrl-2 = <0x16>;
			pinctrl-3 = <0x17>;
			pinctrl-4 = <0x18>;
			pinctrl-5 = <0x19>;
			pinctrl-names = "default\0ts_int_active\0ts_reset_active\0ts_int_suspend\0ts_reset_suspend\0ts_i2c_mode";

			gt9886@5d {
				compatible = "goodix,gt9886";
				goodix,config-version = "6885v9c";
				goodix,firmware-version = "6885b1";
				goodix,input-max-x = <0x438>;
				goodix,input-max-y = <0x8e8>;
				goodix,irq-flags = <0x02>;
				goodix,irq-gpio = <0xffffffff 0x15 0x00>;
				goodix,key-of-pen = <0x14b 0x14c>;
				goodix,panel-key-map = <0x9e 0xac 0xd9>;
				goodix,panel-max-id = <0x0a>;
				goodix,panel-max-p = <0x100>;
				goodix,panel-max-w = <0x100>;
				goodix,panel-max-x = <0x438>;
				goodix,panel-max-y = <0x8e8>;
				goodix,pen-enable;
				goodix,power-off-delay-us = <0x1388>;
				goodix,power-on-delay-us = <0x2710>;
				goodix,reset-gpio = <0xffffffff 0x14 0x00>;
				goodix,x2x;
				goodix,y2y;
				interrupt-parent = <0xffffffff>;
				interrupts = <0x15 0x02 0x15 0x00>;
				reg = <0x5d>;
				status = "disable";
				tpd-filter-custom-prameters = <0x00 0x00 0x00 0x00 0x00 0x00 0x00 0x00 0x00 0x00 0x00 0x00>;
				tpd-filter-custom-speed = <0x00 0x00 0x00>;
				tpd-filter-enable = <0x00>;
				tpd-filter-pixel-density = <0xa1>;
				vtouch-supply = <0xffffffff>;

				sensor0 {
					normal-cfg;
				};
			};
		};
	};

	fragment@40 {
		target = <0xffffffff>;

		__overlay__ {
			#address-cells = <0x01>;
			#size-cells = <0x00>;
			clock-frequency = <0x61a80>;
			mediatek,use-open-drain;
		};
	};

	fragment@41 {
		target = <0xffffffff>;

		__overlay__ {
			#address-cells = <0x01>;
			#size-cells = <0x00>;
			clock-frequency = <0x61a80>;
			mediatek,use-open-drain;
		};
	};

	fragment@42 {
		target = <0xffffffff>;

		__overlay__ {
			#address-cells = <0x01>;
			#size-cells = <0x00>;
			clock-frequency = <0x61a80>;
			mediatek,use-open-drain;

			camera_main@5a {
				compatible = "mediatek,camera_main";
				phandle = <0x94>;
				reg = <0x5a>;
				status = "okay";
			};

			camera_main_af@18 {
				compatible = "mediatek,camera_main_af";
				phandle = <0x95>;
				reg = <0x18>;
				status = "okay";
			};
		};
	};

	fragment@43 {
		target = <0xffffffff>;

		__overlay__ {
			#address-cells = <0x01>;
			#size-cells = <0x00>;
			clock-frequency = <0x61a80>;
			mediatek,use-open-drain;

			nfc@08 {
				compatible = "mediatek,nfc";
				phandle = <0x96>;
				reg = <0x08>;
				status = "okay";
			};
		};
	};

	fragment@44 {
		target = <0xffffffff>;

		__overlay__ {
			#address-cells = <0x01>;
			#size-cells = <0x00>;
			clock-frequency = <0x61a80>;
			mediatek,use-open-drain;

			camera_main_three@5a {
				compatible = "mediatek,camera_main_three";
				phandle = <0x98>;
				reg = <0x5a>;
				status = "okay";
			};

			camera_sub@20 {
				compatible = "mediatek,camera_sub";
				phandle = <0x97>;
				reg = <0x20>;
				status = "okay";
			};
		};
	};

	fragment@45 {
		target = <0xffffffff>;

		__overlay__ {
			#address-cells = <0x01>;
			#size-cells = <0x00>;
			clock-frequency = <0x33e140>;
			mediatek,use-push-pull;

			subpmic@34 {
				compatible = "mediatek,subpmic";
				phandle = <0x99>;
				reg = <0x34>;
				status = "okay";
			};

			subpmic_ldo@64 {
				compatible = "mediatek,subpmic_ldo";
				phandle = <0x9c>;
				reg = <0x64>;
				status = "okay";
			};

			subpmic_pmic@1a {
				compatible = "mediatek,subpmic_pmic";
				phandle = <0x9b>;
				reg = <0x1a>;
				status = "okay";
			};

			usb_type_c@4e {
				compatible = "mediatek,usb_type_c";
				phandle = <0x9a>;
				reg = <0x4e>;
				status = "okay";
			};
		};
	};

	fragment@46 {
		target = <0xffffffff>;

		__overlay__ {
			#address-cells = <0x01>;
			#size-cells = <0x00>;
			clock-frequency = <0x61a80>;
			mediatek,use-open-drain;

			aw8624_haptic@5a {
				compatible = "mediatek,aw8624_haptic";
				phandle = <0x9f>;
				reg = <0x5a>;
				status = "okay";
			};

			i2c_lcd_bias@3e {
				compatible = "mediatek,i2c_lcd_bias";
				phandle = <0x9e>;
				reg = <0x3e>;
				status = "okay";
			};

			speaker_amp@40 {
				compatible = "mediatek,speaker_amp";
				phandle = <0x9d>;
				reg = <0x40>;
				status = "okay";
			};
		};
	};

	fragment@47 {
		target = <0xffffffff>;

		__overlay__ {
			#address-cells = <0x01>;
			#size-cells = <0x00>;
			clock-frequency = <0x61a80>;
			mediatek,use-open-drain;
		};
	};

	fragment@48 {
		target = <0xffffffff>;

		__overlay__ {
			#address-cells = <0x01>;
			#size-cells = <0x00>;
			clock-frequency = <0x61a80>;
			mediatek,use-open-drain;

			camera_main_two@40 {
				compatible = "mediatek,camera_main_two";
				phandle = <0xa0>;
				reg = <0x40>;
				status = "okay";
			};

			camera_main_two_af@1e {
				compatible = "mediatek,camera_main_two_af";
				phandle = <0xa2>;
				reg = <0x1e>;
				status = "okay";
			};

			camera_sub_two@6e {
				compatible = "mediatek,camera_sub_two";
				phandle = <0xa1>;
				reg = <0x6e>;
				status = "okay";
			};

			camera_sub_two_af@18 {
				compatible = "mediatek,camera_sub_two_af";
				phandle = <0xa3>;
				reg = <0x18>;
				status = "okay";
			};
		};
	};

	fragment@49 {
		target = <0xffffffff>;

		__overlay__ {
			#address-cells = <0x01>;
			#size-cells = <0x00>;
			clock-frequency = <0x61a80>;
			mediatek,use-open-drain;
		};
	};

	fragment@5 {
		target = <0xffffffff>;

		__overlay__ {

			eintdefault {
				phandle = <0x14>;
			};

			i2cmode_default {
				phandle = <0x19>;

				pins_cmd_dat {
					mediatek,drive-strength-adv = <0x00>;
					pinmux = <0xcc01 0xcd01>;
				};
			};

			int1_active {
				phandle = <0x0f>;

				pins_cmd_dat {
					bias-pull-up = <0x0b>;
					pinmux = <0x1500>;
					slew-rate = <0x00>;
				};
			};

			int1_suspend {
				phandle = <0x11>;

				pins_cmd_dat {
					output-low;
					pinmux = <0x1500>;
					slew-rate = <0x01>;
				};
			};

			int_active {
				phandle = <0x15>;

				pins_cmd_dat {
					bias-pull-up = <0x0b>;
					pinmux = <0x1500>;
					slew-rate = <0x00>;
				};
			};

			int_suspend {
				phandle = <0x17>;

				pins_cmd_dat {
					output-low;
					pinmux = <0x1500>;
					slew-rate = <0x01>;
				};
			};

			pins_default {
				phandle = <0x0e>;
			};

			reset1_active {
				phandle = <0x10>;

				pins_cmd_dat {
					output-high;
					pinmux = <0x1400>;
					slew-rate = <0x01>;
				};
			};

			reset1_suspend {
				phandle = <0x12>;

				pins_cmd_dat {
					output-low;
					pinmux = <0x1400>;
					slew-rate = <0x01>;
				};
			};

			reset_active {
				phandle = <0x16>;

				pins_cmd_dat {
					output-high;
					pinmux = <0x1400>;
					slew-rate = <0x01>;
				};
			};

			reset_suspend {
				phandle = <0x18>;

				pins_cmd_dat {
					output-low;
					pinmux = <0x1400>;
					slew-rate = <0x01>;
				};
			};

			spimode_default {
				phandle = <0x13>;

				pins_cmd_dat {
					drive-strength = <0x02>;
					pinmux = <0x1006 0x1106 0xcc06 0xcd06>;
				};
			};
		};
	};

	fragment@50 {
		target = <0xffffffff>;

		__overlay__ {
			GPIO_FDD_BAND_SUPPORT_DETECT_1ST_PIN = <0xffffffff 0x3f 0x00>;
			GPIO_FDD_BAND_SUPPORT_DETECT_2ND_PIN = <0xffffffff 0x40 0x00>;
			GPIO_FDD_BAND_SUPPORT_DETECT_3RD_PIN = <0xffffffff 0x41 0x00>;
			GPIO_FDD_BAND_SUPPORT_DETECT_4TH_PIN = <0xffffffff 0x42 0x00>;
			GPIO_SIM1_HOT_PLUG = <0xffffffff 0x2b 0x00>;
			GPIO_SIM1_SCLK = <0xffffffff 0x32 0x00>;
			GPIO_SIM1_SIO = <0xffffffff 0x30 0x00>;
			GPIO_SIM1_SRST = <0xffffffff 0x31 0x00>;
			GPIO_SIM2_SCLK = <0xffffffff 0x2d 0x00>;
			GPIO_SIM2_SIO = <0xffffffff 0x2f 0x00>;
			GPIO_SIM2_SRST = <0xffffffff 0x2e 0x00>;
		};
	};

	fragment@51 {
		target = <0xffffffff>;

		__overlay__ {
			gpio_init_default = <0x00 0x00 0x00 0x00 0x01 0x01 0x01 0x01 0x00 0x00 0x00 0x01 0x01 0x00 0x02 0x00 0x00 0x00 0x01 0x00 0x01 0x03 0x00 0x00 0x00 0x01 0x01 0x00 0x04 0x00 0x00 0x00 0x01 0x01 0x01 0x05 0x00 0x00 0x00 0x01 0x00 0x01 0x06 0x00 0x01 0x00 0x01 0x00 0x01 0x07 0x00 0x01 0x00 0x01 0x00 0x01 0x08 0x00 0x01 0x00 0x01 0x00 0x01 0x09 0x00 0x00 0x00 0x01 0x00 0x01 0x0a 0x00 0x01 0x00 0x01 0x00 0x00 0x0b 0x00 0x00 0x00 0x01 0x00 0x00 0x0c 0x00 0x00 0x00 0x01 0x00 0x00 0x0d 0x00 0x00 0x00 0x00 0x00 0x00 0x0e 0x00 0x01 0x01 0x01 0x00 0x00 0x0f 0x00 0x00 0x00 0x01 0x00 0x00 0x10 0x06 0x00 0x00 0x01 0x00 0x01 0x11 0x00 0x01 0x00 0x01 0x00 0x00 0x12 0x01 0x00 0x00 0x01 0x00 0x01 0x13 0x00 0x00 0x00 0x01 0x00 0x01 0x14 0x00 0x01 0x00 0x01 0x00 0x01 0x15 0x00 0x00 0x00 0x01 0x01 0x01 0x16 0x00 0x00 0x00 0x01 0x00 0x01 0x17 0x00 0x00 0x00 0x01 0x01 0x01 0x18 0x00 0x00 0x00 0x01 0x01 0x01 0x19 0x00 0x00 0x00 0x01 0x01 0x01 0x1a 0x00 0x01 0x00 0x01 0x00 0x01 0x1b 0x00 0x01 0x01 0x01 0x00 0x01 0x1c 0x00 0x01 0x01 0x01 0x00 0x00 0x1d 0x00 0x01 0x01 0x01 0x00 0x00 0x1e 0x00 0x01 0x00 0x01 0x00 0x01 0x1f 0x00 0x00 0x00 0x01 0x01 0x01 0x20 0x00 0x01 0x01 0x00 0x00 0x01 0x21 0x00 0x01 0x01 0x00 0x00 0x01 0x22 0x01 0x00 0x00 0x01 0x00 0x01 0x23 0x00 0x01 0x01 0x00 0x00 0x01 0x24 0x01 0x01 0x00 0x00 0x00 0x00 0x25 0x01 0x01 0x01 0x00 0x00 0x00 0x26 0x01 0x00 0x00 0x01 0x01 0x00 0x27 0x01 0x01 0x00 0x00 0x00 0x00 0x28 0x01 0x00 0x00 0x00 0x00 0x01 0x29 0x01 0x00 0x00 0x01 0x00 0x01 0x2a 0x01 0x00 0x00 0x00 0x00 0x00 0x2b 0x01 0x00 0x00 0x01 0x01 0x01 0x2c 0x00 0x00 0x00 0x01 0x00 0x01 0x2d 0x01 0x00 0x00 0x00 0x00 0x01 0x2e 0x01 0x00 0x00 0x00 0x00 0x01 0x2f 0x01 0x00 0x00 0x01 0x01 0x01 0x30 0x01 0x00 0x00 0x01 0x01 0x01 0x31 0x01 0x00 0x00 0x00 0x00 0x01 0x32 0x01 0x00 0x00 0x00 0x00 0x01 0x33 0x01 0x00 0x00 0x00 0x00 0x01 0x34 0x01 0x00 0x00 0x01 0x01 0x01 0x35 0x01 0x00 0x00 0x01 0x01 0x01 0x36 0x01 0x00 0x00 0x01 0x01 0x01 0x37 0x01 0x00 0x00 0x01 0x01 0x01 0x38 0x01 0x00 0x00 0x01 0x01 0x01 0x39 0x01 0x00 0x00 0x00 0x00 0x00 0x3a 0x01 0x00 0x00 0x01 0x00 0x00 0x3b 0x01 0x00 0x00 0x01 0x00 0x01 0x3c 0x01 0x00 0x00 0x01 0x00 0x01 0x3d 0x01 0x00 0x00 0x01 0x00 0x01 0x3e 0x01 0x00 0x00 0x01 0x00 0x01 0x3f 0x00 0x00 0x00 0x01 0x00 0x00 0x40 0x01 0x00 0x00 0x01 0x00 0x00 0x41 0x01 0x00 0x00 0x01 0x00 0x00 0x42 0x00 0x00 0x00 0x01 0x00 0x00 0x43 0x01 0x00 0x00 0x00 0x00 0x00 0x44 0x01 0x00 0x00 0x00 0x00 0x00 0x45 0x01 0x00 0x00 0x00 0x00 0x00 0x46 0x01 0x00 0x00 0x00 0x00 0x00 0x47 0x01 0x00 0x00 0x00 0x00 0x00 0x48 0x01 0x00 0x00 0x00 0x00 0x00 0x49 0x01 0x00 0x00 0x00 0x00 0x00 0x4a 0x01 0x00 0x00 0x00 0x00 0x00 0x4b 0x01 0x00 0x00 0x00 0x00 0x00 0x4c 0x01 0x00 0x00 0x00 0x00 0x00 0x4d 0x01 0x00 0x00 0x00 0x00 0x00 0x4e 0x01 0x00 0x00 0x00 0x00 0x00 0x4f 0x01 0x00 0x00 0x00 0x00 0x00 0x50 0x01 0x00 0x00 0x00 0x00 0x00 0x51 0x01 0x00 0x00 0x00 0x00 0x00 0x52 0x01 0x00 0x00 0x00 0x00 0x00 0x53 0x01 0x00 0x00 0x00 0x00 0x00 0x54 0x01 0x00 0x00 0x00 0x00 0x00 0x55 0x01 0x00 0x00 0x00 0x00 0x00 0x56 0x01 0x00 0x00 0x01 0x00 0x00 0x57 0x01 0x00 0x00 0x00 0x00 0x00 0x58 0x01 0x00 0x00 0x01 0x00 0x00 0x59 0x01 0x00 0x00 0x00 0x00 0x01 0x5a 0x01 0x00 0x00 0x00 0x00 0x01 0x5c 0x01 0x00 0x00 0x01 0x01 0x00 0x5d 0x01 0x00 0x00 0x00 0x00 0x00 0x5e 0x01 0x00 0x00 0x01 0x01 0x00 0x5f 0x01 0x00 0x00 0x00 0x00 0x00 0x60 0x07 0x00 0x00 0x01 0x00 0x00 0x61 0x07 0x00 0x00 0x01 0x00 0x00 0x62 0x07 0x00 0x00 0x01 0x00 0x00 0x63 0x07 0x00 0x00 0x00 0x00 0x00 0x64 0x07 0x00 0x00 0x01 0x00 0x00 0x65 0x07 0x00 0x00 0x01 0x00 0x00 0x66 0x07 0x00 0x00 0x01 0x00 0x00 0x67 0x07 0x00 0x00 0x00 0x00 0x00 0x68 0x07 0x00 0x00 0x01 0x00 0x00 0x69 0x07 0x00 0x00 0x01 0x00 0x00 0x6a 0x07 0x00 0x00 0x01 0x00 0x00 0x6b 0x07 0x00 0x00 0x01 0x00 0x00 0x6c 0x07 0x00 0x00 0x01 0x00 0x00 0x6d 0x07 0x00 0x00 0x01 0x00 0x00 0x6e 0x00 0x01 0x00 0x01 0x00 0x00 0x6f 0x00 0x01 0x00 0x01 0x00 0x00 0x70 0x00 0x01 0x00 0x01 0x00 0x00 0x71 0x00 0x01 0x00 0x01 0x00 0x00 0x72 0x02 0x00 0x00 0x01 0x00 0x00 0x73 0x02 0x00 0x00 0x00 0x00 0x00 0x74 0x02 0x00 0x00 0x00 0x00 0x00 0x75 0x02 0x00 0x00 0x00 0x00 0x00 0x76 0x02 0x00 0x00 0x01 0x01 0x01 0x77 0x02 0x00 0x00 0x01 0x01 0x01 0x78 0x01 0x00 0x00 0x01 0x01 0x01 0x79 0x01 0x00 0x00 0x01 0x01 0x01 0x7a 0x01 0x00 0x00 0x01 0x01 0x01 0x7b 0x01 0x00 0x00 0x01 0x01 0x01 0x7c 0x01 0x00 0x00 0x01 0x01 0x01 0x7d 0x01 0x00 0x00 0x01 0x01 0x01 0x7e 0x00 0x01 0x00 0x01 0x00 0x00 0x7f 0x00 0x01 0x00 0x01 0x00 0x00 0x80 0x00 0x01 0x00 0x01 0x00 0x00 0x81 0x00 0x01 0x00 0x01 0x00 0x00 0x82 0x01 0x00 0x00 0x01 0x00 0x00 0x83 0x01 0x00 0x00 0x00 0x00 0x00 0x84 0x01 0x00 0x00 0x01 0x00 0x00 0x85 0x00 0x01 0x00 0x01 0x00 0x00 0x86 0x00 0x01 0x00 0x01 0x00 0x00 0x87 0x00 0x01 0x00 0x01 0x00 0x00 0x88 0x01 0x00 0x00 0x00 0x00 0x00 0x89 0x00 0x01 0x00 0x01 0x00 0x00 0x8a 0x00 0x00 0x00 0x01 0x00 0x00 0x8b 0x01 0x00 0x00 0x01 0x01 0x01 0x8c 0x01 0x00 0x00 0x01 0x01 0x01 0x8d 0x01 0x00 0x00 0x01 0x01 0x01 0x8e 0x01 0x00 0x00 0x01 0x01 0x01 0x8f 0x00 0x01 0x00 0x01 0x00 0x00 0x90 0x00 0x01 0x00 0x01 0x00 0x00 0x91 0x00 0x01 0x00 0x01 0x00 0x00 0x92 0x00 0x01 0x00 0x01 0x00 0x00 0x93 0x00 0x01 0x00 0x01 0x00 0x00 0x94 0x00 0x01 0x00 0x01 0x00 0x00 0x95 0x01 0x00 0x00 0x00 0x00 0x00 0x96 0x01 0x00 0x00 0x00 0x00 0x00 0x97 0x01 0x00 0x00 0x00 0x00 0x00 0x98 0x00 0x00 0x00 0x01 0x00 0x00 0x99 0x01 0x00 0x00 0x01 0x00 0x00 0x9a 0x01 0x00 0x00 0x01 0x01 0x00 0x9b 0x01 0x00 0x00 0x01 0x01 0x00 0x9c 0x01 0x00 0x00 0x00 0x00 0x00 0x9d 0x01 0x00 0x00 0x00 0x00 0x00 0x9e 0x01 0x00 0x00 0x01 0x00 0x00 0x9f 0x01 0x00 0x00 0x00 0x00 0x00 0xa0 0x01 0x00 0x00 0x01 0x01 0x01 0xa1 0x01 0x00 0x00 0x01 0x01 0x01 0xa2 0x00 0x00 0x00 0x01 0x00 0x00 0xa3 0x00 0x00 0x00 0x01 0x00 0x00 0xa4 0x00 0x00 0x00 0x01 0x00 0x00 0xa5 0x01 0x00 0x00 0x01 0x00 0x00 0xa6 0x01 0x00 0x00 0x01 0x00 0x00 0xa7 0x00 0x00 0x00 0x01 0x00 0x00 0xa8 0x06 0x00 0x00 0x01 0x00 0x00 0xa9 0x06 0x00 0x00 0x01 0x00 0x00 0xaa 0x00 0x01 0x00 0x01 0x00 0x00 0xab 0x00 0x01 0x00 0x01 0x00 0x00 0xac 0x00 0x00 0x00 0x01 0x00 0x00 0xad 0x00 0x00 0x00 0x01 0x00 0x00 0xae 0x00 0x00 0x00 0x01 0x00 0x00 0xaf 0x00 0x00 0x00 0x01 0x00 0x00 0xb0 0x00 0x00 0x00 0x01 0x00 0x00 0xb1 0x00 0x00 0x00 0x01 0x00 0x00 0xb2 0x00 0x00 0x00 0x01 0x00 0x00 0xb3 0x00 0x00 0x00 0x01 0x00 0x00 0xb4 0x00 0x00 0x00 0x01 0x00 0x00 0xb5 0x00 0x00 0x00 0x01 0x00 0x00 0xb6 0x00 0x00 0x00 0x01 0x00 0x00 0xc3 0x01 0x00 0x00 0x00 0x00 0x01 0xc4 0x01 0x00 0x00 0x00 0x00 0x01 0xc5 0x01 0x00 0x00 0x00 0x00 0x01 0xc6 0x01 0x00 0x00 0x00 0x00 0x01 0xc7 0x01 0x00 0x00 0x01 0x00 0x01 0xc8 0x01 0x00 0x00 0x01 0x01 0x01 0xc9 0x01 0x00 0x00 0x01 0x01 0x01 0xca 0x01 0x00 0x00 0x01 0x01 0x01 0xcb 0x01 0x00 0x00 0x01 0x01 0x01 0xcc 0x01 0x00 0x00 0x01 0x01 0x01 0xcd 0x01 0x00 0x00 0x01 0x01 0x01 0xce 0x01 0x00 0x00 0x00 0x00 0x01 0xcf 0x01 0x00 0x00 0x00 0x00 0x01 0xd0 0x01 0x00 0x00 0x00 0x00 0x00 0xd1 0x01 0x00 0x00 0x01 0x00 0x00 0xd2 0x01 0x00 0x00 0x00 0x00 0x00 0xd3 0x01 0x00 0x00 0x01 0x00 0x00 0xd4 0x01 0x00 0x00 0x00 0x00 0x00 0xd5 0x01 0x00 0x00 0x01 0x00 0x01 0xd6 0x01 0x00 0x00 0x00 0x00 0x01 0xd7 0x01 0x00 0x00 0x00 0x00 0x01 0xd8 0x01 0x00 0x00 0x00 0x00 0x01 0xd9 0x01 0x00 0x00 0x00 0x00 0x01 0xda 0x01 0x00 0x00 0x01 0x00 0x01 0xdb 0x01 0x00 0x00 0x01 0x00 0x01 0xdc 0x00 0x00 0x00 0x01 0x00 0x00 0xdd 0x00 0x00 0x00 0x01 0x00 0x00 0xde 0x00 0x00 0x00 0x01 0x00 0x00 0xdf 0x00 0x00 0x00 0x01 0x00 0x00 0xe0 0x00 0x00 0x00 0x01 0x00 0x00 0xe1 0x00 0x00 0x00 0x01 0x00 0x00 0xe2 0x00 0x00 0x00 0x01 0x00 0x00 0xe3 0x00 0x00 0x00 0x01 0x00 0x00>;
		};
	};

	fragment@52 {
		target = <0xffffffff>;

		__overlay__ {
			deb-gpios = <0xffffffff 0x00 0x00>;
			debounce = <0x7d000>;
			interrupt-parent = <0xffffffff>;
			interrupts = <0x00 0x08 0x00 0x00>;
			status = "okay";
		};
	};

	fragment@53 {
		target = <0xffffffff>;

		__overlay__ {
			interrupt-parent = <0xffffffff>;
			interrupts = <0x0d 0x01 0x0d 0x00>;
			status = "okay";
		};
	};

	fragment@54 {
		target = <0xffffffff>;

		__overlay__ {
			interrupt-parent = <0xffffffff>;
			interrupts = <0x15 0x02 0x15 0x00>;
			status = "okay";
		};
	};

	fragment@55 {
		target = <0xffffffff>;

		__overlay__ {
			interrupt-parent = <0xffffffff>;
			interrupts = <0x18 0x02 0x18 0x00>;
			status = "okay";
		};
	};

	fragment@56 {
		target = <0xffffffff>;

		__overlay__ {
			interrupt-parent = <0xffffffff>;
			interrupts = <0x19 0x02 0x19 0x00>;
			status = "okay";
		};
	};

	fragment@57 {
		target = <0xffffffff>;

		__overlay__ {
			interrupt-parent = <0xffffffff>;
			interrupts = <0x1f 0x08 0x1f 0x00>;
			status = "okay";
		};
	};

	fragment@58 {
		target = <0xffffffff>;

		__overlay__ {
			compatible = "mediatek,md1_sim1_hot_plug_eint-eint";
			debounce = <0x00 0xc350>;
			dedicated = <0x00 0x00>;
			interrupts = <0x00 0x08>;
			sockettype = <0x00 0x00>;
			src_pin = <0x00 0x01>;
			status = "okay";
		};
	};

	fragment@59 {
		target = <0xffffffff>;

		__overlay__ {
			regulator-default-on = <0x01>;
			regulator-name = "vcamio";
			status = "okay";
		};
	};

	fragment@6 {
		target = <0xffffffff>;

		__overlay__ {

			focaltech@38 {
				avdd-supply = <0xffffffff>;
				compatible = "focaltech,focal";
				focaltech,avdd-load = <0x30d40>;
				focaltech,display-coords = <0x00 0x00 0x438 0x960>;
				focaltech,irq-gpio = <0xffffffff 0x15 0x00>;
				focaltech,lockdown-info-addr = <0x1e000>;
				focaltech,max-touch-number = <0x0a>;
				focaltech,open-min = <0xa8c>;
				focaltech,reset-gpio = <0xffffffff 0x14 0x00>;
				focaltech,reset-when-resume;
				interrupt-parent = <0xffffffff>;
				interrupts = <0x15 0x02 0x15 0x00>;
				pinctrl-0 = <0x1a 0x1b>;
				pinctrl-1 = <0x1c 0x1d>;
				pinctrl-names = "pmx_tp_active\0pmx_tp_suspend";
				reg = <0x38>;
				status = "ok";
			};
		};
	};

	fragment@60 {
		target = <0xffffffff>;

		__overlay__ {
			regulator-default-on = <0x01>;
			regulator-name = "vtp";
			status = "okay";
		};
	};

	fragment@61 {
		target = <0xffffffff>;

		__overlay__ {
			status = "okay";
			vcamaf-supply = <0xffffffff>;
			vcamaf_sub-supply = <0xffffffff>;
		};
	};

	fragment@62 {
		target = <0xffffffff>;

		__overlay__ {
			status = "okay";
			vtouch-supply = <0xffffffff>;
		};
	};

	fragment@63 {
		target = <0xffffffff>;

		__overlay__ {
			mediatek,kpd-hw-factory-key = <0x01>;
			mediatek,kpd-hw-init-map = <0x73 0x72 0x00 0x00 0x00 0x00 0x00 0x00 0x00 0x00 0x00 0x00 0x00 0x00 0x00 0x00 0x00 0x00 0x00 0x00 0x00 0x00 0x00 0x00 0x00 0x00 0x00 0x00 0x00 0x00 0x00 0x00 0x00 0x00 0x00 0x00 0x00 0x00 0x00 0x00 0x00 0x00 0x00 0x00 0x00 0x00 0x00 0x00 0x00 0x00 0x00 0x00 0x00 0x00 0x00 0x00 0x00 0x00 0x00 0x00 0x00 0x00 0x00 0x00 0x00 0x00 0x00 0x00 0x00 0x00 0x00 0x00>;
			mediatek,kpd-hw-map-num = <0x48>;
			mediatek,kpd-hw-pwrkey = <0x08>;
			mediatek,kpd-hw-recovery-key = <0x00>;
			mediatek,kpd-key-debounce = <0x400>;
			mediatek,kpd-pwkey-gpio-din = <0x00>;
			mediatek,kpd-pwrkey-eint-gpio = <0x00>;
			mediatek,kpd-sw-pwrkey = <0x74>;
			mediatek,kpd-use-extend-type = <0x00>;
			status = "okay";
		};
	};

	fragment@64 {
		target = <0xffffffff>;

		__overlay__ {
			ac_charger_current = <0x16e360>;
			ac_charger_input_current = <0x16e360>;
			charging_host_charger_current = <0x16e360>;
			max_charger_voltage = <0xdd40a0>;
			non_std_ac_charger_current = <0xf4240>;
			pd_charger_current = <0x16e360>;
			ta_ac_charger_current = <0x16e360>;
			usb_charger_current = <0x7a120>;
		};
	};

	fragment@65 {
		target = <0xffffffff>;

		__overlay__ {
			ac_charger_current = <0x1e8480>;
			ac_charger_input_current = <0x16e360>;
			algorithm_name = "SwitchCharging2";
			battery_cv = <0x43e6d0>;
			bc12_charger = <0x01>;
			charging_host_charger_current = <0x16e360>;
			current_a = <0x4371a0>;
			current_b = <0x35f480>;
			current_max = <0x5b8d80>;
			disable_soc_decimal;
			enable_cv_step;
			enable_ffc;
			enable_min_charge_temp;
			enable_sw_jeita;
			enable_vote;
			ffc_cv = <0x448310>;
			ffc_ieoc = <0x86470>;
			jeita_temp_above_t4_cv = <0x3e8fa0>;
			jeita_temp_below_t0_cv = <0x43e6d0>;
			jeita_temp_t0_to_t1_cv = <0x43e6d0>;
			jeita_temp_t1_to_t1p5_cv = <0x43e6d0>;
			jeita_temp_t1p5_to_t2_cv = <0x43e6d0>;
			jeita_temp_t2_to_t3_cv = <0x43e6d0>;
			jeita_temp_t3_to_t4_cv = <0x3e8fa0>;
			jeita_temp_tn1_to_t0_cv = <0x43e6d0>;
			max_charge_temp = <0x3c>;
			max_charge_temp_minus_x_degree = <0x3a>;
			max_charger_voltage = <0xdd40a0>;
			min_charge_temp = <0x00>;
			min_charge_temp_plus_x_degree = <0x02>;
			non_ffc_cv = <0x43e6d0>;
			non_ffc_ieoc = <0x30d40>;
			non_std_ac_charger_current = <0xf4240>;
			pd_vbus_upper_bound = <0x895440>;
			qcom,soc_decimal_rate = <0x00 0x26 0x0a 0x23 0x14 0x21 0x1e 0x21 0x28 0x21 0x32 0x21 0x3c 0x21 0x46 0x21 0x50 0x19 0x5a 0x14 0x5f 0x0a 0x63 0x05>;
			qcom,thermal-mitigation-dcp = <0x186a00 0x186a00 0x186a00 0x186a00 0x186a00 0x186a00 0x186a00 0x186a00 0x186a00 0x186a00 0x186a00 0x186a00 0x16e360 0x155cc0 0x124f80 0xf4240>;
			qcom,thermal-mitigation-pd-base = <0x3d0900 0x39fbc0 0x36ee80 0x3567e0 0x33e140 0x325aa0 0x30d400 0x2f4d60 0x2dc6c0 0x2ab980 0x27ac40 0x249f00 0x2191c0 0x1e8480 0xf4240 0xaae60>;
			qcom,thermal-mitigation-qc2 = <0x16e360 0x16e360 0x16e360 0x16e360 0x16e360 0x16e360 0x155cc0 0x13d620 0x124f80 0x10c8e0 0xf4240 0xdbba0 0xc3500 0xaae60 0x927c0 0x7a120>;
			qcom,thermal-mitigation-qc3 = <0x36ee80 0x36ee80 0x36ee80 0x3567e0 0x33e140 0x325aa0 0x30d400 0x2f4d60 0x2dc6c0 0x2ab980 0x27ac40 0x249f00 0x2191c0 0x1e8480 0xf4240 0xaae60>;
			qcom,thermal-mitigation-qc3-classb = <0x3d0900 0x3d0900 0x3d0900 0x3d0900 0x36ee80 0x3567e0 0x33e140 0x33e140 0x33e140 0x30d400 0x2625a0 0x2191c0 0x1e8480 0x13d620 0xf4240 0xaae60>;
			qcom,thermal-mitigation-qc3p5 = <0x3d0900 0x39fbc0 0x36ee80 0x3567e0 0x33e140 0x325aa0 0x30d400 0x2f4d60 0x2dc6c0 0x2ab980 0x27ac40 0x249f00 0x2191c0 0x1e8480 0xf4240 0xaae60>;
			step_a = <0x40d990>;
			step_b = <0x43e6d0>;
			step_hy_down_a = <0x249f0>;
			step_hy_down_b = <0x249f0>;
			temp_neg_10_thres = <0xfffffff6>;
			temp_t0_thres = <0x00>;
			temp_t0_thres_plus_x_degree = <0xfffffffe>;
			temp_t0_to_t1_fcc = <0xd7d20>;
			temp_t1_thres = <0x05>;
			temp_t1_thres_plus_x_degree = <0x02>;
			temp_t1_to_t1p5_fcc = <0x21b8d0>;
			temp_t1p5_thres = <0x0a>;
			temp_t1p5_thres_plus_x_degree = <0x08>;
			temp_t1p5_to_t2_fcc = <0x35f480>;
			temp_t2_thres = <0x0f>;
			temp_t2_thres_plus_x_degree = <0x0d>;
			temp_t2_to_t3_fcc = "\0=\t";
			temp_t3_thres = <0x30>;
			temp_t3_thres_minus_x_degree = <0x2f>;
			temp_t3_to_t4_fcc = <0x21b8d0>;
			temp_t4_thres = <0x3c>;
			temp_t4_thres_minus_x_degree = <0x3a>;
			temp_tn1_thres = <0xfffffff6>;
			temp_tn1_thres_plus_x_degree = <0xfffffff6>;
			temp_tn1_to_t0_fcc = <0x6be90>;
			use_xmusb350_do_apsd;
			xm_pps_dual_charger_chg1_current = <0x7a120>;
			xm_pps_dual_charger_chg2_current = <0x2625a0>;
			xm_pps_dual_charger_input_current = <0x2dc6c0>;
			xm_pps_max_ibus = <0x2dc6c0>;
			xm_pps_max_vbus = <0xb71b00>;
			xm_pps_single_charger_current = <0x5b8d80>;
			xm_pps_single_charger_current_non_verified_pps = "\0I>";
			xm_pps_single_charger_input_current = <0x2dc6c0>;
		};
	};

	fragment@66 {
		target = <0xffffffff>;

		__overlay__ {

			chg {
				cv = <0x43e6d0>;
				ieoc = <0x30d40>;
			};
		};
	};

	fragment@67 {
		target = <0xffffffff>;

		__overlay__ {

			simtray {
				compatible = "xiaomi,simtray-status";
				status-gpio = <0xffffffff 0x2b 0x00>;
			};
		};
	};

	fragment@68 {
		target = <0xffffffff>;

		__overlay__ {

			bq2597x_int_default {
				phandle = <0x7d>;

				pins_cmd_dat {
					bias-pull-up = <0x0b>;
					pinmux = <0x300>;
					slew-rate = <0x00>;
				};
			};

			bq2597x_int_suspend {
				phandle = <0x7e>;

				pins_cmd_dat {
					bias-pull-up = <0x0b>;
					pinmux = <0x300>;
					slew-rate = <0x00>;
				};
			};

			xmusb350_int_isp {
				phandle = <0xa5>;

				pins_cmd_dat {
					bias-pull-up = <0x0b>;
					input-enable;
					pinmux = <0x100>;
					slew-rate = <0x00>;
				};
			};

			xmusb350_int_normal {
				phandle = <0xa4>;

				pins_cmd_dat {
					bias-pull-up = <0x0b>;
					input-enable;
					pinmux = <0x100>;
					slew-rate = <0x00>;
				};
			};

			xmusb350_rst_isp {
				phandle = <0x82>;

				pins_cmd_dat {
					bias-disable;
					output-low;
					pinmux = <0x7e00>;
					slew-rate = <0x01>;
				};
			};

			xmusb350_rst_normal {
				phandle = <0x7f>;

				pins_cmd_dat {
					bias-disable;
					output-low;
					pinmux = <0x7e00>;
					slew-rate = <0x01>;
				};
			};

			xmusb350_scl_isp {
				phandle = <0x84>;

				pins_cmd_dat {
					bias-disable;
					output-low;
					pinmux = <0x7800>;
					slew-rate = <0x01>;
				};
			};

			xmusb350_scl_normal {
				phandle = <0x81>;

				pins_cmd_dat {
					bias-pull-up = <0x0b>;
					input-enable;
					pinmux = <0x7801>;
					slew-rate = <0x00>;
				};
			};

			xmusb350_sda_isp {
				phandle = <0x83>;

				pins_cmd_dat {
					bias-disable;
					output-low;
					pinmux = <0x7900>;
					slew-rate = <0x01>;
				};
			};

			xmusb350_sda_normal {
				phandle = <0x80>;

				pins_cmd_dat {
					bias-pull-up = <0x0b>;
					input-enable;
					pinmux = <0x7901>;
					slew-rate = <0x00>;
				};
			};
		};
	};

	fragment@69 {
		target = <0xffffffff>;

		__overlay__ {
			clock-frequency = <0x186a0>;

			bq2597x-standalone@66 {
				compatible = "ti,bq2597x-standalone";
				interrupt-parent = <0xffffffff>;
				interrupts = <0x03 0x02 0x03 0x00>;
				pinctrl-0 = <0x7d 0x7e>;
				pinctrl-names = "default";
				reg = <0x66>;
				sc8551,ac-ovp-threshold = <0x0d>;
				ti,bq2597x,ac-ovp-threshold = <0x0e>;
				ti,bq2597x,bat-ocp-alarm-threshold = <0x1770>;
				ti,bq2597x,bat-ocp-threshold = <0x1b58>;
				ti,bq2597x,bat-ovp-alarm-disable;
				ti,bq2597x,bat-ovp-alarm-threshold = <0x1180>;
				ti,bq2597x,bat-ovp-threshold = <0x11ad>;
				ti,bq2597x,bat-therm-disable;
				ti,bq2597x,bat-therm-threshold = <0x15>;
				ti,bq2597x,bat-ucp-alarm-disable;
				ti,bq2597x,bat-ucp-disable;
				ti,bq2597x,bus-ocp-alarm-threshold = <0xdac>;
				ti,bq2597x,bus-ocp-threshold = <0xea6>;
				ti,bq2597x,bus-ovp-alarm-threshold = <0x2af8>;
				ti,bq2597x,bus-ovp-threshold = <0x2ee0>;
				ti,bq2597x,bus-therm-disable;
				ti,bq2597x,bus-therm-threshold = <0x15>;
				ti,bq2597x,die-therm-disable;
				ti,bq2597x,die-therm-threshold = <0x91>;
				ti,bq2597x,sense-resistor-mohm = <0x05>;
			};

			xmusb350-charger@35 {
				alias_name = "xmusb350";
				charger_name = "secondary_chg";
				compatible = "xm,xmusb350-charger";
				en_bc12;
				en_hvdcp;
				en_intb;
				en_sleep;
				interrupt-parent = <0xffffffff>;
				interrupts = <0x01 0x02 0x01 0x00>;
				mi,connect_therm = <0xffffffff 0x7f 0x00>;
				pinctrl-0 = <0x7f 0x80 0x81>;
				pinctrl-1 = <0x82 0x83 0x84>;
				pinctrl-names = "xmusb350_normal\0xmusb350_isp";
				reg = <0x35>;
				xm,xmusb350_rst_gpio = <0xffffffff 0x7e 0x00>;
				xm,xmusb350_scl_gpio = <0xffffffff 0x78 0x00>;
				xm,xmusb350_sda_gpio = <0xffffffff 0x79 0x00>;
			};
		};
	};

	fragment@7 {
		target = <0xffffffff>;

		__overlay__ {

			tp_int_active {
				phandle = <0x1a>;

				pins_cmd_dat {
					bias-pull-up = <0x0b>;
					pinmux = <0x1500>;
					slew-rate = <0x00>;
				};
			};

			tp_int_suspend {
				phandle = <0x1c>;

				pins_cmd_dat {
					input-enable;
					pinmux = <0x1500>;
					slew-rate = <0x01>;
				};
			};

			tp_reset_active {
				phandle = <0x1b>;

				pins_cmd_dat {
					bias-pull-up;
					drive-strength = <0x02>;
					pinmux = <0x1400>;
					slew-rate = <0x01>;
				};
			};

			tp_reset_suspend {
				phandle = <0x1d>;

				pins_cmd_dat {
					bias-disable;
					pinmux = <0x1400>;
					slew-rate = <0x01>;
				};
			};
		};
	};

	fragment@70 {
		target = <0xffffffff>;

		__overlay__ {
			compatible = "xiaomi,cp-qc30";
			mi,qc3-27w-bat-curr-max = <0xe10>;
			mi,qc3-27w-bus-curr-max = <0x76c>;
			mi,qc3-bat-curr-max = <0xe10>;
			mi,qc3-bat-volt-max = <0x1180>;
			mi,qc3-bus-curr-max = <0x834>;
			mi,qc3-bus-volt-max = <0x2ee0>;
			mi,qc3-non-ffc-bat-volt-max = <0x1162>;
			mi,qc3p-bat-curr-max = <0xfa0>;
			mi,qc3p-bus-curr-max = <0x834>;
			status = "okay";
		};
	};

	fragment@71 {
		target = <0xffffffff>;

		__overlay__ {
			compatible = "xiaomi,usbpd-pm";
			mi,pd-bat-curr-max = <0xfa0>;
			mi,pd-bat-volt-max = <0x1180>;
			mi,pd-bus-curr-max = <0xbb8>;
			mi,pd-bus-volt-max = <0x2ee0>;
			mi,pd-non-ffc-bat-volt-max = <0x1162>;
			status = "okay";
		};
	};

	fragment@72 {
		target = <0xffffffff>;

		__overlay__ {
			compatible = "xiaomi-touch";
			status = "ok";
			touch,name = "xiaomi-touch";
		};
	};

	fragment@73 {
		target = <0xffffffff>;

		__overlay__ {
			mi,non-mtk-pps-ctrl;
		};
	};

	fragment@74 {
		target = <0xffffffff>;

		__overlay__ {
			board-sensor = "VIRTUAL-SENSOR";
		};
	};

	fragment@75 {
		target = <0xffffffff>;

		__overlay__ {

			usb_phy_tuning {
				compatible = "mediatek,phy_tuning";
				u2_discth = <0x07>;
				u2_enhance = <0x01>;
				u2_intr_cal = <0x1e>;
				u2_term_ref = <0x02>;
				u2_vrt_ref = <0x02>;
			};
		};
	};

	fragment@76 {
		target = <0xffffffff>;

		__overlay__ {
			battery0_profile_t0 = <0x00 0xac26 0x3b6 0x1c7 0xaba5 0x3b6 0x38f 0xab2e 0x3c3 0x556 0xaabd 0x3cf 0x71d 0xaa4b 0x3cf 0x8e4 0xa9d9 0x3cf 0xaac 0xa96d 0x3dd 0xc73 0xa8ff 0x3e8 0xe3a 0xa88d 0x3e8 0x1001 0xa81c 0x3e8 0x11c9 0xa7a4 0x3e8 0x1390 0xa72b 0x3e8 0x1557 0xa6b1 0x3e8 0x171e 0xa638 0x3e8 0x18e6 0xa5be 0x3e8 0x1aad 0xa545 0x412 0x1c74 0xa4cd 0x464 0x1e3b 0xa454 0x405 0x2003 0xa3df 0x3f5 0x21ca 0xa36b 0x401 0x2391 0xa2f1 0x400 0x2558 0xa278 0x3ed 0x2720 0xa204 0x3f6 0x28e7 0xa192 0x401 0x2aae 0xa121 0x403 0x2c75 0xa0b7 0x416 0x2e3d 0xa047 0x40b 0x3004 0x9fd9 0x40a 0x31cb 0x9f6e 0x41a 0x3392 0x9f04 0x41a 0x355a 0x9ea0 0x42a 0x3721 0x9e3b 0x429 0x38e8 0x9dd3 0x41d 0x3aaf 0x9d70 0x430 0x3c77 0x9d14 0x443 0x3e3e 0x9cb9 0x44c 0x4005 0x9c5e 0x450 0x41cc 0x9c03 0x463 0x4394 0x9ba1 0x476 0x455b 0x9b3f 0x489 0x4722 0x9ad4 0x492 0x48e9 0x9a53 0x47f 0x4ab1 0x99bc 0x436 0x4c78 0x993d 0x40e 0x4e3f 0x98d2 0x3fb 0x5006 0x9877 0x3e8 0x51ce 0x982b 0x3e8 0x5395 0x97e4 0x3e8 0x555c 0x97a2 0x3e8 0x5723 0x9766 0x3e8 0x58eb 0x9729 0x3e8 0x5ab2 0x96ec 0x3e8 0x5c79 0x96b3 0x3e8 0x5e40 0x967e 0x3e8 0x6008 0x9648 0x3e8 0x61cf 0x9619 0x3e8 0x6396 0x95e8 0x3e8 0x655d 0x95b4 0x3e8 0x6725 0x9587 0x3e8 0x68ec 0x955f 0x3f7 0x6ab3 0x9539 0x401 0x6c7a 0x9513 0x404 0x6e42 0x94ee 0x417 0x7009 0x94c8 0x41a 0x71d0 0x94a2 0x424 0x7397 0x947c 0x433 0x755f 0x9456 0x433 0x7726 0x942a 0x433 0x78ed 0x93e7 0x41e 0x7ab4 0x9393 0x3f8 0x7c7c 0x9340 0x3d2 0x7e43 0x9310 0x3f2 0x800a 0x92de 0x401 0x81d1 0x92a8 0x401 0x8399 0x9273 0x401 0x8560 0x923e 0x401 0x8727 0x9213 0x40d 0x88ee 0x91eb 0x41a 0x8ab6 0x91bd 0x41a 0x8c7d 0x9188 0x42d 0x8e44 0x9143 0x418 0x900b 0x90fd 0x408 0x91d3 0x90bf 0x41a 0x939a 0x907b 0x41a 0x9561 0x902b 0x3e1 0x9728 0x8ff2 0x3be 0x98f0 0x8fdd 0x3d5 0x9ab7 0x8fd6 0x40e 0x9c7e 0x8fc8 0x465 0x9e45 0x8fb5 0x4c4 0xa00d 0x8f90 0x50e 0xa1d4 0x8f1e 0x4e8 0xa39b 0x8dde 0x484 0xa562 0x8c25 0x469 0xa72a 0x89ee 0x4a1 0xa8f1 0x86f8 0x4da 0xaab8 0x821b 0x586 0xac7f 0x78b1 0xc93 0xae47 0x6fea 0x672 0xb00e 0x6fea 0x672>;
			battery0_profile_t0_col = <0x03>;
			battery0_profile_t0_num = <0x64>;
			battery0_profile_t1 = <0x00 0xac62 0x4b0 0x1c7 0xabf8 0x4b0 0x38f 0xab8e 0x4bd 0x556 0xab23 0x4c2 0x71d 0xaab9 0x4b1 0x8e4 0xaa57 0x4c4 0xaac 0xa9ef 0x4c9 0xc73 0xa981 0x4c1 0xe3a 0xa90f 0x4b0 0x1001 0xa89e 0x4b0 0x11c9 0xa82c 0x4bf 0x1390 0xa7b7 0x4c0 0x1557 0xa73d 0x4b0 0x171e 0xa6c4 0x4b0 0x18e6 0xa64a 0x4b0 0x1aad 0xa5d1 0x4e2 0x1c74 0xa559 0x545 0x1e3b 0xa4e0 0x4d3 0x2003 0xa466 0x4b0 0x21ca 0xa3f0 0x4b7 0x2391 0xa37d 0x4c9 0x2558 0xa304 0x4c9 0x2720 0xa290 0x4d7 0x28e7 0xa21e 0x4e2 0x2aae 0xa1ac 0x4e4 0x2c75 0xa13b 0x4f7 0x2e3d 0xa0c9 0x4ec 0x3004 0xa05b 0x4eb 0x31cb 0x9fef 0x4fb 0x3392 0x9f7d 0x4fb 0x355a 0x9f12 0x4fb 0x3721 0x9eac 0x50e 0x38e8 0x9e4b 0x52d 0x3aaf 0x9de8 0x52d 0x3c77 0x9d86 0x53d 0x3e3e 0x9d23 0x550 0x4005 0x9cc2 0x567 0x41cc 0x9c67 0x58d 0x4394 0x9c05 0x5a2 0x455b 0x9ba3 0x5b5 0x4722 0x9b3c 0x5be 0x48e9 0x9aca 0x5ab 0x4ab1 0x9a43 0x574 0x4c78 0x99b5 0x518 0x4e3f 0x9931 0x4c3 0x5006 0x98c7 0x4b0 0x51ce 0x9873 0x4b0 0x5395 0x9825 0x4a3 0x555c 0x97dc 0x497 0x5723 0x9798 0x497 0x58eb 0x975b 0x497 0x5ab2 0x971e 0x497 0x5c79 0x96e2 0x48f 0x5e40 0x96a6 0x481 0x6008 0x9679 0x4a7 0x61cf 0x9645 0x4a1 0x6396 0x9614 0x4a0 0x655d 0x95e6 0x4b0 0x6725 0x95b9 0x4b0 0x68ec 0x958b 0x4b0 0x6ab3 0x9561 0x4b9 0x6c7a 0x953b 0x4c9 0x6e42 0x9516 0x4c9 0x7009 0x94f0 0x4c9 0x71d0 0x94ce 0x4d3 0x7397 0x94ae 0x4e2 0x755f 0x9488 0x4e2 0x7726 0x9469 0x4f3 0x78ed 0x9447 0x4fb 0x7ab4 0x9421 0x4fb 0x7c7c 0x93fb 0x4fb 0x7e43 0x93c0 0x4c6 0x800a 0x938c 0x4b0 0x81d1 0x935f 0x4b0 0x8399 0x9331 0x4b0 0x8560 0x92fc 0x49e 0x8727 0x92cc 0x497 0x88ee 0x92a1 0x49d 0x8ab6 0x927b 0x4b0 0x8c7d 0x924e 0x4b0 0x8e44 0x921b 0x4b0 0x900b 0x91e0 0x4a9 0x91d3 0x919c 0x497 0x939a 0x915f 0x497 0x9561 0x9123 0x4a5 0x9728 0x90d9 0x4a0 0x98f0 0x9085 0x47e 0x9ab7 0x9066 0x47e 0x9c7e 0x905a 0x48d 0x9e45 0x904f 0x4a9 0xa00d 0x903e 0x4d5 0xa1d4 0x9028 0x521 0xa39b 0x8feb 0x56c 0xa562 0x8f26 0x54e 0xa72a 0x8dbd 0x4ec 0xa8f1 0x8bb9 0x525 0xaab8 0x88ea 0x57f 0xac7f 0x84c7 0x631 0xae47 0x7dc9 0xa01 0xb00e 0x7242 0xc67>;
			battery0_profile_t1_col = <0x03>;
			battery0_profile_t1_num = <0x64>;
			battery0_profile_t2 = <0x00 0xac94 0x6c2 0x1c7 0xac1b 0x6be 0x38f 0xabb1 0x6ca 0x556 0xab4b 0x6cf 0x71d 0xaae1 0x6bd 0x8e4 0xaa7f 0x6bd 0xaac 0xaa1c 0x6cb 0xc73 0xa9b3 0x6ce 0xe3a 0xa941 0x6bd 0x1001 0xa8d0 0x6bd 0x11c9 0xa85e 0x6bd 0x1390 0xa7e9 0x6b4 0x1557 0xa76f 0x6a4 0x171e 0xa6f6 0x6a4 0x18e6 0xa67c 0x6a4 0x1aad 0xa603 0x6e7 0x1c74 0xa58b 0x76b 0x1e3b 0xa512 0x6d3 0x2003 0xa498 0x6a4 0x21ca 0xa41f 0x6a4 0x2391 0xa3a6 0x6a5 0x2558 0xa334 0x6b8 0x2720 0xa2bd 0x6af 0x28e7 0xa246 0x6ac 0x2aae 0xa1d4 0x6bd 0x2c75 0xa163 0x6bd 0x2e3d 0xa0f1 0x6cc 0x3004 0xa07f 0x6d6 0x31cb 0xa00e 0x6d9 0x3392 0x9fa4 0x6ec 0x355a 0x9f40 0x70e 0x3721 0x9ede 0x72b 0x38e8 0x9e7c 0x741 0x3aaf 0x9e12 0x766 0x3c77 0x9da7 0x77c 0x3e3e 0x9d41 0x78f 0x4005 0x9cdd 0x79e 0x41cc 0x9c73 0x79e 0x4394 0x9c16 0x7af 0x455b 0x9bb2 0x7b7 0x4722 0x9b44 0x7ad 0x48e9 0x9acb 0x787 0x4ab1 0x9a3c 0x72b 0x4c78 0x99b0 0x6cc 0x4e3f 0x9931 0x67f 0x5006 0x98c7 0x659 0x51ce 0x986c 0x646 0x5395 0x981b 0x640 0x555c 0x97d2 0x640 0x5723 0x978d 0x63f 0x58eb 0x9749 0x62c 0x5ab2 0x970a 0x627 0x5c79 0x96d1 0x62f 0x5e40 0x969c 0x640 0x6008 0x9666 0x640 0x61cf 0x9631 0x640 0x6396 0x9600 0x649 0x655d 0x95d2 0x659 0x6725 0x95a5 0x659 0x68ec 0x9577 0x668 0x6ab3 0x954d 0x672 0x6c7a 0x9526 0x672 0x6e42 0x94f9 0x672 0x7009 0x94d9 0x682 0x71d0 0x94b6 0x695 0x7397 0x9492 0x6a4 0x755f 0x9474 0x6a4 0x7726 0x944f 0x6a4 0x78ed 0x942d 0x6af 0x7ab4 0x940f 0x6bd 0x7c7c 0x93f0 0x6bd 0x7e43 0x93d2 0x6bd 0x800a 0x93af 0x6b1 0x81d1 0x9387 0x69e 0x8399 0x9359 0x68b 0x8560 0x9324 0x666 0x8727 0x92f4 0x659 0x88ee 0x92c9 0x65f 0x8ab6 0x92a3 0x672 0x8c7d 0x927d 0x685 0x8e44 0x924d 0x698 0x900b 0x9212 0x6a4 0x91d3 0x91ce 0x6a5 0x939a 0x9191 0x6b8 0x9561 0x914f 0x6d9 0x9728 0x9101 0x6ef 0x98f0 0x90ab 0x6ef 0x9ab7 0x907d 0x6ef 0x9c7e 0x9068 0x71c 0x9e45 0x9059 0x75e 0xa00d 0x9047 0x7a7 0xa1d4 0x9029 0x7e0 0xa39b 0x8ff2 0x847 0xa562 0x8f43 0x889 0xa72a 0x8df9 0x8b0 0xa8f1 0x8bf5 0x935 0xaab8 0x892c 0xa1d 0xac7f 0x8526 0xbd9 0xae47 0x7e6b 0x106b 0xb00e 0x70f8 0x979>;
			battery0_profile_t2_col = <0x03>;
			battery0_profile_t2_num = <0x64>;
			battery0_profile_t3 = <0x00 0xac9e 0xa46 0x1c7 0xac1d 0xa42 0x38f 0xabac 0xa4e 0x556 0xab41 0xa53 0x71d 0xaad7 0xa42 0x8e4 0xaa75 0xa55 0xaac 0xaa0d 0xa4c 0xc73 0xa9a2 0xa41 0xe3a 0xa937 0xa41 0x1001 0xa8c6 0xa41 0x11c9 0xa854 0xa32 0x1390 0xa7df 0xa1f 0x1557 0xa765 0xa0f 0x171e 0xa6ec 0xa0f 0x18e6 0xa672 0x9ff 0x1aad 0xa5f9 0xa5b 0x1c74 0xa581 0xb20 0x1e3b 0xa508 0xa3c 0x2003 0xa48e 0x9e9 0x21ca 0xa415 0x9dd 0x2391 0xa39c 0x9dd 0x2558 0xa32a 0x9dd 0x2720 0xa2b3 0x9dd 0x28e7 0xa23c 0x9e5 0x2aae 0xa1ca 0x9f8 0x2c75 0xa159 0xa0b 0x2e3d 0xa0e7 0xa0f 0x3004 0xa079 0xa18 0x31cb 0xa00e 0xa2b 0x3392 0x9fa4 0xa3e 0x355a 0x9f3a 0xa51 0x3721 0x9ed1 0xa6d 0x38e8 0x9e68 0xa93 0x3aaf 0x9dfe 0xab8 0x3c77 0x9d8d 0xace 0x3e3e 0x9d1f 0xad7 0x4005 0x9cb5 0xad7 0x41cc 0x9c4b 0xad7 0x4394 0x9bda 0xaa4 0x455b 0x9b68 0xa76 0x4722 0x9af2 0xa4b 0x48e9 0x9a71 0xa12 0x4ab1 0x99f0 0x9c7 0x4c78 0x9979 0x993 0x4e3f 0x9909 0x967 0x5006 0x989f 0x92e 0x51ce 0x984b 0x92e 0x5395 0x97f8 0x921 0x555c 0x97aa 0x915 0x5723 0x9765 0x914 0x58eb 0x9721 0x901 0x5ab2 0x96e2 0x90a 0x5c79 0x96a9 0x91d 0x5e40 0x9674 0x92e 0x6008 0x963e 0x92e 0x61cf 0x9609 0x93d 0x6396 0x95d4 0x947 0x655d 0x95a0 0x949 0x6725 0x9573 0x95c 0x68ec 0x9545 0x960 0x6ab3 0x951b 0x969 0x6c7a 0x94f5 0x97c 0x6e42 0x94d0 0x98f 0x7009 0x94aa 0x9a2 0x71d0 0x9488 0x9b5 0x7397 0x9468 0x9c8 0x755f 0x9442 0x9db 0x7726 0x9423 0x9dd 0x78ed 0x9405 0x9e8 0x7ab4 0x93e8 0x9fb 0x7c7c 0x93d2 0xa0e 0x7e43 0x93bb 0xa21 0x800a 0x93a4 0xa34 0x81d1 0x938b 0xa47 0x8399 0x936d 0xa5a 0x8560 0x9347 0xa6c 0x8727 0x931c 0xa7f 0x88ee 0x92ef 0xa99 0x8ab6 0x92c1 0xabf 0x8c7d 0x9294 0xaf8 0x8e44 0x925b 0xb31 0x900b 0x9219 0xb71 0x91d3 0x91ce 0xbbe 0x939a 0x9191 0xc1d 0x9561 0x9149 0xc8a 0x9728 0x90f3 0xcf4 0x98f0 0x9097 0xd59 0x9ab7 0x9069 0xdf1 0x9c7e 0x9048 0xe98 0x9e45 0x902a 0xf5e 0xa00d 0x900a 0x104a 0xa1d4 0x8fe4 0x1167 0xa39b 0x8fa5 0x12ee 0xa562 0x8ef3 0x1482 0xa72a 0x8da6 0x1656 0xa8f1 0x8b93 0x1960 0xaab8 0x88a7 0x1ec9 0xac7f 0x84a1 0x29d5 0xae47 0x7ece 0x2bd6 0xb00e 0x780a 0x1af4>;
			battery0_profile_t3_col = <0x03>;
			battery0_profile_t3_num = <0x64>;
			battery0_profile_t4 = <0x00 0xacbc 0x127a 0x1c7 0xac1d 0x1276 0x38f 0xab92 0x128f 0x556 0xab17 0x12a0 0x71d 0xaaa5 0x128e 0x8e4 0xaa33 0x128e 0xaac 0xa9c1 0x1280 0xc73 0xa94f 0x1275 0xe3a 0xa8dd 0x1270 0x1001 0xa863 0x1237 0x11c9 0xa7f0 0x121b 0x1390 0xa77e 0x1208 0x1557 0xa70b 0x11f5 0x171e 0xa692 0x11e2 0x18e6 0xa618 0x11cf 0x1aad 0xa59f 0x125d 0x1c74 0xa527 0x1385 0x1e3b 0xa4ae 0x1209 0x2003 0xa439 0x1194 0x21ca 0xa3c8 0x1194 0x2391 0xa355 0x1193 0x2558 0xa2dc 0x1180 0x2720 0xa268 0x117b 0x28e7 0xa1f6 0x117b 0x2aae 0xa184 0x117b 0x2c75 0xa113 0x117b 0x2e3d 0xa0a1 0x117b 0x3004 0xa033 0x1184 0x31cb 0x9fc9 0x119c 0x3392 0x9f67 0x11d5 0x355a 0x9ef8 0x11ef 0x3721 0x9e83 0x1202 0x38e8 0x9e0b 0x120e 0x3aaf 0x9d92 0x11fb 0x3c77 0x9d18 0x11e8 0x3e3e 0x9c9f 0x11c1 0x4005 0x9c26 0x118c 0x41cc 0x9bac 0x1166 0x4394 0x9b33 0x111e 0x455b 0x9abe 0x10e8 0x4722 0x9a4c 0x10c2 0x48e9 0x99da 0x109c 0x4ab1 0x9970 0x1076 0x4c78 0x9905 0x1050 0x4e3f 0x98a0 0x1036 0x5006 0x9845 0x1036 0x51ce 0x97f1 0x1036 0x5395 0x97a3 0x1036 0x555c 0x9757 0x102f 0x5723 0x970c 0x101e 0x58eb 0x96cf 0x1044 0x5ab2 0x9692 0x105d 0x5c79 0x9656 0x1070 0x5e40 0x961a 0x1083 0x6008 0x95e4 0x1096 0x61cf 0x95af 0x10b7 0x6396 0x957e 0x10d5 0x655d 0x9550 0x10ea 0x6725 0x9523 0x1110 0x68ec 0x94fb 0x1136 0x6ab3 0x94d1 0x1152 0x6c7a 0x94a7 0x1169 0x6e42 0x9489 0x118e 0x7009 0x946b 0x11c4 0x71d0 0x944c 0x11e9 0x7397 0x942f 0x1203 0x755f 0x9419 0x123c 0x7726 0x9409 0x1286 0x78ed 0x93f9 0x12d2 0x7ab4 0x93e8 0x1322 0x7c7c 0x93d2 0x1381 0x7e43 0x93bb 0x13ce 0x800a 0x93a4 0x1432 0x81d1 0x938b 0x149e 0x8399 0x936d 0x14fd 0x8560 0x9347 0x1580 0x8727 0x9321 0x15f9 0x88ee 0x92f9 0x1677 0x8ab6 0x92cb 0x1710 0x8c7d 0x928e 0x17ba 0x8e44 0x924c 0x1865 0x900b 0x9205 0x1917 0x91d3 0x91b9 0x19d7 0x939a 0x9175 0x1abb 0x9561 0x9125 0x1bad 0x9728 0x90cf 0x1cb4 0x98f0 0x9077 0x1dd5 0x9ab7 0x903a 0x1f17 0x9c7e 0x9010 0x2096 0x9e45 0x8fea 0x2264 0xa00d 0x8fc4 0x2492 0xa1d4 0x8f9e 0x2750 0xa39b 0x8f5f 0x2aff 0xa562 0x8ec0 0x2fd3 0xa72a 0x8d94 0x36bf 0xa8f1 0x8b88 0x42c0 0xaab8 0x88f7 0x4525 0xac7f 0x858e 0x3cd2 0xae47 0x858e 0x3cbe 0xb00e 0x858e 0x3cbe>;
			battery0_profile_t4_col = <0x03>;
			battery0_profile_t4_num = <0x64>;
			battery1_profile_t0 = <0x00 0xac1c 0x3e8 0x1cb 0xabb1 0x3e8 0x396 0xab46 0x3e8 0x562 0xaadb 0x3e8 0x72d 0xaa6f 0x3e8 0x8f8 0xaa04 0x3e8 0xac3 0xa999 0x3f7 0xc8e 0xa927 0x3f8 0xe5a 0xa8af 0x3eb 0x1025 0xa844 0x3fe 0x11f0 0xa7cb 0x401 0x13bb 0xa751 0x401 0x1586 0xa6d7 0x401 0x1751 0xa65c 0x401 0x191d 0xa5e2 0x401 0x1ae8 0xa567 0x441 0x1cb3 0xa4ea 0x481 0x1e7e 0xa468 0x3fb 0x2049 0xa3ed 0x3f8 0x2215 0xa376 0x40c 0x23e0 0xa302 0x41a 0x25ab 0xa287 0x41a 0x2776 0xa20d 0x408 0x2941 0xa197 0x40d 0x2b0d 0xa124 0x41a 0x2cd8 0xa0b2 0x41a 0x2ea3 0xa03f 0x41a 0x306e 0x9fd1 0x41a 0x3239 0x9f63 0x41a 0x3405 0x9ef1 0x41a 0x35d0 0x9e86 0x41a 0x379b 0x9e21 0x429 0x3966 0x9dbd 0x43c 0x3b31 0x9d5a 0x44c 0x3cfd 0x9cf6 0x44c 0x3ec8 0x9c9a 0x45d 0x4093 0x9c39 0x465 0x425e 0x9bda 0x474 0x4429 0x9b86 0x4ad 0x45f4 0x9b1a 0x4b0 0x47c0 0x9aa4 0x4a3 0x498b 0x9a1c 0x474 0x4b56 0x997d 0x419 0x4d21 0x9903 0x406 0x4eec 0x9899 0x3f3 0x50b8 0x9840 0x3e8 0x5283 0x97f5 0x3e8 0x544e 0x97b0 0x3e8 0x5619 0x976b 0x3e8 0x57e4 0x972a 0x3e8 0x59b0 0x96ed 0x3e8 0x5b7b 0x96af 0x3e8 0x5d46 0x9679 0x3e8 0x5f11 0x9644 0x3e8 0x60dc 0x960e 0x3e8 0x62a8 0x95d9 0x3e8 0x6473 0x95ab 0x3e8 0x663e 0x957d 0x3e8 0x6809 0x9552 0x3ef 0x69d4 0x952b 0x401 0x6ba0 0x94fd 0x401 0x6d6b 0x94d5 0x401 0x6f36 0x94af 0x401 0x7101 0x9489 0x404 0x72cc 0x946b 0x417 0x7497 0x9446 0x41a 0x7663 0x9424 0x42f 0x782e 0x9400 0x44c 0x79f9 0x93ca 0x44c 0x7bc4 0x9378 0x405 0x7d8f 0x932d 0x3e8 0x7f5b 0x92ed 0x3e8 0x8126 0x92b8 0x3e8 0x82f1 0x928a 0x3fb 0x84bc 0x925c 0x401 0x8687 0x922e 0x401 0x8853 0x9201 0x403 0x8a1e 0x91db 0x416 0x8be9 0x91ae 0x41a 0x8db4 0x917c 0x423 0x8f7f 0x9143 0x42c 0x914b 0x90fe 0x406 0x9316 0x90c0 0x412 0x94e1 0x9083 0x425 0x96ac 0x9040 0x41f 0x9877 0x8feb 0x3d2 0x9a43 0x8fcb 0x3cf 0x9c0e 0x8fbb 0x3e8 0x9dd9 0x8fb3 0x422 0x9fa4 0x8fab 0x482 0xa16f 0x8f94 0x4e1 0xa33a 0x8f61 0x517 0xa506 0x8ebf 0x4f4 0xa6d1 0x8d7d 0x47e 0xa89c 0x8b8b 0x47e 0xaa67 0x88f8 0x4cc 0xac32 0x854f 0x56f 0xadfe 0x7f86 0x9ee 0xafc9 0x71c1 0xb0a 0xb194 0x715c 0xa8c>;
			battery1_profile_t0_col = <0x03>;
			battery1_profile_t0_num = <0x64>;
			battery1_profile_t1 = <0x00 0xac62 0x500 0x1cb 0xac06 0x50f 0x396 0xaba5 0x514 0x562 0xab42 0x514 0x72d 0xaade 0x514 0x8f8 0xaa7b 0x514 0xac3 0xaa11 0x514 0xc8e 0xa9a6 0x514 0xe5a 0xa93a 0x514 0x1025 0xa8c7 0x514 0x11f0 0xa84d 0x504 0x13bb 0xa7d7 0x505 0x1586 0xa761 0x50f 0x1751 0xa6df 0x4fc 0x191d 0xa66b 0x50d 0x1ae8 0xa5ee 0x54a 0x1cb3 0xa56d 0x57e 0x1e7e 0xa4f3 0x50b 0x2049 0xa479 0x50b 0x2215 0xa3fe 0x509 0x23e0 0xa384 0x4fb 0x25ab 0xa309 0x4fb 0x2776 0xa296 0x50d 0x2941 0xa223 0x520 0x2b0d 0xa1ae 0x52d 0x2cd8 0xa134 0x52d 0x2ea3 0xa0c1 0x52d 0x306e 0xa04e 0x52d 0x3239 0x9fde 0x535 0x3405 0x9f73 0x546 0x35d0 0x9f08 0x546 0x379b 0x9ea3 0x564 0x3966 0x9e3c 0x578 0x3b31 0x9dd1 0x57b 0x3cfd 0x9d65 0x58f 0x3ec8 0x9d01 0x5b2 0x4093 0x9c9d 0x5d9 0x425e 0x9c3a 0x5fa 0x4429 0x9bd6 0x60d 0x45f4 0x9b71 0x621 0x47c0 0x9afe 0x60d 0x498b 0x9a7b 0x5cb 0x4b56 0x99ea 0x55b 0x4d21 0x9960 0x50e 0x4eec 0x98ee 0x4ed 0x50b8 0x9889 0x4d1 0x5283 0x9830 0x4b0 0x544e 0x97e3 0x4b0 0x5619 0x97a3 0x4c0 0x57e4 0x9762 0x4bf 0x59b0 0x971f 0x4b0 0x5b7b 0x96e1 0x4b0 0x5d46 0x96ab 0x4c1 0x5f11 0x9676 0x4c9 0x60dc 0x9640 0x4c9 0x62a8 0x960b 0x4c9 0x6473 0x95dd 0x4c9 0x663e 0x95af 0x4c9 0x6809 0x9581 0x4c9 0x69d4 0x9553 0x4ca 0x6ba0 0x952d 0x4dd 0x6d6b 0x9507 0x4e2 0x6f36 0x94e1 0x4e2 0x7101 0x94bb 0x4e5 0x72cc 0x949d 0x4f8 0x7497 0x9478 0x4fb 0x7663 0x9456 0x505 0x782e 0x9437 0x514 0x79f9 0x9418 0x514 0x7bc4 0x93ec 0x502 0x7d8f 0x93c2 0x4fb 0x7f5b 0x939a 0x4ef 0x8126 0x936c 0x4c9 0x82f1 0x933e 0x4c9 0x84bc 0x9310 0x4c9 0x8687 0x92e2 0x4c2 0x8853 0x92b4 0x4b0 0x8a1e 0x9286 0x4b0 0x8be9 0x9264 0x4bf 0x8db4 0x923d 0x4c9 0x8f7f 0x920e 0x4cd 0x914b 0x91d8 0x4e0 0x9316 0x9195 0x4d1 0x94e1 0x9155 0x4d4 0x96ac 0x9116 0x4e7 0x9877 0x90d1 0x4fa 0x9a43 0x9085 0x4d6 0x9c0e 0x905b 0x4d5 0x9dd9 0x9047 0x4e9 0x9fa4 0x9038 0x4fd 0xa16f 0x9030 0x537 0xa33a 0x901d 0x58c 0xa506 0x8fef 0x5e4 0xa6d1 0x8f85 0x61c 0xa89c 0x8e3c 0x5bc 0xaa67 0x8c44 0x5e8 0xac32 0x89a5 0x652 0xadfe 0x8600 0x724 0xafc9 0x8033 0x929 0xb194 0x75ee 0x1563>;
			battery1_profile_t1_col = <0x03>;
			battery1_profile_t1_num = <0x64>;
			battery1_profile_t2 = <0x00 0xac76 0x9e2 0xce3 0x1cb 0xabfc 0x9de 0x88a 0x396 0xab8c 0x9f8 0x599 0x562 0xab24 0xa0f 0x4d9 0x72d 0xaabf 0xa0d 0x54f 0x8f8 0xaa54 0x9fa 0x5d1 0xac3 0xa9e9 0x9f6 0x602 0xc8e 0xa97a 0x9ed 0x5f7 0xe5a 0xa908 0x9dd 0x5e8 0x1025 0xa895 0x9dd 0x5dd 0x11f0 0xa822 0x9cd 0x60b 0x13bb 0xa7ab 0x9ba 0x617 0x1586 0xa731 0x9ab 0x5fb 0x1751 0xa6b6 0x9ab 0x5e1 0x191d 0xa63c 0x999 0x61b 0x1ae8 0xa5bc 0xa13 0x607 0x1cb3 0xa53b 0xa94 0x5f0 0x1e7e 0xa4c1 0x99c 0x5fd 0x2049 0xa447 0x969 0x5eb 0x2215 0xa3d0 0x96b 0x5fe 0x23e0 0xa35c 0x974 0x5f8 0x25ab 0xa2e1 0x961 0x60a 0x2776 0xa26e 0x972 0x5c8 0x2941 0xa1f6 0x979 0x5d0 0x2b0d 0xa17e 0x979 0x5b8 0x2cd8 0xa10c 0x979 0x5b2 0x2ea3 0xa099 0x979 0x5ac 0x306e 0xa026 0x979 0x597 0x3239 0x9fb6 0x979 0x599 0x3405 0x9f4c 0x97f 0x589 0x35d0 0x9ee8 0x9b8 0x581 0x379b 0x9e7f 0x9e2 0x584 0x3966 0x9e10 0x9f6 0x57b 0x3b31 0x9d9f 0x9f9 0x56f 0x3cfd 0x9d33 0xa0d 0x57d 0x3ec8 0x9cc8 0x9fe 0x56e 0x4093 0x9c5d 0x9f6 0x568 0x425e 0x9bf4 0x9f6 0x56c 0x4429 0x9b90 0x9f6 0x55a 0x45f4 0x9b1d 0x9d1 0x553 0x47c0 0x9aa4 0x99e 0x56c 0x498b 0x9a24 0x95d 0x567 0x4b56 0x999b 0x911 0x567 0x4d21 0x9921 0x8c4 0x575 0x4eec 0x98b2 0x894 0x58a 0x50b8 0x984d 0x86e 0x58c 0x5283 0x97f4 0x84d 0x5b0 0x544e 0x97a7 0x84d 0x5b7 0x5619 0x9761 0x84d 0x5a3 0x57e4 0x9720 0x857 0x5b1 0x59b0 0x96e3 0x866 0x5a5 0x5b7b 0x96a5 0x866 0x5a1 0x5d46 0x9668 0x855 0x59e 0x5f11 0x9630 0x859 0x5a1 0x60dc 0x95fa 0x866 0x5a2 0x62a8 0x95c5 0x866 0x5aa 0x6473 0x9597 0x866 0x5a4 0x663e 0x9569 0x873 0x59b 0x6809 0x953e 0x88d 0x59c 0x69d4 0x9517 0x8b1 0x59d 0x6ba0 0x94e9 0x8b1 0x598 0x6d6b 0x94c1 0x8c0 0x5a0 0x6f36 0x949b 0x8ca 0x597 0x7101 0x9475 0x8cd 0x59c 0x72cc 0x9457 0x8e0 0x59a 0x7497 0x9438 0x8f3 0x5a6 0x7663 0x941a 0x8fc 0x5a3 0x782e 0x93fb 0x8fc 0x59d 0x79f9 0x93dc 0x8fc 0x59b 0x7bc4 0x93c5 0x91f 0x5a5 0x7d8f 0x93ae 0x92e 0x59c 0x7f5b 0x9394 0x92e 0x5a0 0x8126 0x9376 0x92e 0x591 0x82f1 0x9357 0x941 0x59f 0x84bc 0x9333 0x954 0x5a4 0x8687 0x930a 0x967 0x5a1 0x8853 0x92dd 0x97e 0x593 0x8a1e 0x92b7 0x9b7 0x598 0x8be9 0x9290 0x9f1 0x59e 0x8db4 0x9262 0xa35 0x595 0x8f7f 0x922b 0xa81 0x598 0x914b 0x91ed 0xace 0x5a1 0x9316 0x91a9 0xb09 0x5a8 0x94e1 0x9165 0xb59 0x5a3 0x96ac 0x911c 0xbb8 0x5a9 0x9877 0x90c7 0xc18 0x598 0x9a43 0x9082 0xc8a 0x5a7 0x9c0e 0x9051 0xd22 0x596 0x9dd9 0x9030 0xde2 0x596 0x9fa4 0x9019 0xecb 0x59e 0xa16f 0x8ffa 0xffd 0x5cc 0xa33a 0x8fc5 0x1183 0x5c9 0xa506 0x8f6e 0x1359 0x5cb 0xa6d1 0x8edd 0x156f 0x5e8 0xa89c 0x8dab 0x1773 0x5e8 0xaa67 0x8bac 0x1abe 0x5e8 0xac32 0x88e6 0x20e7 0x5e8 0xadfe 0x8523 0x2a42 0x5e8 0xafc9 0x7eb8 0x2b76 0x5e8 0xb194 0x77ba 0x1a90 0x5e8>;
			battery1_profile_t2_col = <0x04>;
			battery1_profile_t2_num = <0x64>;
			battery1_profile_t3 = <0x00 0xac80 0x1356 0x22a8 0x1cb 0xabef 0x1356 0x1ad3 0x396 0xab6d 0x138b 0x1610 0x562 0xaaf3 0x13b3 0x130c 0x72d 0xaa78 0x139e 0xec6 0x8f8 0xa9fe 0x1378 0xbb6 0xac3 0xa989 0x136f 0x929 0xc8e 0xa913 0x1366 0x727 0xe5a 0xa898 0x1353 0x594 0x1025 0xa81e 0x1340 0x455 0x11f0 0xa79d 0x130c 0x348 0x13bb 0xa71f 0x12dd 0x202 0x1586 0xa6a5 0x12bb 0x20e 0x1751 0xa62a 0x12a8 0x20d 0x191d 0xa5a9 0x1283 0x1e6 0x1ae8 0xa526 0x1361 0x1cf 0x1cb3 0xa4a5 0x144e 0x1cc 0x1e7e 0xa42b 0x1283 0x1be 0x2049 0xa3b7 0x1233 0x1b2 0x2215 0xa340 0x121f 0x1a4 0x23e0 0xa2c8 0x1211 0x1a4 0x25ab 0xa255 0x1211 0x1b3 0x2776 0xa1db 0x11ed 0x1b2 0x2941 0xa165 0x11df 0x1bf 0x2b0d 0xa0f2 0x11d9 0x1cc 0x2cd8 0xa080 0x11c6 0x1d9 0x2ea3 0xa00d 0x11b2 0x200 0x306e 0x9fa5 0x11d6 0x21a 0x3239 0x9f3e 0x1200 0x227 0x3405 0x9ed2 0x1211 0x24a 0x35d0 0x9e60 0x1211 0x275 0x379b 0x9de7 0x1202 0x28c 0x3966 0x9d70 0x11ef 0x2aa 0x3b31 0x9cff 0x11dc 0x2dc 0x3cfd 0x9c93 0x11c8 0x301 0x3ec8 0x9c22 0x1194 0x324 0x4093 0x9bb3 0x1170 0x347 0x425e 0x9b46 0x1153 0x370 0x4429 0x9ad3 0x111a 0x398 0x45f4 0x9a5f 0x10f2 0x3b3 0x47c0 0x99e6 0x10b2 0x3cc 0x498b 0x996e 0x106c 0x3fd 0x4b56 0x98fc 0x1035 0x439 0x4d21 0x9891 0x1022 0x468 0x4eec 0x9831 0x1000 0x49e 0x50b8 0x97d5 0xfeb 0x4d5 0x5283 0x977d 0xfee 0x508 0x544e 0x9738 0x1001 0x557 0x5619 0x96f3 0x1004 0x58d 0x57e4 0x96ae 0x100e 0x5d9 0x59b0 0x966c 0x1025 0x627 0x5b7b 0x9637 0x104c 0x680 0x5d46 0x95fa 0x104f 0x6df 0x5f11 0x95c2 0x105b 0x739 0x60dc 0x958e 0x1079 0x795 0x62a8 0x9560 0x10b2 0x7ea 0x6473 0x9533 0x10c6 0x82c 0x663e 0x9505 0x10d9 0x870 0x6809 0x94da 0x10fb 0x8ad 0x69d4 0x94b3 0x1133 0x8d8 0x6ba0 0x948d 0x1159 0x901 0x6d6b 0x9467 0x1171 0x93d 0x6f36 0x9444 0x118c 0x96f 0x7101 0x9428 0x11b9 0x9a8 0x72cc 0x9418 0x1205 0x9cd 0x7497 0x9403 0x1241 0xa04 0x7663 0x93ec 0x127b 0xa29 0x782e 0x93d6 0x12c1 0xa44 0x79f9 0x93c7 0x1334 0xa6a 0x7bc4 0x93b1 0x1395 0xa77 0x7d8f 0x939a 0x1401 0xa98 0x7f5b 0x9383 0x1480 0xa8f 0x8126 0x936c 0x1519 0xa7d 0x82f1 0x934d 0x15b2 0xa68 0x84bc 0x9329 0x1658 0xa38 0x8687 0x9300 0x1704 0xa01 0x8853 0x92d2 0x17b4 0x9bb 0x8a1e 0x92a4 0x1886 0x982 0x8be9 0x9270 0x196b 0x934 0x8db4 0x9236 0x1a5c 0x8e0 0x8f7f 0x91f7 0x1b5b 0x87b 0x914b 0x91b2 0x1c7a 0x83c 0x9316 0x9167 0x1daa 0x7ea 0x94e1 0x911f 0x1f08 0x7a5 0x96ac 0x90dc 0x2096 0x781 0x9877 0x909e 0x224e 0x774 0x9a43 0x9061 0x2487 0x764 0x9c0e 0x902e 0x271c 0x770 0x9dd9 0x8ffd 0x2a1c 0x758 0x9fa4 0x8fc8 0x2d8c 0x720 0xa16f 0x8f92 0x30fc 0x684 0xa33a 0x8f46 0x33ee 0x575 0xa506 0x8ed5 0x3648 0x575 0xa6d1 0x8e2f 0x3823 0x575 0xa89c 0x8d2b 0x3a74 0x575 0xaa67 0x8b72 0x3f71 0x575 0xac32 0x8917 0x4452 0x575 0xadfe 0x855d 0x3c98 0x575 0xafc9 0x8426 0x3921 0x575 0xb194 0x8426 0x3921 0x575>;
			battery1_profile_t3_col = <0x04>;
			battery1_profile_t3_num = <0x64>;
			battery1_profile_t4 = <0x00 0xaca8 0x288c 0x3861 0x1cb 0xabf8 0x2888 0x2ebd 0x396 0xab53 0x28fe 0x26a0 0x562 0xaaaf 0x2952 0x202f 0x72d 0xaa07 0x2918 0x1b16 0x8f8 0xa966 0x28df 0x16af 0xac3 0xa8cc 0x2888 0x13b1 0xc8e 0xa833 0x2828 0x10ea 0xe5a 0xa79b 0x27c9 0xde9 0x1025 0xa709 0x2769 0xaf4 0x11f0 0xa67e 0x26f9 0x82e 0x13bb 0xa5f5 0x2691 0x553 0x1586 0xa56b 0x2631 0x25e 0x1751 0xa4e1 0x25d1 0x79 0x191d 0xa45f 0x2595 0x362 0x1ae8 0xa3d8 0x26ad 0x63b 0x1cb3 0xa353 0x27c8 0x923 0x1e7e 0xa2e0 0x2518 0xc02 0x2049 0xa267 0x2466 0xca5 0x2215 0xa1f0 0x241b 0xc2e 0x23e0 0xa17e 0x23e2 0xb95 0x25ab 0xa10b 0x23a8 0xb34 0x2776 0xa098 0x236f 0xaa9 0x2941 0xa02f 0x234e 0xa34 0x2b0d 0x9fc6 0x2334 0x9c4 0x2cd8 0x9f54 0x230e 0x94e 0x2ea3 0x9ee1 0x22e8 0x8c7 0x306e 0x9e63 0x2299 0x859 0x3239 0x9de4 0x2249 0x7e2 0x3405 0x9d6a 0x220b 0x6d9 0x35d0 0x9cef 0x21ac 0x5a6 0x379b 0x9c81 0x217a 0x58a 0x3966 0x9c12 0x2141 0x580 0x3b31 0x9ba3 0x20ff 0x44d 0x3cfd 0x9b47 0x20eb 0x361 0x3ec8 0x9ade 0x20b7 0x41c 0x4093 0x9a77 0x2093 0x399 0x425e 0x9a12 0x2076 0x331 0x4429 0x99a7 0x203d 0x2a9 0x45f4 0x9941 0x2027 0x231 0x47c0 0x98dd 0x2007 0x1b0 0x498b 0x987d 0x1fe8 0x13c 0x4b56 0x9821 0x1fd5 0x9e 0x4d21 0x97c5 0x1fc2 0x15 0x4eec 0x9775 0x1fbd 0x9e 0x50b8 0x972b 0x1fce 0x170 0x5283 0x96e6 0x1fef 0x229 0x544e 0x9699 0x1fef 0x2fb 0x5619 0x9659 0x200f 0x3b6 0x57e4 0x9620 0x2035 0x486 0x59b0 0x95ea 0x205b 0x55c 0x5b7b 0x95b5 0x2082 0x603 0x5d46 0x957f 0x20a8 0x6b1 0x5f11 0x954e 0x20ce 0x768 0x60dc 0x9523 0x2100 0x855 0x62a8 0x94fc 0x214c 0x930 0x6473 0x94d6 0x2186 0x9ff 0x663e 0x94ba 0x21d9 0xad8 0x6809 0x94a0 0x2232 0xbb0 0x69d4 0x9483 0x2281 0xc73 0x6ba0 0x9474 0x22f4 0xd43 0x6d6b 0x945e 0x2358 0xdfb 0x6f36 0x9448 0x23c9 0xe88 0x7101 0x9432 0x2452 0xf0c 0x72cc 0x9422 0x24eb 0xf70 0x7497 0x940d 0x25a4 0xfcf 0x7663 0x93f6 0x265a 0xfdc 0x782e 0x93df 0x270f 0xff6 0x79f9 0x93c8 0x27e1 0xfec 0x7bc4 0x93b1 0x28c5 0xfbc 0x7d8f 0x939a 0x29ab 0xfab 0x7f5b 0x9380 0x2a96 0xf87 0x8126 0x9362 0x2b8f 0xf03 0x82f1 0x9343 0x2c88 0xe5e 0x84bc 0x931f 0x2d80 0xde7 0x8687 0x92fc 0x2e79 0xe33 0x8853 0x92dc 0x2f70 0xdea 0x8a1e 0x92ae 0x3056 0xc75 0x8be9 0x927a 0x313f 0xc31 0x8db4 0x9244 0x3213 0xc59 0x8f7f 0x920d 0x32d3 0xb10 0x914b 0x91cf 0x3392 0xb37 0x9316 0x9192 0x3451 0xa5f 0x94e1 0x9151 0x3511 0xa6e 0x96ac 0x910c 0x35d0 0x9dd 0x9877 0x90c7 0x368f 0x9ea 0x9a43 0x9082 0x3761 0x99e 0x9c0e 0x9047 0x3840 0x93d 0x9dd9 0x9017 0x394d 0x8fa 0x9fa4 0x8ff1 0x3aaa 0x923 0xa16f 0x8fd2 0x3c75 0x8fd 0xa33a 0x8fb4 0x3f13 0x90a 0xa506 0x8f85 0x42c9 0x8a6 0xa6d1 0x8f2e 0x480a 0x7dd 0xa89c 0x8e50 0x50c7 0x7ff 0xaa67 0x8ca8 0x4e79 0x823 0xac32 0x8a19 0x4828 0x7ec 0xadfe 0x8a0c 0x47c7 0x836 0xafc9 0x8a0c 0x47c7 0x836 0xb194 0x8a0c 0x47c7 0x836>;
			battery1_profile_t4_col = <0x04>;
			battery1_profile_t4_num = <0x64>;
		};
	};

	fragment@8 {
		target = <0xffffffff>;

		__overlay__ {

			aw8624_interrupt_active {
				phandle = <0x20>;

				pins_cmd_dat {
					bias-pull-up;
					drive-strength = <0x02>;
					input-enable;
					pinmux = <0x1600>;
				};
			};

			aw8624_reset_active {
				phandle = <0x1e>;

				pins_cmd_dat {
					bias-disable;
					drive-strength = <0x02>;
					output-low;
					pinmux = <0x8100>;
				};
			};

			aw8624_reset_reset {
				phandle = <0x1f>;

				pins_cmd_dat {
					bias-disable;
					drive-strength = <0x02>;
					output-high;
					pinmux = <0x8100>;
				};
			};
		};
	};

	fragment@9 {
		target = <0xffffffff>;

		__overlay__ {
			status = "ok";

			aw8624_haptic@5a {
				compatible = "mediatek,aw8624_haptic";
				irq-gpio = <0xffffffff 0x16 0x00>;
				pinctrl-0 = <0x1e>;
				pinctrl-1 = <0x1f>;
				pinctrl-2 = <0x20>;
				pinctrl-names = "aw8624_reset_reset\0aw8624_reset_active\0aw8624_interrupt_active";
				reg = <0x5a>;
				reset-gpio = <0xffffffff 0x81 0x00>;
				status = "ok";
				vib_bemf_config = <0x10 0x08 0x23 0xf8>;
				vib_bst_vol_default = <0x1b>;
				vib_bst_vol_ram = <0x1b>;
				vib_bst_vol_rtp = <0x16>;
				vib_cont_drv_lev = <0x64>;
				vib_cont_drv_lvl_ov = <0x69>;
				vib_cont_num_brk = <0x03>;
				vib_cont_td = <0xf06c>;
				vib_cont_zc_thr = <0x8f8>;
				vib_effect_id_boundary = <0x0a>;
				vib_effect_max = <0xaa>;
				vib_f0_cali_percen = <0x07>;
				vib_f0_coeff = <0x104>;
				vib_f0_pre = <0x802>;
				vib_f0_trace_parameter = <0x09 0x03 0x01 0x1f>;
				vib_func_parameter1 = <0x01>;
				vib_gain_flag = <0x00>;
				vib_mode = <0x00>;
				vib_r_spare = <0x68>;
				vib_rtp_time = <0x14 0x14 0x14 0x14 0x14 0x14 0x14 0x14 0x4e20 0x3a98 0x3a98 0x4e20 0x61a8 0x3a98 0x7530 0x61a8 0x4e20 0x4e20 0x4e20 0x4e20 0x4e20 0x4e20 0x4e20 0x4e20 0x4e20 0x4e20 0x4e20 0x4e20 0x4e20 0x4e20 0x4e20 0x4e20 0x4e20 0x4e20 0x4e20 0x4e20 0x4e20 0x4e20 0x4e20 0x4e20 0x4e20 0x4e20 0x4e20 0x4e20 0x4e20 0x4e20 0x4e20 0x4e20 0x4e20 0x4e20 0x4e20 0x4e20 0x4e20 0x4e20 0x4e20 0x4e20 0x4e20 0x4e20 0x4e20 0x4e20 0x4e20 0x4e20 0x4e20 0x4e20 0x4e20 0x4e20 0x4e20 0x4e20 0x4e20 0x4e20 0x4e20 0x4e20 0x4e20 0x4e20 0x4e20 0x4e20 0x4e20 0x4e20 0x4e20 0x4e20 0x4e20 0x4e20 0x4e20 0x4e20 0x4e20 0x4e20 0x4e20 0x4e20 0x4e20 0x4e20 0x4e20 0x4e20 0x4e20 0x4e20 0x4e20 0x4e20 0x4e20 0x4e20 0x4e20 0x4e20 0x4e20 0x4e20 0x4e20 0x4e20 0x4e20 0x4e20 0x4e20 0x4e20 0x4e20 0x4e20 0x4e20 0x4e20 0x4e20 0x4e20 0x4e20 0x4e20 0x4e20 0x4e20 0x4e20 0x4e20 0x4e20 0x4e20 0x4e20 0x4e20 0x4e20 0x4e20 0x4e20 0x4e20 0x4e20 0x4e20 0x4e20 0x4e20 0x4e20 0x4e20 0x4e20 0x4e20 0x4e20 0x4e20 0x4e20 0x4e20 0x4e20 0x4e20 0x4e20 0x4e20 0x4e20 0x4e20 0x4e20 0x4e20 0x4e20 0x4e20 0x4e20 0x4e20 0x4e20 0x4e20 0x4e20 0x4e20 0x4e20 0x4e20 0x4e20 0x4e20 0x4e20 0x4e20 0x4e20 0x4e20 0x4e20 0x4e20 0x4e20 0x4e20 0x4e20 0x4e20 0x4e20 0x4e20 0x4e20 0x4e20 0x4e20>;
				vib_sw_brake = <0x2c>;
				vib_trig_config = <0x00 0x01 0x00 0x01 0x02 0x00 0x01 0x00 0x01 0x02 0x00 0x01 0x00 0x01 0x02>;
				vib_tset = <0x11>;

				wf_0 {
					mtk,effect-id = <0x00>;
					mtk,wf-brake-pattern = <0x2010000>;
					mtk,wf-pattern = [3e 3e];
					mtk,wf-play-rate-us = <0x4e20>;
					mtk,wf-vmax-mv = <0xe10>;
				};

				wf_1 {
					mtk,effect-id = <0x01>;
					mtk,wf-brake-pattern = <0x3010000>;
					mtk,wf-pattern = [7e 3e];
					mtk,wf-play-rate-us = <0x4e20>;
					mtk,wf-vmax-mv = <0xe10>;
				};

				wf_10 {
					mtk,effect-id = <0x0a>;
					mtk,wf-brake-pattern = <0x2010000>;
					mtk,wf-pattern = [3e 3e];
					mtk,wf-play-rate-us = <0x3a98>;
					mtk,wf-vmax-mv = <0xe10>;
				};

				wf_2 {
					mtk,effect-id = <0x02>;
					mtk,wf-brake-pattern = <0x2010000>;
					mtk,wf-pattern = [7e 3e];
					mtk,wf-play-rate-us = <0x32c8>;
					mtk,wf-vmax-mv = <0xe10>;
				};

				wf_3 {
					mtk,effect-id = <0x03>;
					mtk,wf-brake-pattern = <0x2010000>;
					mtk,wf-pattern = [3e 3e];
					mtk,wf-play-rate-us = <0x2710>;
					mtk,wf-vmax-mv = <0xe10>;
				};

				wf_4 {
					mtk,effect-id = <0x04>;
					mtk,wf-brake-pattern = <0x2010000>;
					mtk,wf-pattern = [3e 3e];
					mtk,wf-play-rate-us = <0x6d60>;
					mtk,wf-vmax-mv = <0xe10>;
				};

				wf_5 {
					mtk,effect-id = <0x05>;
					mtk,wf-brake-pattern = <0x3030100>;
					mtk,wf-pattern = [7e 7e 7e];
					mtk,wf-play-rate-us = <0x2710>;
					mtk,wf-vmax-mv = <0xe10>;
				};

				wf_6 {
					mtk,effect-id = <0x06>;
					mtk,wf-brake-pattern = <0x2010000>;
					mtk,wf-pattern = [3e 3e];
					mtk,wf-play-rate-us = <0x61a8>;
					mtk,wf-vmax-mv = <0xe10>;
				};

				wf_7 {
					mtk,effect-id = <0x07>;
					mtk,wf-brake-pattern = <0x3010000>;
					mtk,wf-pattern = [7e 3e];
					mtk,wf-play-rate-us = <0x61a8>;
					mtk,wf-vmax-mv = <0xe10>;
				};

				wf_8 {
					mtk,effect-id = <0x08>;
					mtk,wf-brake-pattern = <0x2010000>;
					mtk,wf-pattern = [7e 3e];
					mtk,wf-play-rate-us = <0x88b8>;
					mtk,wf-vmax-mv = <0xe10>;
				};

				wf_9 {
					mtk,effect-id = <0x09>;
					mtk,wf-brake-pattern = <0x2010000>;
					mtk,wf-pattern = [3e 3e];
					mtk,wf-play-rate-us = <0x3a98>;
					mtk,wf-vmax-mv = <0xe10>;
				};
			};
		};
	};
};
